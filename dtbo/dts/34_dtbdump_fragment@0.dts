/dts-v1/;

/ {

	fragment@0 {
		target = <0xffffffff>;

		__overlay__ {
			device_type = "memory";
			reg = <0x00 0x20000000 0x00 0x80000000>;
		};
	};

	fragment@1 {
		target = <0xffffffff>;

		__overlay__ {
			device_type = "memory";
			reg = <0x00 0x00 0x00 0x00>;
		};
	};

	fragment@2 {
		target = <0xffffffff>;

		__overlay__ {
			device_type = "memory";
			reg = <0x00 0x00 0x00 0x00>;
		};
	};

	fragment@3 {
		target = <0xffffffff>;

		__overlay__ {
			device_type = "memory";
			reg = <0x00 0x00 0x00 0x00>;
		};
	};

	fragment@4 {
		target = <0xffffffff>;

		__overlay__ {

			MMAP_PROPERTY {
				platfrom = "ANDROID";
				mmap_size = "2G";
				mmap_filename = "mmap_mt5873_mtk_2g_an_iommu";
				mmap_sha256 = <0x98ee9c4c>;
			};

			MI_DRAMC_HW_TRACKING {
				layer = <0x00>;
				miu = <0x00>;
				is_cache = <0x00>;
				cma_id = <0x00>;
				reg = <0x00 0x20000000 0x00 0x1000>;
			};

			MI_PM51_VAR_MEM {
				layer = <0x00>;
				miu = <0x00>;
				is_cache = <0x00>;
				cma_id = <0x00>;
				reg = <0x00 0x20001000 0x00 0x1000>;
			};

			MI_PM51_MEM {
				layer = <0x00>;
				miu = <0x00>;
				is_cache = <0x00>;
				cma_id = <0x00>;
				reg = <0x00 0x20002000 0x00 0x10000>;
			};

			MI_HDMIRX_MEM_SHM {
				layer = <0x00>;
				miu = <0x00>;
				is_cache = <0x00>;
				cma_id = <0x00>;
				reg = <0x00 0x20060000 0x00 0x40000>;
			};

			MI_VBI_BUF {
				layer = <0x00>;
				miu = <0x00>;
				is_cache = <0x00>;
				cma_id = <0x00>;
				reg = <0x00 0x200a0000 0x00 0xd000>;
			};

			MI_SBOOT_UBOOT_BANK {
				layer = <0x00>;
				miu = <0x00>;
				is_cache = <0x00>;
				cma_id = <0x00>;
				reg = <0x00 0x20100000 0x00 0x100000>;
			};

			MI_MAD_ADV_BUF {
				layer = <0x00>;
				miu = <0x00>;
				is_cache = <0x00>;
				cma_id = <0x00>;
				reg = <0x00 0x20200000 0x00 0x2600000>;
			};

			MI_TSP_FW_BUF {
				layer = <0x00>;
				miu = <0x00>;
				is_cache = <0x00>;
				cma_id = <0x00>;
				reg = <0x00 0x22800000 0x00 0x11000>;
			};

			MI_TSP_VQ_BUF {
				layer = <0x00>;
				miu = <0x00>;
				is_cache = <0x00>;
				cma_id = <0x00>;
				reg = <0x00 0x22811000 0x00 0x20000>;
			};

			MI_AUDIO_CPU_1 {
				layer = <0x00>;
				miu = <0x00>;
				is_cache = <0x00>;
				cma_id = <0x00>;
				reg = <0x00 0x2501c000 0x00 0x400000>;
			};

			MI_DISPOUT_DEMURA {
				layer = <0x00>;
				miu = <0x00>;
				is_cache = <0x00>;
				cma_id = <0x00>;
				reg = <0x00 0x2541c000 0x00 0x500000>;
			};

			MI_VRR_SHM {
				layer = <0x00>;
				miu = <0x00>;
				is_cache = <0x00>;
				cma_id = <0x00>;
				reg = <0x00 0x25d60000 0x00 0x1000>;
			};

			MI_KERNEL_POOL1 {
				layer = <0x00>;
				miu = <0x00>;
				is_cache = <0x00>;
				cma_id = <0x00>;
				reg = <0x00 0x26000000 0x00 0x35e00000>;
			};

			MI_KERNEL1_RANGE0 {
				layer = <0x01>;
				miu = <0x00>;
				is_cache = <0x00>;
				cma_id = <0x00>;
				reg = <0x00 0x26000000 0x00 0x6200000>;
			};

			MI_MBOOT_MEM_USAGE {
				layer = <0x01>;
				miu = <0x00>;
				is_cache = <0x00>;
				cma_id = <0x00>;
				reg = <0x00 0x2c200000 0x00 0x2400000>;
			};

			MI_JPD_OUT {
				layer = <0x01>;
				miu = <0x00>;
				is_cache = <0x00>;
				cma_id = <0x00>;
				reg = <0x00 0x40000000 0x00 0x400000>;
			};

			MI_JPD_READ_BUF {
				layer = <0x01>;
				miu = <0x00>;
				is_cache = <0x00>;
				cma_id = <0x00>;
				reg = <0x00 0x40400000 0x00 0x500000>;
			};

			MI_JPD_INTER_BUF {
				layer = <0x01>;
				miu = <0x00>;
				is_cache = <0x00>;
				cma_id = <0x00>;
				reg = <0x00 0x40900000 0x00 0xd00000>;
			};

			MI_DUMMY {
				layer = <0x01>;
				miu = <0x00>;
				is_cache = <0x00>;
				cma_id = <0x00>;
				reg = <0x00 0x41600000 0x00 0x3e00000>;
			};

			E_MMAP_ID_SW_UPGRADE_BUF {
				layer = <0x01>;
				miu = <0x00>;
				is_cache = <0x00>;
				cma_id = <0x00>;
				reg = <0x00 0x45400000 0x00 0x158ff000>;
			};

			MI_FRC_FW_MEM {
				layer = <0x00>;
				miu = <0x00>;
				is_cache = <0x00>;
				cma_id = <0x00>;
				reg = <0x00 0x5be00000 0x00 0x300000>;
			};

			MI_FRC_SHM {
				layer = <0x00>;
				miu = <0x00>;
				is_cache = <0x00>;
				cma_id = <0x00>;
				reg = <0x00 0x5c100000 0x00 0x15000>;
			};

			MI_DISP_PQ_MEMORY {
				layer = <0x00>;
				miu = <0x00>;
				is_cache = <0x00>;
				cma_id = <0x00>;
				reg = <0x00 0x5c115000 0x00 0x10000>;
			};

			MI_DISP_PQ_DF_MEMORY_LAYER {
				layer = <0x00>;
				miu = <0x00>;
				is_cache = <0x00>;
				cma_id = <0x00>;
				reg = <0x00 0x5c125000 0x00 0xd000>;
			};

			MI_DISP_OD_BUF {
				layer = <0x00>;
				miu = <0x00>;
				is_cache = <0x00>;
				cma_id = <0x00>;
				reg = <0x00 0x5c132000 0x00 0x600000>;
			};

			MI_DISP_AUTO_UPLOAD {
				layer = <0x00>;
				miu = <0x00>;
				is_cache = <0x00>;
				cma_id = <0x00>;
				reg = <0x00 0x5c732000 0x00 0x5000>;
			};

			MI_DISP_AUTO_DOWNLOAD {
				layer = <0x00>;
				miu = <0x00>;
				is_cache = <0x00>;
				cma_id = <0x00>;
				reg = <0x00 0x5c737000 0x00 0x200000>;
			};

			MI_DISP_GUCD_DMA {
				layer = <0x00>;
				miu = <0x00>;
				is_cache = <0x00>;
				cma_id = <0x00>;
				reg = <0x00 0x5c937000 0x00 0x1b000>;
			};

			MI_GOP_RPMSG {
				layer = <0x00>;
				miu = <0x00>;
				is_cache = <0x00>;
				cma_id = <0x00>;
				reg = <0x00 0x5c952000 0x00 0x1000>;
			};

			MI_MCU_DS {
				layer = <0x00>;
				miu = <0x00>;
				is_cache = <0x00>;
				cma_id = <0x00>;
				reg = <0x00 0x5c953000 0x00 0x14d000>;
			};

			MI_MENULOAD_BUF {
				layer = <0x00>;
				miu = <0x00>;
				is_cache = <0x00>;
				cma_id = <0x00>;
				reg = <0x00 0x5caa0000 0x00 0x180000>;
			};

			MI_STREAMON_METADATA {
				layer = <0x00>;
				miu = <0x00>;
				is_cache = <0x00>;
				cma_id = <0x00>;
				reg = <0x00 0x5cc20000 0x00 0x1000>;
			};

			MI_PQPARAM_METADATA {
				layer = <0x00>;
				miu = <0x00>;
				is_cache = <0x00>;
				cma_id = <0x00>;
				reg = <0x00 0x5cc21000 0x00 0x20000>;
			};

			MI_CONTROLMAP_BUF {
				layer = <0x00>;
				miu = <0x00>;
				is_cache = <0x00>;
				cma_id = <0x00>;
				reg = <0x00 0x5cc41000 0x00 0x8000>;
			};

			MI_ONLY_STR_BUF {
				layer = <0x00>;
				miu = <0x00>;
				is_cache = <0x00>;
				cma_id = <0x00>;
				reg = <0x00 0x5cc49000 0x00 0xa000>;
			};

			MI_CM4_VOICE {
				layer = <0x00>;
				miu = <0x00>;
				is_cache = <0x00>;
				cma_id = <0x00>;
				reg = <0x00 0x5cc53000 0x00 0x200000>;
			};

			MI_MEMC_REALDATA {
				layer = <0x00>;
				miu = <0x00>;
				is_cache = <0x00>;
				cma_id = <0x00>;
				reg = <0x00 0x5ce53000 0x00 0x14000>;
			};

			MI_MEMC_MV_BUFFER {
				layer = <0x00>;
				miu = <0x00>;
				is_cache = <0x00>;
				cma_id = <0x00>;
				reg = <0x00 0x5ce67000 0x00 0x300000>;
			};

			UCD_SHM_BUFFER {
				layer = <0x00>;
				miu = <0x00>;
				is_cache = <0x00>;
				cma_id = <0x00>;
				reg = <0x00 0x5d167000 0x00 0x10000>;
			};

			MI_EXTIN_VD_COMB_BUF {
				layer = <0x00>;
				miu = <0x00>;
				is_cache = <0x00>;
				cma_id = <0x00>;
				reg = <0x00 0x5d177000 0x00 0x400000>;
			};

			MI_BOOTLOGO_BUF {
				layer = <0x01>;
				miu = <0x00>;
				is_cache = <0x00>;
				cma_id = <0x00>;
				reg = <0x00 0x5d177000 0x00 0x400000>;
			};

			MI_DISP_CONFIG_MEMORY {
				layer = <0x00>;
				miu = <0x00>;
				is_cache = <0x00>;
				cma_id = <0x00>;
				reg = <0x00 0x5d577000 0x00 0x1000>;
			};

			MI_MMAP_CFD_BUF {
				layer = <0x00>;
				miu = <0x00>;
				is_cache = <0x00>;
				cma_id = <0x00>;
				reg = <0x00 0x5d578000 0x00 0x457000>;
			};

			MI_PQU_DOLBY_CONFIG_MEM {
				layer = <0x00>;
				miu = <0x00>;
				is_cache = <0x00>;
				cma_id = <0x00>;
				reg = <0x00 0x5d9cf000 0x00 0x50000>;
			};

			MI_FRAME_METADATA {
				layer = <0x00>;
				miu = <0x00>;
				is_cache = <0x00>;
				cma_id = <0x00>;
				reg = <0x00 0x5da1f000 0x00 0x100000>;
			};

			MI_SRCCAP_SWREG_BUF {
				layer = <0x00>;
				miu = <0x00>;
				is_cache = <0x00>;
				cma_id = <0x00>;
				reg = <0x00 0x5db1f000 0x00 0x1a000>;
			};

			MI_KERNEL_POOL2 {
				layer = <0x00>;
				miu = <0x00>;
				is_cache = <0x00>;
				cma_id = <0x00>;
				reg = <0x00 0x5dc00000 0x00 0x42400000>;
			};

			MI_DMD_DVBT {
				layer = <0x01>;
				miu = <0x00>;
				is_cache = <0x00>;
				cma_id = <0x17>;
				reg = <0x00 0x5dc00000 0x00 0x500000>;
			};

			MI_TSO_FILEIN_BUF {
				layer = <0x01>;
				miu = <0x00>;
				is_cache = <0x00>;
				cma_id = <0x17>;
				reg = <0x00 0x5e100000 0x00 0x540000>;
			};

			MI_DUMMY2 {
				layer = <0x01>;
				miu = <0x00>;
				is_cache = <0x00>;
				cma_id = <0x00>;
				reg = <0x00 0x5e640000 0x00 0x1c0000>;
			};

			MI_DISPOUT_LOCAL_DIMMING {
				layer = <0x01>;
				miu = <0x00>;
				is_cache = <0x00>;
				cma_id = <0x00>;
				reg = <0x00 0x5e800000 0x00 0x600000>;
			};
		};
	};

	__fixups__ {
		lx_mem = "/fragment@0:target:0";
		lx_mem2 = "/fragment@1:target:0";
		lx_mem3 = "/fragment@2:target:0";
		lx_mem4 = "/fragment@3:target:0";
		mtk_mmap = "/fragment@4:target:0";
	};
};
