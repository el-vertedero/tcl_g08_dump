/dts-v1/;

/ {

	fragment@0 {
		target = <0xffffffff>;

		__overlay__ {

			ir_keymap0 {
				protocol = <0x01>;
				keymap_name = "FIRE_TV";
				customercode = <0x27d>;
				ir_key_table = <0x4f 0xa6 0x74 0x46 0x244 0xb1 0xd9 0xa0 0x26e 0xc3 0x67 0x48 0x69 0x4e 0x1c 0x4a 0x6a 0x49 0x6c 0x4d 0x9e 0x0d 0x66 0x9f 0x8b 0x45 0x73 0x0c 0x16a 0x14 0x192 0x0f 0x72 0x19 0x71 0x4c 0x193 0x5a 0xa8 0x16 0xa4 0x5b 0x9f 0x17 0x2e9 0xa1 0x2e8 0x5f 0x2ea 0xa4 0x2eb 0xa5 0x2a0 0xb5 0x2a1 0xb6>;
			};

			ir_keymap1 {
				protocol = <0x01>;
				keymap_name = "mtk-tv";
				customercode = <0x40bf>;
				ir_key_table = <0x74 0x12 0x0b 0x00 0x02 0x01 0x03 0x02 0x04 0x03 0x05 0x04 0x06 0x05 0x07 0x06 0x08 0x07 0x09 0x08 0x0a 0x09 0x67 0x19 0x6c 0x1d 0x69 0x42 0x6a 0x40 0x1c 0x21 0x9e 0x52 0x1d7 0x14 0x73 0x1a 0x72 0x1e 0x192 0x1b 0x193 0x1f 0x231 0x4b 0x66 0x48 0x8b 0x5b 0xae 0x43>;
			};
		};
	};

	__fixups__ {
		ir_in = "/fragment@0:target:0";
	};
};
