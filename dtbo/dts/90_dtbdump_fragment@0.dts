/dts-v1/;

/ {

	fragment@0 {
		target = <0xffffffff>;

		__overlay__ {
			dma_sel = <0x02>;
			bdma = "bdma_ch0";
			fifo-dma-switch;
		};
	};

	__fixups__ {
		mspi2 = "/fragment@0:target:0";
	};
};
