/dts-v1/;

/ {

	fragment@0 {
		target = <0xffffffff>;

		__overlay__ {
			panel_info_name_list = "panel_info\0panel_info_vby1_3840x2160_144\0panel_info_vby1_3840x2160_100\0panel_info_vby1_3840x2160_96\0panel_info_vby1_3840x2160_60\0panel_info_vby1_3840x2160_50\0panel_info_vby1_3840x2160_48";

			panel_info {
				panel_name = "4K120_PANEL_16LANE_2DIV";
				link_type = <0x01>;
				vbo_byte_mode = <0x04>;
				div_section = <0x02>;
				on_timing1 = <0x1e>;
				on_timing2 = <0xc8>;
				off_timing1 = <0xdc>;
				off_timing2 = <0x0a>;
				hsync_start = <0x00>;
				hsync_width = <0x1e>;
				hsync_polarity = <0x01>;
				vsync_start = <0x00>;
				vsync_width = <0x02>;
				vsync_polarity = <0x01>;
				de_hstart = <0x70>;
				de_vstart = <0x54>;
				resolution_width = <0xf00>;
				resolution_height = <0x870>;
				max_h_total = <0x1194>;
				typ_h_total = <0x1130>;
				min_h_total = <0x10cc>;
				max_v_total = <0x900>;
				typ_v_total = <0x8d4>;
				min_v_total = <0x8c4>;
				max_v_total_panelprotect = <0x1c20>;
				min_v_total_panelprotect = <0x8c4>;
				typ_clk_high = <0x00>;
				typ_clk_low = <0x47200200>;
				output_format = <0x00>;
				content_output_format = <0x00>;
				vrr_en = <0x00>;
				min_vrr_framerate = <0x1e0>;
				max_vrr_framerate = <0x60e>;
				graphic_mixer1_outmode = <0x00>;
				graphic_mixer2_outmode = <0x01>;
			};

			panel_info_vby1_3840x2160_144 {
				panel_name = "4K144_PANEL_16LANE_2DIV";
				link_type = <0x01>;
				vbo_byte_mode = <0x04>;
				div_section = <0x02>;
				on_timing1 = <0x1e>;
				on_timing2 = <0xc8>;
				off_timing1 = <0xdc>;
				off_timing2 = <0x0a>;
				hsync_start = <0x00>;
				hsync_width = <0x1e>;
				hsync_polarity = <0x01>;
				vsync_start = <0x00>;
				vsync_width = <0x02>;
				vsync_polarity = <0x01>;
				de_hstart = <0x70>;
				de_vstart = <0x54>;
				resolution_width = <0xf00>;
				resolution_height = <0x870>;
				max_h_total = <0x1194>;
				typ_h_total = <0x1130>;
				min_h_total = <0x10cc>;
				max_v_total = <0x900>;
				typ_v_total = <0x8d4>;
				min_v_total = <0x8c4>;
				max_v_total_panelprotect = <0x1c20>;
				min_v_total_panelprotect = <0x8c4>;
				typ_clk_high = <0x00>;
				typ_clk_low = <0x55599c00>;
				output_format = <0x00>;
				content_output_format = <0x00>;
				vrr_en = <0x00>;
				min_vrr_framerate = <0x1e0>;
				max_vrr_framerate = <0x60e>;
				graphic_mixer1_outmode = <0x00>;
				graphic_mixer2_outmode = <0x01>;
				hpc_mode = <0x01>;
			};

			panel_info_vby1_3840x2160_100 {
				panel_name = "4K100_PANEL_16LANE_2DIV";
				link_type = <0x01>;
				vbo_byte_mode = <0x04>;
				div_section = <0x02>;
				on_timing1 = <0x1e>;
				on_timing2 = <0xc8>;
				off_timing1 = <0xdc>;
				off_timing2 = <0x0a>;
				hsync_start = <0x00>;
				hsync_width = <0x1e>;
				hsync_polarity = <0x01>;
				vsync_start = <0x00>;
				vsync_width = <0x02>;
				vsync_polarity = <0x01>;
				de_hstart = <0x70>;
				de_vstart = <0x54>;
				resolution_width = <0xf00>;
				resolution_height = <0x870>;
				max_h_total = <0x1194>;
				typ_h_total = <0x1130>;
				min_h_total = <0x10cc>;
				max_v_total = <0xad0>;
				typ_v_total = <0xa98>;
				min_v_total = <0xa50>;
				max_v_total_panelprotect = <0x1c20>;
				min_v_total_panelprotect = <0x8c4>;
				typ_clk_high = <0x00>;
				typ_clk_low = <0x47200200>;
				output_format = <0x00>;
				content_output_format = <0x00>;
				vrr_en = <0x00>;
				min_vrr_framerate = <0x1e0>;
				max_vrr_framerate = <0x60e>;
				graphic_mixer1_outmode = <0x00>;
				graphic_mixer2_outmode = <0x01>;
			};

			panel_info_vby1_3840x2160_96 {
				panel_name = "4K96_PANEL_16LANE_2DIV";
				link_type = <0x01>;
				vbo_byte_mode = <0x04>;
				div_section = <0x02>;
				on_timing1 = <0x1e>;
				on_timing2 = <0xc8>;
				off_timing1 = <0xdc>;
				off_timing2 = <0x0a>;
				hsync_start = <0x00>;
				hsync_width = <0x1e>;
				hsync_polarity = <0x01>;
				vsync_start = <0x00>;
				vsync_width = <0x02>;
				vsync_polarity = <0x01>;
				de_hstart = <0x70>;
				de_vstart = <0x54>;
				resolution_width = <0xf00>;
				resolution_height = <0x870>;
				max_h_total = <0x1194>;
				typ_h_total = <0x1130>;
				min_h_total = <0x10cc>;
				max_v_total = <0xb40>;
				typ_v_total = <0xb09>;
				min_v_total = <0xac0>;
				max_v_total_panelprotect = <0x1c20>;
				min_v_total_panelprotect = <0x8c4>;
				typ_clk_high = <0x00>;
				typ_clk_low = <0x47200200>;
				output_format = <0x00>;
				content_output_format = <0x00>;
				vrr_en = <0x00>;
				min_vrr_framerate = <0x1e0>;
				max_vrr_framerate = <0x60e>;
				graphic_mixer1_outmode = <0x00>;
				graphic_mixer2_outmode = <0x01>;
			};

			panel_info_vby1_3840x2160_60 {
				panel_name = "4K60_PANEL_8LANE";
				link_type = <0x01>;
				vbo_byte_mode = <0x04>;
				div_section = <0x01>;
				on_timing1 = <0x1e>;
				on_timing2 = <0xc8>;
				off_timing1 = <0xdc>;
				off_timing2 = <0x0a>;
				hsync_start = <0x00>;
				hsync_width = <0x1e>;
				hsync_polarity = <0x01>;
				vsync_start = <0x00>;
				vsync_width = <0x02>;
				vsync_polarity = <0x01>;
				de_hstart = <0x70>;
				de_vstart = <0x54>;
				resolution_width = <0xf00>;
				resolution_height = <0x870>;
				max_h_total = <0x1194>;
				typ_h_total = <0x1130>;
				min_h_total = <0x10cc>;
				max_v_total = <0x900>;
				typ_v_total = <0x8d4>;
				min_v_total = <0x8c4>;
				max_v_total_panelprotect = <0x1c20>;
				min_v_total_panelprotect = <0x8c4>;
				typ_clk_high = <0x00>;
				typ_clk_low = <0x23900100>;
				output_format = <0x00>;
				content_output_format = <0x00>;
				vrr_en = <0x00>;
				min_vrr_framerate = <0x1e0>;
				max_vrr_framerate = <0x60e>;
				graphic_mixer1_outmode = <0x00>;
				graphic_mixer2_outmode = <0x01>;
			};

			panel_info_vby1_3840x2160_50 {
				panel_name = "4K50_PANEL_8LANE";
				link_type = <0x01>;
				vbo_byte_mode = <0x04>;
				div_section = <0x01>;
				on_timing1 = <0x1e>;
				on_timing2 = <0xc8>;
				off_timing1 = <0xdc>;
				off_timing2 = <0x0a>;
				hsync_start = <0x00>;
				hsync_width = <0x1e>;
				hsync_polarity = <0x01>;
				vsync_start = <0x00>;
				vsync_width = <0x02>;
				vsync_polarity = <0x01>;
				de_hstart = <0x70>;
				de_vstart = <0x54>;
				resolution_width = <0xf00>;
				resolution_height = <0x870>;
				max_h_total = <0x1194>;
				typ_h_total = <0x1130>;
				min_h_total = <0x10cc>;
				max_v_total = <0xad0>;
				typ_v_total = <0xa98>;
				min_v_total = <0xa50>;
				max_v_total_panelprotect = <0x1c20>;
				min_v_total_panelprotect = <0x8c4>;
				typ_clk_high = <0x00>;
				typ_clk_low = <0x23900100>;
				output_format = <0x00>;
				content_output_format = <0x00>;
				vrr_en = <0x00>;
				min_vrr_framerate = <0x1e0>;
				max_vrr_framerate = <0x60e>;
				graphic_mixer1_outmode = <0x00>;
				graphic_mixer2_outmode = <0x01>;
			};

			panel_info_vby1_3840x2160_48 {
				panel_name = "4K48_PANEL_8LANE";
				link_type = <0x01>;
				vbo_byte_mode = <0x04>;
				div_section = <0x01>;
				on_timing1 = <0x1e>;
				on_timing2 = <0xc8>;
				off_timing1 = <0xdc>;
				off_timing2 = <0x0a>;
				hsync_start = <0x00>;
				hsync_width = <0x1e>;
				hsync_polarity = <0x01>;
				vsync_start = <0x00>;
				vsync_width = <0x02>;
				vsync_polarity = <0x01>;
				de_hstart = <0x70>;
				de_vstart = <0x54>;
				resolution_width = <0xf00>;
				resolution_height = <0x870>;
				max_h_total = <0x1194>;
				typ_h_total = <0x1130>;
				min_h_total = <0x10cc>;
				max_v_total = <0xb40>;
				typ_v_total = <0xb09>;
				min_v_total = <0xac0>;
				max_v_total_panelprotect = <0x1c20>;
				min_v_total_panelprotect = <0x8c4>;
				typ_clk_high = <0x00>;
				typ_clk_low = <0x23900100>;
				output_format = <0x00>;
				content_output_format = <0x00>;
				vrr_en = <0x00>;
				min_vrr_framerate = <0x1e0>;
				max_vrr_framerate = <0x60e>;
				graphic_mixer1_outmode = <0x00>;
				graphic_mixer2_outmode = <0x01>;
			};

			panel_tgen_info {
				panel_tgen_max_vtotal = <0x1c43>;
				panel_tgen_min_vtotal = <0x8be>;
			};

			panel-color-info {
				COLOR_SPACE = <0x04>;
				COLOR_FORAMT = <0x00>;
				COLOR_RANGE = <0x03>;
				Rx = <0x7d00>;
				Rx_variation = <0x64>;
				Ry = <0x4047>;
				Ry_variation = <0x64>;
				Gx = <0x3a98>;
				Gx_variation = <0x64>;
				Gy = <0x7530>;
				Gy_variation = <0x64>;
				Bx = <0x1d4c>;
				Bx_variation = <0x64>;
				By = <0xbb8>;
				By_variation = <0x64>;
				Wx = <0x3d13>;
				Wx_variation = <0x64>;
				Wy = <0x4042>;
				Wy_variation = <0x64>;
				MaxLuminance = <0x64>;
				MedLuminance = <0x32>;
				MinLuminance = <0x1f4>;
				LinearRGB = <0x01>;
				HDRPanelNits = <0x18f>;
				DynamicLuminance = <0x00>;
			};

			usr_lane_order {
				usr_define = <0x00>;
				ctrl_lanes = <0x10>;
				laneorder = <0x00 0x01 0x02 0x03 0x04 0x05 0x06 0x07 0x08 0x09 0x0a 0x0b 0x0c 0x0d 0x0e 0x0f>;
			};

			panel-dither-info {
				dither_out_depth = <0x00>;
				dither_pattern_type = <0x00>;
				dither_capability = <0x00>;
			};

			ext_graph_combo_info {
				graph_vbo_byte_mode = <0x04>;
			};

			pmic_info {
				pmic_info_version = <0x01>;
				pmic_info_length = <0x00>;
				pmic_type = <0x01>;
				pmic_bin_file_path = "tcon/4k120/RT6863.bin";
				pmic_bin_format_type = <0x00>;
				pmic_force_init = <0x01>;
				pmic_with_nvm = <0x00>;
				pmic_i2c_bus = <0x02>;
				pmic_i2c_mode = <0x01>;
				pmic_i2c_dev_addr = <0x33>;
				pmic_i2c_reg_offst = <0x00>;
				pmic_pre_gpio_num = <0x00>;
				pmic_pre_gpio_ops = <0x00>;
				pmic_pre_delay = <0x00>;
				pmic_post_gpio_num = <0x00>;
				pmic_post_gpio_ops = <0x00>;
				pmic_post_delay = <0x00>;
				pmic_auto_from_flash = <0x00>;
			};

			pgamma_info {
				pgamma_info_version = <0x00>;
				pgamma_info_length = <0x00>;
				pgamma_type = <0x02>;
				pgamma_bin_file_path = "tcon/4k120/RT8949_A.bin";
				pgamma_bin_format_type = <0x00>;
				pgamma_force_init = <0x01>;
				pgamma_with_nvm = <0x00>;
				pgamma_i2c_bus = <0x02>;
				pgamma_i2c_mode = <0x01>;
				pgamma_i2c_dev_addr = <0x28>;
				pgamma_i2c_reg_offst = <0x00>;
				pgamma_pre_gpio_num = <0x00>;
				pgamma_pre_gpio_ops = <0x00>;
				pgamma_pre_delay = <0x00>;
				pgamma_post_gpio_num = <0x00>;
				pgamma_post_gpio_ops = <0x00>;
				pgamma_post_delay = <0x00>;
				pgamma_auto_from_flash = <0x00>;
			};

			levelshift_info {
				levelshift_info_version = <0x00>;
				levelshift_info_length = <0x00>;
				levelshift_type = <0x03>;
				levelshift_bin_file_path = "tcon/4k120/RT8949_B.bin";
				levelshift_bin_format_type = <0x00>;
				levelshift_force_init = <0x01>;
				levelshift_with_nvm = <0x00>;
				levelshift_i2c_bus = <0x02>;
				levelshift_i2c_mode = <0x01>;
				levelshift_i2c_dev_addr = <0x29>;
				levelshift_i2c_reg_offst = <0x00>;
				levelshift_pre_gpio_num = <0x00>;
				levelshift_pre_gpio_ops = <0x00>;
				levelshift_pre_delay = <0x00>;
				levelshift_post_gpio_num = <0x00>;
				levelshift_post_gpio_ops = <0x00>;
				levelshift_post_delay = <0x00>;
				levelshift_auto_from_flash = <0x00>;
			};

			vcomic_info {
				vcomic_info_version = <0x00>;
				vcomic_info_length = <0x00>;
				vcomic_type = <0x04>;
				vcomic_bin_file_path = [00];
				vcomic_bin_format_type = <0x00>;
				vcomic_force_init = <0x00>;
				vcomic_with_nvm = <0x00>;
				vcomic_i2c_bus = <0x00>;
				vcomic_i2c_mode = <0x00>;
				vcomic_i2c_dev_addr = <0x00>;
				vcomic_i2c_reg_offst = <0x00>;
				vcomic_pre_gpio_num = <0x00>;
				vcomic_pre_gpio_ops = <0x00>;
				vcomic_pre_delay = <0x00>;
				vcomic_post_gpio_num = <0x00>;
				vcomic_post_gpio_ops = <0x00>;
				vcomic_post_delay = <0x00>;
				vcomic_auto_from_flash = <0x00>;
			};

			tconless_model_info {
				higt_frame_rate_bin_path = "tcon/4k120/TCON20_HFR240.bin";
				higt_pixel_clock_bin_path = "tcon/4k120/TCON20_HPC144.bin";
				game_mode_bin_path = "tcon/4k120/TCON20_GAME.bin";
				higt_frame_rate_gamma_bin_path = "tcon/4k120/gamma_HFR240.bin";
				higt_pixel_clock_gamma_bin_path = "tcon/4k120/gamma_HPC144.bin";
				game_mode_gamma_bin_path = "tcon/4k120/gamma_GAME.bin";
				power_seq_on_bin_path = "tcon/4k120/TCON20_POST.bin";
				power_seq_off_bin_path = "tcon/4k120/TCON20_PRE.bin";
			};
		};
	};

	fragment@1 {
		target = <0xffffffff>;

		__overlay__ {
			PanelGamma_Enable = <0x01>;
			PanelGamme_BinPath = "tcon/4k120/gamma.bin";
			TCON_Enable = <0x01>;
			TCON_BinPath = "tcon/4k120/TCON20.bin";
			PanelMirrorMode = <0x00>;
			PanelOutputFormat = <0x00>;
			SSC_Enable = <0x00>;
			SSC_Step = <0x00>;
			SSC_Span = <0x00>;
			OverDrive_Enable = <0x01>;
			OverDrive_Buf_Addr = <0x00>;
			OverDrive_Buf_Size = <0x00>;
			GPIO_Backlight = <0x00>;
			GPIO_VCC = <0x00>;
			M_delta = <0x05>;
			CustomerColorPrimaries = <0x00>;
			SourceWx = <0x3d13>;
			SourceWy = <0x4042>;
			VIDEO_GFX_DISPLAY_MODE = <0x00>;
			OSD_Height = <0x870>;
			OSD_Width = <0xf00>;
			OSD_HsyncStart = <0x00>;
			OSD_HsyncEnd = <0x00>;
			OSD_HDEStart = <0x00>;
			OSD_HDEEnd = <0x00>;
			OSD_HTotal = <0x00>;
			OSD_VsyncStart = <0x00>;
			OSD_VsyncEnd = <0x00>;
			OSD_VDEStart = <0x00>;
			OSD_VDEEnd = <0x00>;
			OSD_VTotal = <0x00>;
			cus_x_dpi = <0x4d>;
			cus_y_dpi = <0x4d>;
			u32PeriodPWM = <0x5f5e10>;
			u32DutyPWM = <0x307258>;
			u32DivPWM = <0x00>;
			u32ShiftPWM = <0x00>;
			bPolPWM = <0x00>;
			u32MaxPWMvalue = <0x5f5e10>;
			u32MinPWMvalue = <0x186a0>;
			bBakclightFreq2Vfreq = <0x00>;
			u32PwmPeriodMulti = <0x01>;
			graphic_mixer1_outmode = <0x00>;
			graphic_mixer2_outmode = <0x01>;
			panel_frc_table_type = <0x03>;
		};
	};

	fragment@2 {
		target = <0xffffffff>;

		__overlay__ {
			status = "disable";
			panel_info_name_list = "panel_info\0timing_info_50\0timing_info_48";

			panel_info {
				panel_name = "SONY BE";
				link_type = <0x01>;
				vbo_byte_mode = <0x04>;
				div_section = <0x01>;
				on_timing1 = <0x1e>;
				on_timing2 = <0xc8>;
				off_timing1 = <0xdc>;
				off_timing2 = <0x0a>;
				hsync_start = <0x00>;
				hsync_width = <0x1e>;
				hsync_polarity = <0x01>;
				vsync_start = <0x00>;
				vsync_width = <0x02>;
				vsync_polarity = <0x01>;
				de_hstart = <0x70>;
				de_vstart = <0x54>;
				resolution_width = <0xf00>;
				resolution_height = <0x870>;
				max_h_total = <0x1194>;
				typ_h_total = <0x1130>;
				min_h_total = <0x10cc>;
				max_v_total = <0x92e>;
				typ_v_total = <0x8ca>;
				min_v_total = <0x8c4>;
				typ_clk_high = <0x00>;
				typ_clk_low = <0x2367b880>;
				output_format = <0x00>;
				content_output_format = <0x00>;
				graphic_mixer1_outmode = <0x00>;
				graphic_mixer2_outmode = <0x01>;
			};

			timing_info_50 {
				panel_name = "SONY BE 4k 50";
				link_type = <0x01>;
				vbo_byte_mode = <0x04>;
				div_section = <0x01>;
				on_timing1 = <0x1e>;
				on_timing2 = <0xc8>;
				off_timing1 = <0xdc>;
				off_timing2 = <0x0a>;
				hsync_start = <0x00>;
				hsync_width = <0x1e>;
				hsync_polarity = <0x01>;
				vsync_start = <0x00>;
				vsync_width = <0x02>;
				vsync_polarity = <0x01>;
				de_hstart = <0x70>;
				de_vstart = <0x54>;
				resolution_width = <0xf00>;
				resolution_height = <0x870>;
				max_h_total = <0x1194>;
				typ_h_total = <0x1130>;
				min_h_total = <0x10cc>;
				max_v_total = <0xaf0>;
				typ_v_total = <0xa8c>;
				min_v_total = <0xa28>;
				typ_clk_high = <0x00>;
				typ_clk_low = <0x2367b880>;
				output_format = <0x00>;
				content_output_format = <0x00>;
				graphic_mixer1_outmode = <0x00>;
				graphic_mixer2_outmode = <0x01>;
			};

			timing_info_48 {
				panel_name = "SONY BE 4k 48";
				link_type = <0x01>;
				vbo_byte_mode = <0x04>;
				div_section = <0x01>;
				on_timing1 = <0x1e>;
				on_timing2 = <0xc8>;
				off_timing1 = <0xdc>;
				off_timing2 = <0x0a>;
				hsync_start = <0x00>;
				hsync_width = <0x1e>;
				hsync_polarity = <0x01>;
				vsync_start = <0x00>;
				vsync_width = <0x02>;
				vsync_polarity = <0x01>;
				de_hstart = <0x70>;
				de_vstart = <0x54>;
				resolution_width = <0xf00>;
				resolution_height = <0x870>;
				max_h_total = <0x1194>;
				typ_h_total = <0x1130>;
				min_h_total = <0x10cc>;
				max_v_total = <0xb60>;
				typ_v_total = <0xafc>;
				min_v_total = <0xa98>;
				typ_clk_high = <0x00>;
				typ_clk_low = <0x2367b880>;
				output_format = <0x00>;
				content_output_format = <0x00>;
				graphic_mixer1_outmode = <0x00>;
				graphic_mixer2_outmode = <0x01>;
			};
		};
	};

	fragment@3 {
		target = <0xffffffff>;

		__overlay__ {
			status = "disable";
			panel_info_name_list = "panel_info";

			panel_info {
				panel_name = "GFX output";
				link_type = <0x01>;
				vbo_byte_mode = <0x05>;
				div_section = <0x01>;
				on_timing1 = <0x1e>;
				on_timing2 = <0xc8>;
				off_timing1 = <0xdc>;
				off_timing2 = <0x0a>;
				hsync_start = <0x00>;
				hsync_width = <0x1e>;
				hsync_polarity = <0x01>;
				vsync_start = <0x00>;
				vsync_width = <0x02>;
				vsync_polarity = <0x01>;
				de_hstart = <0x70>;
				de_vstart = <0x54>;
				resolution_width = <0xf00>;
				resolution_height = <0x870>;
				max_h_total = <0x1194>;
				typ_h_total = <0x1130>;
				min_h_total = <0x10cc>;
				max_v_total = <0x92e>;
				typ_v_total = <0x8d4>;
				min_v_total = <0x8c4>;
				typ_clk_high = <0x00>;
				typ_clk_low = <0x23900100>;
				output_format = <0x08>;
				content_output_format = <0x04>;
				graphic_mixer1_outmode = <0x00>;
				graphic_mixer2_outmode = <0x01>;
			};

			loadfw-timing-info {
				panel_name = "GFX output";
				hsync_start = <0x00>;
				hsync_width = <0x1e>;
				vsync_start = <0x00>;
				vsync_width = <0x02>;
				de_hstart = <0x70>;
				de_vstart = <0x54>;
				resolution_width = <0xf00>;
				resolution_height = <0x870>;
				max_h_total = <0x1194>;
				typ_h_total = <0x1130>;
				min_h_total = <0x10cc>;
				max_v_total = <0x92e>;
				typ_v_total = <0x8ca>;
				min_v_total = <0x8c4>;
				typ_clk_high = <0x00>;
				typ_clk_low = <0x2367b880>;
			};
		};
	};

	__fixups__ {
		video_out = "/fragment@0:target:0";
		panel_cus_setting = "/fragment@1:target:0";
		ext_video_out = "/fragment@2:target:0";
		graphic_out = "/fragment@3:target:0";
	};
};
