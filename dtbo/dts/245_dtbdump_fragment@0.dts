/dts-v1/;

/ {

	fragment@0 {
		target = <0xffffffff>;

		__overlay__ {

			ir {
				key = <0x01 0x00 0x00 0x02 0x7d 0x00 0x46 0x00 0x74 0x00 0x01 0x00 0x00 0x02 0x7d 0x00 0x5f 0x02 0xe8 0x00 0x01 0x00 0x00 0x02 0x7d 0x00 0x9f 0x00 0x66 0x00 0x01 0x00 0x00 0x02 0x7d 0x00 0x4a 0x00 0x1c 0x00 0x01 0x00 0x00 0x02 0x7d 0x00 0xa0 0x00 0xd9 0x00 0x01 0x00 0x00 0x02 0x7d 0x00 0xa1 0x02 0xe9 0x00 0x01 0x00 0x00 0x02 0x7d 0x00 0xa4 0x02 0xea 0x00 0x01 0x00 0x00 0x02 0x7d 0x00 0xa5 0x02 0xeb 0x00 0x01 0x00 0x00 0x02 0x7d 0x00 0xb5 0x02 0xa0 0x00 0x01 0x00 0x00 0x02 0x7d 0x00 0xb6 0x02 0xa1 0x00 0x00 0x00 0x00 0x00 0x00 0x00 0x00 0x00 0x00 0x00 0x00 0x00 0x00 0x00 0x00 0x00 0x00 0x00 0x00 0x00 0x00 0x00 0x00 0x00 0x00 0x00 0x00 0x00 0x00 0x00 0x00 0x00 0x00 0x00 0x00 0x00 0x00 0x00 0x00 0x00 0x00 0x00 0x00 0x00 0x00 0x00 0x00 0x00 0x00 0x00 0x00 0x00 0x00 0x00 0x00 0x00 0x00 0x00 0x00 0x00>;
				phandle = <0x01>;
			};

			sar {
				wakeup-ch = <0x00>;
				wakeup-lb = <0x05>;
				wake-adc = <0x05 0x3ff 0x3ff 0x3ff 0x3ff>;
				upgrade-ch = <0x00>;
				upgrade-lb = <0xff>;
				upgrade-adc = <0x05 0x3ff 0x3ff 0x3ff 0x3ff>;
				phandle = <0x02>;
			};
		};
	};

	__symbols__ {
		ir_wake = "/fragment@0/__overlay__/ir";
		ir_sar = "/fragment@0/__overlay__/sar";
	};

	__fixups__ {
		pmu_ini = "/fragment@0:target:0";
	};
};
