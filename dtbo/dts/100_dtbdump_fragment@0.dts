/dts-v1/;

/ {

	fragment@0 {
		target = <0xffffffff>;

		__overlay__ {
			pinctrl-names = "default";
			pinctrl-0 = <0xffffffff>;
		};
	};

	fragment@1 {
		target = <0xffffffff>;

		__overlay__ {
			interrupt-parent = <0xffffffff>;
			interrupts = <0x00 0x19 0x04>;
			spi-deticated = <0x01>;
		};
	};

	__fixups__ {
		mspi1 = "/fragment@0:target:0";
		mspi_serflash_pmux = "/fragment@0/__overlay__:pinctrl-0:0";
		mspi2 = "/fragment@1:target:0";
		mtk_intc1_irq_high = "/fragment@1/__overlay__:interrupt-parent:0";
	};
};
