/dts-v1/;

/ {

	fragment@0 {
		target = <0xffffffff>;

		__overlay__ {
			status = "disalbed";
		};
	};

	fragment@1 {
		target = <0xffffffff>;

		__overlay__ {
			status = "disalbed";
		};
	};

	fragment@2 {
		target = <0xffffffff>;

		__overlay__ {
			status = "okay";
		};
	};

	fragment@3 {
		target = <0xffffffff>;

		__overlay__ {
			status = "okay";
		};
	};

	fragment@4 {
		target = <0xffffffff>;

		__overlay__ {

			sar1-gpio-hog {
				gpio-hog;
				gpios = <0x35 0x00>;
				output-high;
				line-name = "gpio-sar1-gpio-out";
			};
		};
	};

	__fixups__ {
		pmu_rproc = "/fragment@0:target:0";
		pmu_rpmsg = "/fragment@1:target:0";
		pmu_mcs51_rproc = "/fragment@2:target:0";
		pmu_ini = "/fragment@3:target:0";
		pm_gpio0 = "/fragment@4:target:0";
	};
};
