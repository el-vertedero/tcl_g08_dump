/dts-v1/;

/ {

	fragment@0 {
		target = <0xffffffff>;

		__overlay__ {

			ir {
				key = <0x01 0x00 0x00 0x66 0x99 0x00 0xd5 0x00 0x74 0x00 0x01 0x00 0x00 0x66 0x99 0x00 0xf7 0x00 0x66 0x00 0x01 0x00 0x00 0x66 0x99 0x00 0x10 0x00 0x10 0x00 0x01 0x00 0x00 0x66 0x99 0x00 0xe9 0x01 0xfb 0x00 0x01 0x00 0x00 0x66 0x99 0x00 0xcf 0x00 0x0b 0x00 0x01 0x00 0x00 0x66 0x99 0x00 0xce 0x00 0x02 0x00 0x01 0x00 0x00 0x66 0x99 0x00 0xcd 0x00 0x03 0x00 0x01 0x00 0x00 0x66 0x99 0x00 0xcc 0x00 0x04 0x00 0x01 0x00 0x00 0x66 0x99 0x00 0xcb 0x00 0x05 0x00 0x01 0x00 0x00 0x66 0x99 0x00 0xca 0x00 0x06 0x00 0x01 0x00 0x00 0x66 0x99 0x00 0xc9 0x00 0x07 0x00 0x01 0x00 0x00 0x66 0x99 0x00 0xc8 0x00 0x08 0x00 0x01 0x00 0x00 0x66 0x99 0x00 0xc7 0x00 0x09 0x00 0x01 0x00 0x00 0x66 0x99 0x00 0xc6 0x00 0x0a 0x00 0x01 0x00 0x00 0x66 0x99 0x00 0x3d 0x02 0x00 0x00 0x00 0x00 0x00 0x00 0x00 0x00 0x00 0x00 0x00 0x00 0x00 0x00 0x00 0x00 0x00 0x00 0x00 0x00 0x00 0x00 0x00 0x00 0x00 0x00 0x00 0x00 0x00 0x00 0x00 0x00 0x00 0x00 0x00 0x00 0x00 0x00 0x00 0x00 0x00 0x00 0x00 0x00 0x00 0x00 0x00 0x00 0x00 0x00 0x00 0x00 0x00 0x00 0x00 0x00 0x00 0x00 0x00 0x00 0x00 0x00 0x00 0x00 0x00 0x00 0x00 0x00 0x00 0x00 0x00 0x00>;
				phandle = <0x01>;
			};

			sar {
				wakeup-ch = <0x00>;
				wakeup-lb = <0x05>;
				wake-adc = <0x05 0x3ff 0x3ff 0x3ff 0x3ff>;
				upgrade-ch = <0x00>;
				upgrade-lb = <0xff>;
				upgrade-adc = <0x05 0x3ff 0x3ff 0x3ff 0x3ff>;
				phandle = <0x02>;
			};
		};
	};

	__symbols__ {
		ir_wake = "/fragment@0/__overlay__/ir";
		ir_sar = "/fragment@0/__overlay__/sar";
	};

	__fixups__ {
		pmu_ini = "/fragment@0:target:0";
	};
};
