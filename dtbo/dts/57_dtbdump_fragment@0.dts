/dts-v1/;

/ {

	fragment@0 {
		target = <0xffffffff>;

		__overlay__ {
			panel_info_name_list = "panel_info\0panel_info_vby1_3840x2160_100\0panel_info_vby1_3840x2160_96";
			oled_err_det-gpios = <0xffffffff 0xc6 0x00>;
			oled_evdd_det-gpios = <0xffffffff 0xc5 0x00>;
			oled_onrf-gpios = <0xffffffff 0xc2 0x01>;
			oled_comp_done-gpios = <0xffffffff 0xc3 0x00>;
			oled_qsm_en-gpios = <0xffffffff 0xd7 0x00>;

			panel_info {
				panel_name = "4K120_PANEL_16LANE";
				link_type = <0x01>;
				vbo_byte_mode = <0x04>;
				div_section = <0x01>;
				on_timing1 = <0x1e>;
				on_timing2 = <0xc8>;
				off_timing1 = <0xdc>;
				off_timing2 = <0x0a>;
				hsync_start = <0x00>;
				hsync_width = <0x1e>;
				hsync_polarity = <0x01>;
				vsync_start = <0x00>;
				vsync_width = <0x02>;
				vsync_polarity = <0x01>;
				de_hstart = <0x70>;
				de_vstart = <0x54>;
				resolution_width = <0xf00>;
				resolution_height = <0x870>;
				max_h_total = <0x1194>;
				typ_h_total = <0x1130>;
				min_h_total = <0x10cc>;
				max_v_total = <0x900>;
				typ_v_total = <0x8d4>;
				min_v_total = <0x8c4>;
				max_v_total_panelprotect = <0xb54>;
				min_v_total_panelprotect = <0x898>;
				typ_clk_high = <0x00>;
				typ_clk_low = <0x47200200>;
				output_format = <0x00>;
				content_output_format = <0x00>;
				output_color_range = <0x01>;
				output_color_space = <0x00>;
				vrr_en = <0x00>;
				min_vrr_framerate = <0x1e>;
				max_vrr_framerate = <0x78>;
				graphic_mixer1_outmode = <0x00>;
				graphic_mixer2_outmode = <0x01>;
			};

			panel_info_vby1_3840x2160_100 {
				panel_name = "4K100_PANEL_16LANE";
				link_type = <0x01>;
				vbo_byte_mode = <0x04>;
				div_section = <0x01>;
				on_timing1 = <0x1e>;
				on_timing2 = <0xc8>;
				off_timing1 = <0xdc>;
				off_timing2 = <0x0a>;
				hsync_start = <0x00>;
				hsync_width = <0x1e>;
				hsync_polarity = <0x01>;
				vsync_start = <0x00>;
				vsync_width = <0x02>;
				vsync_polarity = <0x01>;
				de_hstart = <0x70>;
				de_vstart = <0x54>;
				resolution_width = <0xf00>;
				resolution_height = <0x870>;
				max_h_total = <0x1194>;
				typ_h_total = <0x1130>;
				min_h_total = <0x10cc>;
				max_v_total = <0xad0>;
				typ_v_total = <0xa98>;
				min_v_total = <0xa50>;
				max_v_total_panelprotect = <0xb54>;
				min_v_total_panelprotect = <0x898>;
				typ_clk_high = <0x00>;
				typ_clk_low = <0x47200200>;
				output_format = <0x00>;
				content_output_format = <0x00>;
				output_color_range = <0x01>;
				output_color_space = <0x00>;
				vrr_en = <0x00>;
				min_vrr_framerate = <0x1e>;
				max_vrr_framerate = <0x78>;
				graphic_mixer1_outmode = <0x00>;
				graphic_mixer2_outmode = <0x01>;
			};

			panel_info_vby1_3840x2160_96 {
				panel_name = "4K96_PANEL_16LANE";
				link_type = <0x01>;
				vbo_byte_mode = <0x04>;
				div_section = <0x01>;
				on_timing1 = <0x1e>;
				on_timing2 = <0xc8>;
				off_timing1 = <0xdc>;
				off_timing2 = <0x0a>;
				hsync_start = <0x00>;
				hsync_width = <0x1e>;
				hsync_polarity = <0x01>;
				vsync_start = <0x00>;
				vsync_width = <0x02>;
				vsync_polarity = <0x01>;
				de_hstart = <0x70>;
				de_vstart = <0x54>;
				resolution_width = <0xf00>;
				resolution_height = <0x870>;
				max_h_total = <0x1194>;
				typ_h_total = <0x1130>;
				min_h_total = <0x10cc>;
				max_v_total = <0xb40>;
				typ_v_total = <0xb09>;
				min_v_total = <0xac0>;
				max_v_total_panelprotect = <0xb54>;
				min_v_total_panelprotect = <0x898>;
				typ_clk_high = <0x00>;
				typ_clk_low = <0x47200200>;
				output_format = <0x00>;
				content_output_format = <0x00>;
				output_color_range = <0x01>;
				output_color_space = <0x00>;
				vrr_en = <0x00>;
				min_vrr_framerate = <0x1e>;
				max_vrr_framerate = <0x78>;
				graphic_mixer1_outmode = <0x00>;
				graphic_mixer2_outmode = <0x01>;
			};

			panel_tgen_info {
				panel_tgen_max_vtotal = <0xb54>;
				panel_tgen_min_vtotal = <0x8be>;
			};

			panel-color-info {
				COLOR_SPACE = <0x04>;
				COLOR_FORAMT = <0x00>;
				COLOR_RANGE = <0x03>;
				Rx = <0x7d00>;
				Rx_variation = <0x64>;
				Ry = <0x4047>;
				Ry_variation = <0x64>;
				Gx = <0x3a98>;
				Gx_variation = <0x64>;
				Gy = <0x7530>;
				Gy_variation = <0x64>;
				Bx = <0x1d4c>;
				Bx_variation = <0x64>;
				By = <0xbb8>;
				By_variation = <0x64>;
				Wx = <0x3d13>;
				Wx_variation = <0x64>;
				Wy = <0x4042>;
				Wy_variation = <0x64>;
				MaxLuminance = <0x64>;
				MedLuminance = <0x32>;
				MinLuminance = <0x1f4>;
				LinearRGB = <0x01>;
				HDRPanelNits = <0x18f>;
				DynamicLuminance = <0x00>;
			};

			usr_lane_order {
				usr_define = <0x00>;
				ctrl_lanes = <0x10>;
				laneorder = <0x00 0x01 0x02 0x03 0x04 0x05 0x06 0x07 0x08 0x09 0x0a 0x0b 0x0c 0x0d 0x0e 0x0f>;
			};

			panel-dither-info {
				dither_out_depth = <0x00>;
				dither_pattern_type = <0x00>;
				dither_capability = <0x00>;
			};

			ext_graph_combo_info {
				graph_vbo_byte_mode = <0x05>;
			};

			pmic_info {
				pmic_info_version = <0x01>;
				pmic_info_length = <0x00>;
				pmic_type = <0x00>;
				pmic_bin_file_path = "/bsp/common/TCON_BIN/RT6963.bin";
				pmic_bin_format_type = <0x00>;
				pmic_force_init = <0x01>;
				pmic_with_nvm = <0x00>;
				pmic_i2c_bus = <0x01>;
				pmic_i2c_mode = <0x00>;
				pmic_i2c_dev_addr = <0x33>;
				pmic_i2c_reg_offst = <0x00>;
				pmic_pre_gpio_num = <0x00>;
				pmic_pre_gpio_ops = <0x00>;
				pmic_pre_delay = <0x00>;
				pmic_post_gpio_num = <0x00>;
				pmic_post_gpio_ops = <0x00>;
				pmic_post_delay = <0x00>;
				pmic_auto_from_flash = <0x00>;
			};

			pgamma_info {
				pgamma_info_version = <0x00>;
				pgamma_info_length = <0x00>;
				pgamma_type = <0x01>;
				pgamma_bin_file_path = "/bsp/common/TCON_BIN/RT8949_A.bin";
				pgamma_bin_format_type = <0x00>;
				pgamma_force_init = <0x01>;
				pgamma_with_nvm = <0x00>;
				pgamma_i2c_bus = <0x01>;
				pgamma_i2c_mode = <0x00>;
				pgamma_i2c_dev_addr = <0x28>;
				pgamma_i2c_reg_offst = <0x00>;
				pgamma_pre_gpio_num = <0x00>;
				pgamma_pre_gpio_ops = <0x00>;
				pgamma_pre_delay = <0x00>;
				pgamma_post_gpio_num = <0x00>;
				pgamma_post_gpio_ops = <0x00>;
				pgamma_post_delay = <0x00>;
				pgamma_auto_from_flash = <0x00>;
			};

			levelshift_info {
				levelshift_info_version = <0x00>;
				levelshift_info_length = <0x00>;
				levelshift_type = <0x02>;
				levelshift_bin_file_path = "/bsp/common/TCON_BIN/RT8949_B.bin";
				levelshift_bin_format_type = <0x00>;
				levelshift_force_init = <0x01>;
				levelshift_with_nvm = <0x00>;
				levelshift_i2c_bus = <0x01>;
				levelshift_i2c_mode = <0x00>;
				levelshift_i2c_dev_addr = <0x29>;
				levelshift_i2c_reg_offst = <0x00>;
				levelshift_pre_gpio_num = <0x00>;
				levelshift_pre_gpio_ops = <0x00>;
				levelshift_pre_delay = <0x00>;
				levelshift_post_gpio_num = <0x00>;
				levelshift_post_gpio_ops = <0x00>;
				levelshift_post_delay = <0x00>;
				levelshift_auto_from_flash = <0x00>;
			};

			vcomic_info {
				vcomic_info_version = <0x00>;
				vcomic_info_length = <0x00>;
				vcomic_type = <0x03>;
				vcomic_bin_file_path = [00];
				vcomic_bin_format_type = <0x00>;
				vcomic_force_init = <0x00>;
				vcomic_with_nvm = <0x00>;
				vcomic_i2c_bus = <0x00>;
				vcomic_i2c_mode = <0x00>;
				vcomic_i2c_dev_addr = <0x00>;
				vcomic_i2c_reg_offst = <0x00>;
				vcomic_pre_gpio_num = <0x00>;
				vcomic_pre_gpio_ops = <0x00>;
				vcomic_pre_delay = <0x00>;
				vcomic_post_gpio_num = <0x00>;
				vcomic_post_gpio_ops = <0x00>;
				vcomic_post_delay = <0x00>;
				vcomic_auto_from_flash = <0x00>;
			};

			oled_info {
				OLED_Support = <0x01>;
				OLED_PixelShift = <0x01>;
				oled_ip_bypass_cust = <0x00>;
				oled_qsm_cust = <0x00>;
				slave_addr = <0xf0>;
				channel_id = <0x02>;
				i2c_mode = <0x01>;
				reg_offset = <0x00>;
				lumin_gain_addr = <0x16>;
				temp_addr = <0x5e>;
				offrs_addr = <0x01>;
				offrs_mask = <0x10>;
				jb_addr = <0x5d>;
				jb_mask = <0x80>;
				hdr_addr = <0x0b>;
				hdr_mask = <0x08>;
				lea_addr = <0x0b>;
				lea_mask = <0x10>;
				tpc_addr = <0x01>;
				tpc_mask = <0x40>;
				cpc_addr = <0x01>;
				cpc_mask = <0x80>;
				opt_p0_addr = <0x03>;
				opt_start_addr = <0x01>;
				opt_start_mask = <0x3ff>;
				onrf_op = <0xa8c>;
				onrf_delay = <0xc8>;
				offrs_op = <0x140>;
				jb_op = <0x78>;
				jb_on_off = <0x0a>;
				jb_temp_max = <0x28>;
				jb_temp_min = <0x0a>;
				jb_cooldown = <0xe10>;
				qsm_on = <0xbb8>;
				qsm_evdd_off = <0x4b>;
				qsm_off = <0x3de>;
				qsm_evdd_on = <0x0a>;
				mon_delay = <0xc8>;
			};
		};
	};

	fragment@1 {
		target = <0xffffffff>;

		__overlay__ {
			PanelGamma_Enable = <0x00>;
			PanelGamme_BinPath = [00];
			TCON_Enable = <0x01>;
			TCON_BinPath = "tcon/TCON20.bin";
			PanelMirrorMode = <0x00>;
			PanelOutputFormat = <0x00>;
			SSC_Enable = <0x00>;
			SSC_Step = <0x00>;
			SSC_Span = <0x00>;
			OverDrive_Enable = <0x00>;
			OverDrive_Buf_Addr = <0x00>;
			OverDrive_Buf_Size = <0x00>;
			GPIO_Backlight = <0x00>;
			GPIO_VCC = <0x00>;
			M_delta = <0x05>;
			CustomerColorPrimaries = <0x00>;
			SourceWx = <0x3d13>;
			SourceWy = <0x4042>;
			VIDEO_GFX_DISPLAY_MODE = <0x00>;
			OSD_Height = <0x870>;
			OSD_Width = <0xf00>;
			OSD_HsyncStart = <0x00>;
			OSD_HsyncEnd = <0x00>;
			OSD_HDEStart = <0x00>;
			OSD_HDEEnd = <0x00>;
			OSD_HTotal = <0x00>;
			OSD_VsyncStart = <0x00>;
			OSD_VsyncEnd = <0x00>;
			OSD_VDEStart = <0x00>;
			OSD_VDEEnd = <0x00>;
			OSD_VTotal = <0x00>;
			cus_x_dpi = <0x28>;
			cus_y_dpi = <0x28>;
			u32PeriodPWM = <0x5f5e10>;
			u32DutyPWM = <0x307258>;
			u32DivPWM = <0x00>;
			u32ShiftPWM = <0x00>;
			bPolPWM = <0x00>;
			u32MaxPWMvalue = <0x5f5e10>;
			u32MinPWMvalue = <0x186a0>;
			bBakclightFreq2Vfreq = <0x00>;
			u32PwmPeriodMulti = <0x01>;
			graphic_mixer1_outmode = <0x00>;
			graphic_mixer2_outmode = <0x01>;
			panel_frc_table_type = <0x01>;
			RENDER_IN_COLOR_FORMAT = <0x01>;
			RENDER_IN_COLOR_RANGE = <0x01>;
			RENDER_IN_COLOR_SPACE = <0x00>;
		};
	};

	fragment@2 {
		target = <0xffffffff>;

		__overlay__ {
			status = "disable";
			panel_info_name_list = "panel_info\0timing_info_50\0timing_info_48";

			panel_info {
				panel_name = "SONY BE";
				link_type = <0x01>;
				vbo_byte_mode = <0x04>;
				div_section = <0x01>;
				on_timing1 = <0x1e>;
				on_timing2 = <0xc8>;
				off_timing1 = <0xdc>;
				off_timing2 = <0x0a>;
				hsync_start = <0x00>;
				hsync_width = <0x1e>;
				hsync_polarity = <0x01>;
				vsync_start = <0x00>;
				vsync_width = <0x02>;
				vsync_polarity = <0x01>;
				de_hstart = <0x70>;
				de_vstart = <0x54>;
				resolution_width = <0xf00>;
				resolution_height = <0x870>;
				max_h_total = <0x1194>;
				typ_h_total = <0x1130>;
				min_h_total = <0x10cc>;
				max_v_total = <0x92e>;
				typ_v_total = <0x8ca>;
				min_v_total = <0x8c4>;
				typ_clk_high = <0x00>;
				typ_clk_low = <0x2367b880>;
				output_format = <0x00>;
				content_output_format = <0x00>;
				output_color_range = <0x01>;
				output_color_space = <0x00>;
				graphic_mixer1_outmode = <0x00>;
				graphic_mixer2_outmode = <0x01>;
			};

			timing_info_50 {
				panel_name = "SONY BE 4k 50";
				link_type = <0x01>;
				vbo_byte_mode = <0x04>;
				div_section = <0x01>;
				on_timing1 = <0x1e>;
				on_timing2 = <0xc8>;
				off_timing1 = <0xdc>;
				off_timing2 = <0x0a>;
				hsync_start = <0x00>;
				hsync_width = <0x1e>;
				hsync_polarity = <0x01>;
				vsync_start = <0x00>;
				vsync_width = <0x02>;
				vsync_polarity = <0x01>;
				de_hstart = <0x70>;
				de_vstart = <0x54>;
				resolution_width = <0xf00>;
				resolution_height = <0x870>;
				max_h_total = <0x1194>;
				typ_h_total = <0x1130>;
				min_h_total = <0x10cc>;
				max_v_total = <0xaf0>;
				typ_v_total = <0xa8c>;
				min_v_total = <0xa28>;
				typ_clk_high = <0x00>;
				typ_clk_low = <0x2367b880>;
				output_format = <0x00>;
				content_output_format = <0x00>;
				output_color_range = <0x01>;
				output_color_space = <0x00>;
				graphic_mixer1_outmode = <0x00>;
				graphic_mixer2_outmode = <0x01>;
			};

			timing_info_48 {
				panel_name = "SONY BE 4k 48";
				link_type = <0x01>;
				vbo_byte_mode = <0x04>;
				div_section = <0x01>;
				on_timing1 = <0x1e>;
				on_timing2 = <0xc8>;
				off_timing1 = <0xdc>;
				off_timing2 = <0x0a>;
				hsync_start = <0x00>;
				hsync_width = <0x1e>;
				hsync_polarity = <0x01>;
				vsync_start = <0x00>;
				vsync_width = <0x02>;
				vsync_polarity = <0x01>;
				de_hstart = <0x70>;
				de_vstart = <0x54>;
				resolution_width = <0xf00>;
				resolution_height = <0x870>;
				max_h_total = <0x1194>;
				typ_h_total = <0x1130>;
				min_h_total = <0x10cc>;
				max_v_total = <0xb60>;
				typ_v_total = <0xafc>;
				min_v_total = <0xa98>;
				typ_clk_high = <0x00>;
				typ_clk_low = <0x2367b880>;
				output_format = <0x00>;
				content_output_format = <0x00>;
				output_color_range = <0x01>;
				output_color_space = <0x00>;
				graphic_mixer1_outmode = <0x00>;
				graphic_mixer2_outmode = <0x01>;
			};
		};
	};

	fragment@3 {
		target = <0xffffffff>;

		__overlay__ {
			status = "disable";
			panel_info_name_list = "panel_info";

			panel_info {
				panel_name = "GFX output";
				link_type = <0x01>;
				vbo_byte_mode = <0x05>;
				div_section = <0x01>;
				on_timing1 = <0x1e>;
				on_timing2 = <0xc8>;
				off_timing1 = <0xdc>;
				off_timing2 = <0x0a>;
				hsync_start = <0x00>;
				hsync_width = <0x1e>;
				hsync_polarity = <0x01>;
				vsync_start = <0x00>;
				vsync_width = <0x02>;
				vsync_polarity = <0x01>;
				de_hstart = <0x70>;
				de_vstart = <0x54>;
				resolution_width = <0xf00>;
				resolution_height = <0x870>;
				max_h_total = <0x1194>;
				typ_h_total = <0x1130>;
				min_h_total = <0x10cc>;
				max_v_total = <0x92e>;
				typ_v_total = <0x8d4>;
				min_v_total = <0x8c4>;
				typ_clk_high = <0x00>;
				typ_clk_low = <0x23900100>;
				output_format = <0x08>;
				content_output_format = <0x04>;
				output_color_range = <0x01>;
				output_color_space = <0x00>;
				graphic_mixer1_outmode = <0x00>;
				graphic_mixer2_outmode = <0x01>;
			};

			loadfw-timing-info {
				panel_name = "GFX output";
				hsync_start = <0x00>;
				hsync_width = <0x1e>;
				vsync_start = <0x00>;
				vsync_width = <0x02>;
				de_hstart = <0x70>;
				de_vstart = <0x54>;
				resolution_width = <0xf00>;
				resolution_height = <0x870>;
				max_h_total = <0x1194>;
				typ_h_total = <0x1130>;
				min_h_total = <0x10cc>;
				max_v_total = <0x92e>;
				typ_v_total = <0x8ca>;
				min_v_total = <0x8c4>;
				typ_clk_high = <0x00>;
				typ_clk_low = <0x2367b880>;
			};
		};
	};

	__fixups__ {
		video_out = "/fragment@0:target:0";
		gpio0 = "/fragment@0/__overlay__:oled_err_det-gpios:0\0/fragment@0/__overlay__:oled_evdd_det-gpios:0\0/fragment@0/__overlay__:oled_onrf-gpios:0\0/fragment@0/__overlay__:oled_comp_done-gpios:0\0/fragment@0/__overlay__:oled_qsm_en-gpios:0";
		panel_cus_setting = "/fragment@1:target:0";
		ext_video_out = "/fragment@2:target:0";
		graphic_out = "/fragment@3:target:0";
	};
};
