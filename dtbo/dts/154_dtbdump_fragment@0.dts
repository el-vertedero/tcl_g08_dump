/dts-v1/;

/ {

	fragment@0 {
		target = <0xffffffff>;

		__overlay__ {
			audio-codec = <0xffffffff>;
			codec-dai-name = "AMP_TAS5805";
		};
	};

	fragment@1 {
		target = <0xffffffff>;

		__overlay__ {
			codec-dai-name = "AMP_TAS5805";
			amp-model-cnt = "1";
			amp-1-name = "tas5805";
		};
	};

	fragment@2 {
		target = <0xffffffff>;

		__overlay__ {
			audio-codec = <0xffffffff>;
		};
	};

	fragment@3 {
		target = <0xffffffff>;

		__overlay__ {
			compatible = "ti, tas5805";
			mtk_ini = "../tvconfig/bsp/chip/mt5873/amp/audio_amp_device_tas5805.ini";
			reg = <0x2d>;
			status = "okay";
			type = <0x00>;
			amppowerdown-gpios = <0xffffffff 0x1e 0x01>;
		};
	};

	fragment@4 {
		target = <0xffffffff>;

		__overlay__ {

			mtk-amp9120 {
				status = "disabled";
			};
		};
	};

	__fixups__ {
		mtk_sound_machine = "/fragment@0:target:0";
		cus_i2c0_amp0 = "/fragment@0/__overlay__:audio-codec:0\0/fragment@2/__overlay__:audio-codec:0\0/fragment@3:target:0";
		mtk_tv_machine = "/fragment@1:target:0";
		mtk_sound_soc = "/fragment@2:target:0";
		pm_gpio0 = "/fragment@3/__overlay__:amppowerdown-gpios:0";
		i2c0 = "/fragment@4:target:0";
	};
};
