/dts-v1/;

/ {

	fragment@0 {
		target = <0xffffffff>;

		__overlay__ {
			LDM_SUPPORT = <0x05>;
			LDM_DMA_SPI_LTP_TEST = <0x00>;

			ldm-panel-info {
				LEDType = <0x03>;
				LDFWidth = <0x0c>;
				LDFHeight = <0x0a>;
				LEDWidth = <0x0c>;
				LEDHeight = <0x0a>;
				LSFWidth = <0x80>;
				LSFHeight = <0x48>;
				Edge2D_Local_h = <0x05>;
				Edge2D_Local_v = <0x05>;
				PanelHz = <0x3c>;
				MirrorPanel = <0x00>;
				Support_DV_GD = <0x01>;
			};

			ldm-misc-info {
				LDEn = <0x01>;
				Compensation_En = <0x01>;
				LD_cus_alg_mode = <0x00>;
				OLEDEn = <0x00>;
				OLED_LSP_En = <0x00>;
				OLED_GSP_En = <0x00>;
				OLED_HBP_En = <0x00>;
				OLED_CRP_En = <0x00>;
				OLED_LSPHDR_En = <0x00>;
				OLED_Report_En = <0x00>;
				OLED_LGE_GSR_En = <0x00>;
				OLED_LGE_GSR_HBP_En = <0x00>;
			};

			ldm-mspi-info {
				MspiClk = <0x2dc6c0>;
				TrStart = <0x04>;
				TrEnd = <0x00>;
				TB = <0x00>;
				BClkPolarity = <0x01>;
				BClkPhase = <0x00>;
			};

			ldm-dma-info {
				DataInvert = <0x01>;
				Closed_12bit_duty_mode = <0x01>;
				VsyncWidth = <0x1138 0x00 0x1d04 0x00>;
				Same_tri_for_Vsync_and_DMA = <0x00>;
				First_trig = <0xa0>;
				PWM0_Period = <0xffff 0xff>;
				PWM0_Duty = <0x10 0x00>;
				PWM0_Shift = <0x01 0x00>;
				PWM1_Period = <0xffff 0xff>;
				PWM1_Duty = <0x10 0x00>;
				PWM1_Shift = <0x01 0x00>;
			};

			ldm-boosting-info {
				MaxPowerRatio = <0x64>;
				OpenAreaDuty_100 = <0x64 0x2d 0x2c 0x29 0x27 0x24 0x21 0x1f 0x1c 0x1a 0x17 0x00 0x00 0x00 0x00 0x00 0x00 0x00 0x00 0x00>;
				OpenAreaDuty_AnchorPoints = <0x64 0x2d 0x2c 0x29 0x27 0x24 0x21 0x1f 0x1c 0x1a 0x17 0x00 0x00 0x00 0x00 0x00 0x00 0x00 0x00 0x00>;
				DecayWei = <0x00 0x00 0x00 0x00 0xff 0x00 0x00 0x00 0x00 0x00 0x00 0x00 0x00 0x00 0x00 0x01 0x01 0x01 0x01 0x01 0x01 0x01 0x01 0x01 0x01 0x02 0x02 0x02 0x02 0x02 0x02 0x02 0x03 0x03 0x03 0x03 0x03 0x04 0x04 0x04 0x04 0x05 0x05 0x05 0x05 0x06 0x06 0x06 0x06 0x07 0x07 0x07 0x08 0x08 0x08 0x09 0x09 0x09 0x0a 0x0a 0x0b 0x0b 0x0b 0x0c 0x0c 0x0d 0x0d 0x0e 0x0e 0x0e 0x0f 0x0f 0x10 0x10 0x11 0x11 0x12 0x12 0x13 0x13 0x14 0x15 0x15 0x16 0x16 0x17 0x17 0x18 0x19 0x19 0x1a 0x1b 0x1b 0x1c 0x1c 0x1d 0x1e 0x1f 0x1f 0x20 0x21 0x21 0x22 0x23 0x24 0x24 0x25 0x26 0x27 0x27 0x28 0x29 0x2a 0x2b 0x2c 0x2c 0x2d 0x2e 0x2f 0x30 0x31 0x32 0x33 0x33 0x34 0x35 0x36 0x37 0x38 0x39 0x3a 0x3b 0x3c 0x3d 0x3e 0x3f 0x40 0x41 0x42 0x43 0x44 0x46 0x47 0x48 0x49 0x4a 0x4b 0x4c 0x4d 0x4e 0x50 0x51 0x52 0x53 0x54 0x56 0x57 0x58 0x59 0x5b 0x5c 0x5d 0x5e 0x60 0x61 0x62 0x64 0x65 0x66 0x68 0x69 0x6a 0x6c 0x6d 0x6e 0x70 0x71 0x73 0x74 0x76 0x77 0x78 0x7a 0x7b 0x7d 0x7e 0x80 0x81 0x83 0x84 0x86 0x88 0x89 0x8b 0x8c 0x8e 0x8f 0x91 0x93 0x94 0x96 0x98 0x99 0x9b 0x9d 0x9e 0xa0 0xa2 0xa4 0xa5 0xa7 0xa9 0xab 0xac 0xae 0xb0 0xb2 0xb3 0xb5 0xb7 0xb9 0xbb 0xbd 0xbf 0xc0 0xc2 0xc4 0xc6 0xc8 0xca 0xcc 0xce 0xd0 0xd2 0xd4 0xd6 0xd8 0xda 0xdc 0xde 0xe0 0xe2 0xe4 0xe6 0xe8 0xea 0xed 0xef 0xf1 0xf3 0xf5 0xf7 0xf9 0xfc 0xfe 0x100>;
				OpenAreaCurrentAnchorPoints = <0x64 0x19 0x0a 0x00 0x00 0x00 0x00 0x00 0x00 0x00 0x00 0x00 0x00 0x00 0x00 0x00 0x00 0x00 0x00 0x00>;
				OpenAreaCurrent = <0x2a 0x63 0xd7 0x00 0x00 0x00 0x00 0x00 0x00 0x00 0x00 0x00 0x00 0x00 0x00 0x00 0x00 0x00 0x00 0x00>;
				Cus_tf_dynamic_en = <0x00>;
				Cus_tf_strength_up_fast = <0xdc>;
				Cus_tf_strength_dn_fast = <0xdc>;
				Cus_tf_strength_up_black = <0xdc>;
				Cus_tf_strength_dn_black = <0xdc>;
				Cus_tf_up_diff_low_th = <0x50>;
				Cus_tf_up_diff_high_th = <0x78>;
				Cus_tf_dn_diff_low_th = <0x50>;
				Cus_tf_dn_diff_high_th = <0x78>;
				Cus_tf_black_th = <0x03>;
			};

			ldm-led-device-info {
				LedDevice_Type = <0x07>;
				SPIbits = <0x0c>;
				DutyHeader = <0x55 0xaa 0x40 0xb4 0x00 0x00 0x00 0x00 0x00 0x00 0x00 0x00 0x00 0x00 0x00 0x00>;
				CurrentHeader = <0xbf 0x10 0x70 0x00 0x00 0x00 0x00 0x00 0x00 0x00 0x00 0x00 0x00 0x00 0x00 0x00>;
				SpiChannelNum = <0x01>;
				DutyHeaderByte = <0x04>;
				DutyPerDataByte = <0x01>;
				DutyCheckSumByte = <0x00>;
				CurrentHeaderByte = <0x00>;
				CurrentPerDataByte = <0x00>;
				CurrentCheckSumByte = <0x00>;
				SPIChannelList = <0x01 0x01 0x01 0x01 0x01 0x01 0x01 0x01 0x01 0x01 0x01 0x01 0x01 0x01 0x01 0x01 0x01 0x01 0x01 0x01 0x01 0x01 0x01 0x01 0x01 0x01 0x01 0x01 0x01 0x01 0x01 0x01 0x01 0x01 0x01 0x01 0x01 0x01 0x01 0x01 0x01 0x01 0x01 0x01 0x01 0x01 0x01 0x01 0x01 0x01 0x01 0x01 0x01 0x01 0x01 0x01 0x01 0x01 0x01 0x01 0x01 0x01 0x01 0x01 0x01 0x01 0x01 0x01 0x01 0x01 0x01 0x01 0x01 0x01 0x01 0x01 0x01 0x01 0x01 0x01 0x01 0x01 0x01 0x01 0x01 0x01 0x01 0x01 0x01 0x01 0x01 0x01 0x01 0x01 0x01 0x01 0x01 0x01 0x01 0x01 0x01 0x01 0x01 0x01 0x01 0x01 0x01 0x01 0x01 0x01 0x01 0x01 0x01 0x01 0x01 0x01 0x01 0x01 0x01 0x01 0x01 0x01 0x01 0x01 0x01 0x01 0x01 0x01 0x01 0x01 0x01 0x01 0x01 0x01 0x01 0x01 0x01 0x01 0x01 0x01 0x01 0x01 0x01 0x01 0x01 0x01 0x01 0x01 0x01 0x01 0x01 0x01 0x01 0x01 0x01 0x01 0x01 0x01 0x01 0x01 0x01 0x01 0x01 0x01 0x01 0x01 0x01 0x01 0x01 0x01 0x01 0x01 0x01 0x01 0x01 0x01 0x01 0x01 0x01 0x01>;
				Device_Num = <0x01 0x00 0x00 0x00 0x00 0x00 0x00 0x00>;
				DutyDramFormat = <0x20 0x06 0xbe 0x00 0x00 0x00 0x00 0x00 0x00 0x00 0x00 0x00 0x00 0x00 0x00 0x00 0x00 0x00 0x00 0x00 0x00 0x00 0x00 0x00>;
				CurrentDramFormat = <0x20 0x01 0x06 0x00 0x00 0x00 0x00 0x00 0x00 0x00 0x00 0x00 0x00 0x00 0x00 0x00 0x00 0x00 0x00 0x00 0x00 0x00 0x00 0x00>;
				Mapping_Table_Header_Duty = <0x00 0x01 0x02 0x03 0x00 0x00 0x00 0x00 0x00 0x00 0x00 0x00 0x00 0x00 0x00 0x00 0x00 0x00 0x00 0x00 0x00 0x00 0x00 0x00 0x00 0x00 0x00 0x00 0x00 0x00 0x00 0x00>;
				Mapping_Table_Duty = <0x04 0x05 0x06 0x07 0x08 0x09 0x0a 0x0b 0x0c 0x0d 0x0e 0x0f 0x10 0x11 0x12 0x13 0x14 0x15 0x16 0x17 0x18 0x19 0x1a 0x1b 0x1c 0x1d 0x1e 0x1f 0x20 0x21 0x22 0x23 0x24 0x25 0x26 0x27 0x28 0x29 0x2a 0x2b 0x2c 0x2d 0x2e 0x2f 0x30 0x31 0x32 0x33 0x34 0x35 0x36 0x37 0x38 0x39 0x3a 0x3b 0x3c 0x3d 0x3e 0x3f 0x40 0x41 0x42 0x43 0x44 0x45 0x46 0x47 0x48 0x49 0x4a 0x4b 0x4c 0x4d 0x4e 0x4f 0x50 0x51 0x52 0x53 0x54 0x55 0x56 0x57 0x58 0x59 0x5a 0x5b 0x5c 0x5d 0x5e 0x5f 0x60 0x61 0x62 0x63 0x64 0x65 0x66 0x67 0x68 0x69 0x6a 0x6b 0x6c 0x6d 0x6e 0x6f 0x70 0x71 0x72 0x73 0x74 0x75 0x76 0x77 0x78 0x79 0x7a 0x7b 0x7c 0x7d 0x7e 0x7f 0x80 0x81 0x82 0x83 0x84 0x85 0x86 0x87 0x88 0x89 0x8a 0x8b 0x8c 0x8d 0x8e 0x8f 0x90 0x91 0x92 0x93 0x94 0x95 0x96 0x97 0x98 0x99 0x9a 0x9b 0x9c 0x9d 0x9e 0x9f 0xa0 0xa1 0xa2 0xa3 0xa4 0xa5 0xa6 0xa7 0xa8 0xa9 0xaa 0xab 0xac 0xad 0xae 0xaf 0xb0 0xb1 0xb2 0xb3 0xb4 0xb5 0xb6 0xb7>;
				Mapping_Table_CheckSum_Duty;
				Mapping_Table_ExtendData_Duty = <0xb8 0xb9 0xba 0xbb 0xbc 0xbd 0x00 0x00 0x00 0x00 0x00 0x00 0x00>;
				Mapping_Table_Header_Current;
				Mapping_Table_Current;
				Mapping_Table_CheckSum_Current;
				Mapping_Table_ExtendData_Current = <0xc0 0xc1 0xc2 0xc3 0xc4 0xc5 0x00 0x00 0x00 0x00 0x00 0x00 0x00>;
				ExtendDataByte = <0x06 0x00 0x00 0x00 0x00 0x00 0x00 0x00>;
			};

			ldm-led-device-as3824-info {
				Rsense = <0x360>;
				AS3824_Reg_0x01_to_0x0B = <0xff 0xff 0x8f 0x00 0x00 0x00 0x86 0x00 0x00 0x00 0x00>;
				AS3824_Reg_0x0E_to_0x15 = <0xff 0xff 0x00 0x00 0x05 0xc2 0xff 0x0f>;
				AS3824_Reg_0x67 = <0x10>;
				AS3824_PWM_Duty_Init = <0x7ff>;
				AS3824_PWM_Phase_MBR_OFF = <0x00 0x00 0x00 0x00 0x00 0x00 0x00 0x00 0x100 0x100 0x100 0x100 0x100 0x100 0x100 0x100 0x200 0x200 0x200 0x200 0x200 0x200 0x200 0x200 0x300 0x300 0x300 0x300 0x300 0x300 0x300 0x300 0x400 0x400 0x400 0x400 0x400 0x400 0x400 0x400 0x500 0x500 0x500 0x500 0x500 0x500 0x500 0x500 0x600 0x600 0x600 0x600 0x600 0x600 0x600 0x600 0x700 0x700 0x700 0x700 0x700 0x700 0x700 0x700 0x800 0x800 0x800 0x800 0x800 0x800 0x800 0x800 0x900 0x900 0x900 0x900 0x900 0x900 0x900 0x900 0xa00 0xa00 0xa00 0xa00 0xa00 0xa00 0xa00 0xa00 0xb00 0xb00 0xb00 0xb00 0xb00 0xb00 0xb00 0xb00 0xc00 0xc00 0xc00 0xc00 0xc00 0xc00 0xc00 0xc00 0xd00 0xd00 0xd00 0xd00 0xd00 0xd00 0xd00 0xd00 0xe00 0xe00 0xe00 0xe00 0xe00 0xe00 0xe00 0xe00 0xf00 0xf00 0xf00 0xf00 0xf00 0xf00 0xf00 0xf00>;
				AS3824_PWM_Phase_MBR_ON = <0x100 0x100 0x100 0x100 0x100 0x100 0x100 0x100 0x200 0x200 0x200 0x200 0x200 0x200 0x200 0x200 0x300 0x300 0x300 0x300 0x300 0x300 0x300 0x300 0x400 0x400 0x400 0x400 0x400 0x400 0x400 0x400 0x500 0x500 0x500 0x500 0x500 0x500 0x500 0x500 0x600 0x600 0x600 0x600 0x600 0x600 0x600 0x600 0x700 0x700 0x700 0x700 0x700 0x700 0x700 0x700 0x800 0x800 0x800 0x800 0x800 0x800 0x800 0x800 0x900 0x900 0x900 0x900 0x900 0x900 0x900 0x900 0xa00 0xa00 0xa00 0xa00 0xa00 0xa00 0xa00 0xa00 0xb00 0xb00 0xb00 0xb00 0xb00 0xb00 0xb00 0xb00 0xc00 0xc00 0xc00 0xc00 0xc00 0xc00 0xc00 0xc00 0xd00 0xd00 0xd00 0xd00 0xd00 0xd00 0xd00 0xd00 0xe00 0xe00 0xe00 0xe00 0xe00 0xe00 0xe00 0xe00 0xf00 0xf00 0xf00 0xf00 0xf00 0xf00 0xf00 0xf00 0x00 0x00 0x00 0x00 0x00 0x00 0x00 0x00>;
				AS3824_Reg_0x0C_0x0D_VDAC_MBR_OFF = <0x10 0x00>;
				AS3824_Reg_0x0C_0x0D_VDAC_MBR_ON = <0x20 0x00>;
				AS3824_Reg_0x61_0x62_PLL_multi = <0x3f 0xfc>;
				AS3824_BDAC_High_Limit = <0xa0>;
				AS3824_BDAC_Low_Limit = <0x80>;
			};

			ldm-led-device-nt50585-info {
				NT50585_Reg_0x01_to_0x0B = <0xff 0xff 0xff 0xff 0xbf 0x13 0x00 0x00 0x00 0x00 0x00>;
				NT50585_Reg_0x1D_to_0x1F = <0xc2 0xff 0x0f>;
				NT50585_Reg_0x60 = <0xca>;
				NT50585_Reg_0x68 = <0x0e>;
				NT50585_PWM_Duty_Init = <0x7ff>;
				NT50585_PWM_Phase_MBR_OFF = <0x00 0x00 0x00 0x00 0x00 0x00 0x00 0x00 0x100 0x100 0x100 0x100 0x100 0x100 0x100 0x100 0x200 0x200 0x200 0x200 0x200 0x200 0x200 0x200 0x300 0x300 0x300 0x300 0x300 0x300 0x300 0x300 0x400 0x400 0x400 0x400 0x400 0x400 0x400 0x400 0x500 0x500 0x500 0x500 0x500 0x500 0x500 0x500 0x600 0x600 0x600 0x600 0x600 0x600 0x600 0x600 0x700 0x700 0x700 0x700 0x700 0x700 0x700 0x700 0x800 0x800 0x800 0x800 0x800 0x800 0x800 0x800 0x900 0x900 0x900 0x900 0x900 0x900 0x900 0x900 0xa00 0xa00 0xa00 0xa00 0xa00 0xa00 0xa00 0xa00 0xb00 0xb00 0xb00 0xb00 0xb00 0xb00 0xb00 0xb00 0xc00 0xc00 0xc00 0xc00 0xc00 0xc00 0xc00 0xc00 0xd00 0xd00 0xd00 0xd00 0xd00 0xd00 0xd00 0xd00 0xe00 0xe00 0xe00 0xe00 0xe00 0xe00 0xe00 0xe00 0xf00 0xf00 0xf00 0xf00 0xf00 0xf00 0xf00 0xf00>;
				NT50585_PWM_Phase_MBR_ON = <0x100 0x100 0x100 0x100 0x100 0x100 0x100 0x100 0x200 0x200 0x200 0x200 0x200 0x200 0x200 0x200 0x300 0x300 0x300 0x300 0x300 0x300 0x300 0x300 0x400 0x400 0x400 0x400 0x400 0x400 0x400 0x400 0x500 0x500 0x500 0x500 0x500 0x500 0x500 0x500 0x600 0x600 0x600 0x600 0x600 0x600 0x600 0x600 0x700 0x700 0x700 0x700 0x700 0x700 0x700 0x700 0x800 0x800 0x800 0x800 0x800 0x800 0x800 0x800 0x900 0x900 0x900 0x900 0x900 0x900 0x900 0x900 0xa00 0xa00 0xa00 0xa00 0xa00 0xa00 0xa00 0xa00 0xb00 0xb00 0xb00 0xb00 0xb00 0xb00 0xb00 0xb00 0xc00 0xc00 0xc00 0xc00 0xc00 0xc00 0xc00 0xc00 0xd00 0xd00 0xd00 0xd00 0xd00 0xd00 0xd00 0xd00 0xe00 0xe00 0xe00 0xe00 0xe00 0xe00 0xe00 0xe00 0xf00 0xf00 0xf00 0xf00 0xf00 0xf00 0xf00 0xf00 0x00 0x00 0x00 0x00 0x00 0x00 0x00 0x00>;
				NT50585_Reg_0x14_0x15_IDAC_MBR_OFF = <0x28 0x02>;
				NT50585_Reg_0x14_0x15_IDAC_MBR_ON = <0x66 0x02>;
				NT50585_Reg_0x66_0x67_PLL_multi = <0x7f 0xf8>;
				NT50585_BDAC_High_Limit = <0xa0>;
				NT50585_BDAC_Low_Limit = <0x80>;
			};

			ldm-led-device-IW7039-info {
				IW7039_Reg_0x000_to_0x01F = <0x802 0x8145 0x00 0xfff 0x1fff 0x4127 0x4585 0x60d9 0x4d 0x2100 0x00 0x90c 0xcdc4 0x840 0x8a88 0xcc86 0xffff 0xffff 0x01 0x80 0x118 0x00 0x00 0x00 0x00 0x00 0x00 0x1ff 0x6fff 0x1ff 0xffff 0xffff>;
				IW7039_PWM_Duty_Init = <0x333>;
				IW7039_ISET_MBR_OFF = <0x145>;
				IW7039_ISET_MBR_ON = <0x145>;
				IW7039_PWM_Phase_MBR_OFF = <0x00 0x00 0x00 0x00 0x00 0x00 0x00 0x00 0x100 0x100 0x100 0x100 0x100 0x100 0x100 0x100 0x200 0x200 0x200 0x200 0x200 0x200 0x200 0x200 0x300 0x300 0x300 0x300 0x300 0x300 0x300 0x300 0x400 0x400 0x400 0x400 0x400 0x400 0x400 0x400 0x500 0x500 0x500 0x500 0x500 0x500 0x500 0x500 0x600 0x600 0x600 0x600 0x600 0x600 0x600 0x600 0x700 0x700 0x700 0x700 0x700 0x700 0x700 0x700 0x800 0x800 0x800 0x800 0x800 0x800 0x800 0x800 0x900 0x900 0x900 0x900 0x900 0x900 0x900 0x900 0xa00 0xa00 0xa00 0xa00 0xa00 0xa00 0xa00 0xa00 0xb00 0xb00 0xb00 0xb00 0xb00 0xb00 0xb00 0xb00 0xc00 0xc00 0xc00 0xc00 0xc00 0xc00 0xc00 0xc00 0xd00 0xd00 0xd00 0xd00 0xd00 0xd00 0xd00 0xd00 0xe00 0xe00 0xe00 0xe00 0xe00 0xe00 0xe00 0xe00 0xf00 0xf00 0xf00 0xf00 0xf00 0xf00 0xf00 0xf00>;
				IW7039_PWM_Phase_MBR_ON = <0x100 0x100 0x100 0x100 0x100 0x100 0x100 0x100 0x200 0x200 0x200 0x200 0x200 0x200 0x200 0x200 0x300 0x300 0x300 0x300 0x300 0x300 0x300 0x300 0x400 0x400 0x400 0x400 0x400 0x400 0x400 0x400 0x500 0x500 0x500 0x500 0x500 0x500 0x500 0x500 0x600 0x600 0x600 0x600 0x600 0x600 0x600 0x600 0x700 0x700 0x700 0x700 0x700 0x700 0x700 0x700 0x800 0x800 0x800 0x800 0x800 0x800 0x800 0x800 0x900 0x900 0x900 0x900 0x900 0x900 0x900 0x900 0xa00 0xa00 0xa00 0xa00 0xa00 0xa00 0xa00 0xa00 0xb00 0xb00 0xb00 0xb00 0xb00 0xb00 0xb00 0xb00 0xc00 0xc00 0xc00 0xc00 0xc00 0xc00 0xc00 0xc00 0xd00 0xd00 0xd00 0xd00 0xd00 0xd00 0xd00 0xd00 0xe00 0xe00 0xe00 0xe00 0xe00 0xe00 0xe00 0xe00 0xf00 0xf00 0xf00 0xf00 0xf00 0xf00 0xf00 0xf00 0x00 0x00 0x00 0x00 0x00 0x00 0x00 0x00>;
				IW7039_ISET_High_Limit = <0x145>;
				IW7039_ISET_Low_Limit = <0x145>;
			};

			ldm-led-device-MBI6353-info {
				MBI6353_MASK = <0x00 0x00 0x00 0x00 0x00 0x00>;
				MBI6353_CFG = <0x0c 0x6f 0x08 0x14 0x00 0x19 0x53 0x53 0x97 0x28 0xe2 0xbc 0x24 0x40 0x00 0x00 0xfc 0x20 0x01 0xc0 0x1e 0x80 0x3f 0xa7 0x12 0x00 0x00 0xa8 0x00 0x00 0x00 0x3f>;
				MBI6353_CFG_1 = <0x0c 0x6f 0x08 0x14 0x00 0x19 0x53 0x53 0x09 0x28 0xe2 0xbc 0x24 0x40 0x00 0x00 0x9c 0x20 0x81 0xc0 0x1e 0x80 0x3f 0xa7 0x12 0x00 0x00 0xa8 0x00 0x00 0x00 0x3f>;
				MBI6353_PWM_Duty_Init = <0xff>;
			};
		};
	};

	__fixups__ {
		mediatek_ldm = "/fragment@0:target:0";
	};
};
