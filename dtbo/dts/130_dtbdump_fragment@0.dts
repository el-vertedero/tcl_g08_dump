/dts-v1/;

/ {
	target-path = "/";

	fragment@0 {
		target = <0xffffffff>;

		__overlay__ {
		};
	};

	fragment@1 {
		target = <0xffffffff>;

		__overlay__ {
			reg = <0x00 0x1c086400 0x00 0x200 0x00 0x1c020200 0x00 0x200 0x00 0x1c021000 0x00 0x200 0x00 0x1c021200 0x00 0x200 0x00 0x1c620080 0x00 0x02 0x00 0x1c620880 0x00 0x02 0x00 0x1d206000 0x00 0x200 0x00 0x1d2a0800 0x00 0x200 0x00 0x00 0x00 0x200 0x00 0x1d2a0400 0x00 0x200 0x00 0x1c606000 0x00 0x200 0x00 0x1c001800 0x00 0x200 0x00 0x1c001a00 0x00 0x200 0x00 0x1c086000 0x00 0x200 0x00 0x1c086200 0x00 0x200 0x00 0x1c087200 0x00 0x200 0x00 0x1d280000 0x00 0x200 0x00 0x1c025200 0x00 0x200>;
		};
	};

	fragment@2 {
		target = <0xffffffff>;

		__overlay__ {
		};
	};

	fragment@3 {
		target = <0xffffffff>;

		__overlay__ {
			pinctrl-names = "fun_gpio\0fun_vsync_like";
			pinctrl-0 = <0xffffffff>;
			pinctrl-1 = <0xffffffff>;
		};
	};

	fragment@4 {
		target = <0xffffffff>;

		__overlay__ {
			LDM_SUPPORT = <0x00>;
			LDM_CUS_IP_PATH_uBoot = <0x01>;
			LDM_MMAP_ADDR = <0x00>;
			MX_LDM_VERSION = <0x06>;
			MX_RENDER_QMAP_VERSION = <0x01>;
			LED_MSPI_EN = <0x00>;
			LDM_DMA_SPI_LTP_TEST = <0x00>;
			gpios = <0xffffffff 0x09 0x00>;
		};
	};

	fragment@5 {
		target = <0xffffffff>;

		__overlay__ {
			pinctrl-names = "default";
			pinctrl-0 = <0xffffffff 0xffffffff 0xffffffff 0xffffffff 0xffffffff>;
		};
	};

	fragment@6 {
		target = <0xffffffff>;

		__overlay__ {
			pinctrl-names = "default";
			pinctrl-0 = <0xffffffff 0xffffffff 0xffffffff 0xffffffff 0xffffffff>;
		};
	};

	fragment@7 {
		target = <0xffffffff>;

		__overlay__ {
			pre_init_name = "audio_pre_init_mt5873.ini";
			init_name = "audio_init_mt5873.ini";
			speaker_out = <0x00>;
			module-clocks = <0x1c204f38 0x04 0x04 0x1c2070e0 0x1000 0x1000 0x1c2071b8 0x4000 0x4000 0x1c204fc8 0x0c 0x04 0x1c204cf0 0x0c 0x08 0x1c204d68 0x1c 0x14 0x1c204f58 0x0c 0x04 0x1c204f60 0x0c 0x04 0x1c204f50 0x0c 0x04 0x1c204e00 0x1c 0x08 0x1c204f70 0x0c 0x04 0x1c204f68 0x1c 0x10 0x1c204e18 0x04 0x04 0x1c204e08 0x04 0x04 0x1c204e10 0x04 0x04 0x1c204cc8 0x0c 0x04 0x1c204d60 0x0c 0x04 0x1c204cc0 0x0c 0x04 0x1c204c90 0x1c 0x04 0x1c204cb8 0x1c 0x10 0x1c204f48 0x04 0x04 0x1c204d58 0x0c 0x04 0x1c205138 0x01 0x00 0x1c205198 0x01 0x00 0x1c205198 0x07 0x00 0x1c205198 0x07 0x00 0x1c205198 0x18 0x00 0x1c20520c 0x04 0x04 0x1c20519c 0x01 0x00 0x1c20519c 0x07 0x00 0x1c20519c 0x07 0x00 0x1c20519c 0x18 0x00 0x1c205210 0x04 0x04 0x1c2051a0 0x01 0x00 0x1c2051a0 0x07 0x00 0x1c2051a0 0x07 0x00 0x1c2051a0 0x18 0x00 0x1c205214 0x04 0x04 0x1c2051a4 0x01 0x00 0x1c2051a4 0x07 0x00 0x1c2051a4 0x07 0x00 0x1c2051a4 0x18 0x00 0x1c205218 0x04 0x04 0x1c2051a8 0x01 0x00 0x1c2051a8 0x07 0x00 0x1c2051a8 0x07 0x00 0x1c2051a8 0x18 0x00 0x1c20521c 0x04 0x04 0x1c205060 0x01 0x00 0x1c205060 0x07 0x00 0x1c205060 0x07 0x00 0x1c205060 0x18 0x00 0x1c204d38 0x04 0x04 0x1c205068 0x01 0x00 0x1c205068 0x07 0x00 0x1c205068 0x07 0x00 0x1c205068 0x18 0x00 0x1c204d40 0x04 0x04 0x1c205070 0x01 0x00 0x1c205070 0x07 0x00 0x1c205070 0x07 0x00 0x1c205070 0x18 0x00 0x1c204d48 0x04 0x04 0x1c205078 0x01 0x00 0x1c205078 0x07 0x00 0x1c205078 0x07 0x00 0x1c205078 0x18 0x00 0x1c204d50 0x04 0x04 0x1c204d70 0x0c 0x04 0x1c205080 0x07 0x00 0x1c205080 0x07 0x00 0x1c2051e0 0x07 0x00 0x1c2051e0 0x07 0x00 0x1c2051e4 0x07 0x00 0x1c2051e4 0x07 0x00 0x1c2050c0 0x07 0x00 0x1c2050c0 0x07 0x00 0x1c2050c0 0x08 0x00 0x1c204d78 0x04 0x04 0x1c2050c0 0x07 0x00 0x1c2050c0 0x07 0x00 0x1c2050c0 0x08 0x00 0x1c204d80 0x0c 0x04 0x1c205090 0x07 0x00 0x1c205090 0x07 0x00 0x1c2051e8 0x07 0x00 0x1c2051e8 0x07 0x00 0x1c2051ec 0x07 0x00 0x1c2051ec 0x07 0x00 0x1c2050c8 0x07 0x00 0x1c2050c8 0x07 0x00 0x1c2050c8 0x08 0x00 0x1c204d88 0x04 0x04 0x1c2050c8 0x07 0x00 0x1c2050c8 0x07 0x00 0x1c2050c8 0x08 0x00 0x1c204d90 0x0c 0x04 0x1c2050a0 0x07 0x00 0x1c2050a0 0x07 0x00 0x1c2051f0 0x07 0x00 0x1c2051f0 0x07 0x00 0x1c2051f4 0x07 0x00 0x1c2051f4 0x07 0x00 0x1c2050d0 0x07 0x00 0x1c2050d0 0x07 0x00 0x1c2050d0 0x08 0x00 0x1c204d98 0x04 0x04 0x1c2050d0 0x07 0x00 0x1c2050d0 0x07 0x00 0x1c2050d0 0x08 0x00 0x1c204da0 0x0c 0x04 0x1c2050b0 0x07 0x00 0x1c2050b0 0x07 0x00 0x1c2051f8 0x07 0x00 0x1c2051f8 0x07 0x00 0x1c2051fc 0x07 0x00 0x1c2051fc 0x07 0x00 0x1c2050d8 0x07 0x00 0x1c2050d8 0x07 0x00 0x1c2050d8 0x08 0x00 0x1c204da8 0x04 0x04 0x1c2050d8 0x07 0x00 0x1c2050d8 0x07 0x00 0x1c2050d8 0x08 0x00 0x1c204db0 0x04 0x04 0x1c204db8 0x04 0x04 0x1c204cd8 0x1c 0x04 0x1c205020 0x01 0x00 0x1c204cd0 0x04 0x04 0x1c204ce8 0x1c 0x04 0x1c204ce0 0x04 0x04 0x1c204f88 0x04 0x04 0x1c204f90 0x04 0x04 0x1c204f98 0x0c 0x04 0x1c204e60 0x04 0x04 0x1c2050f8 0x01 0x00 0x1c204e58 0x04 0x04 0x1c2050f8 0x01 0x00 0x1c204e50 0x04 0x04 0x1c204e48 0x04 0x04 0x1c204e90 0x04 0x04 0x1c204ea8 0x1c 0x0c 0x1c205118 0x01 0x00 0x1c205118 0x01 0x00 0x1c205118 0x01 0x00 0x1c205118 0x01 0x00 0x1c205128 0x01 0x00 0x1c205128 0x01 0x00 0x1c205128 0x01 0x00 0x1c205128 0x01 0x00 0x1c204ec0 0x04 0x04 0x1c204ea0 0x04 0x04 0x1c204ee0 0x1c 0x10 0x1c205130 0x01 0x00 0x1c204e98 0x0c 0x04 0x1c205130 0x01 0x00 0x1c205130 0x01 0x00 0x1c205130 0x01 0x00 0x1c205030 0x07 0x04 0x1c204ca8 0x04 0x04 0x1c204eb8 0x1c 0x04 0x1c204eb0 0x0c 0x04 0x1c204f20 0x04 0x04 0x1c204f28 0x04 0x04 0x1c205178 0x03 0x00 0x1c205180 0x07 0x00 0x1c204fb8 0x04 0x04 0x1c205178 0x03 0x00 0x1c205180 0x07 0x00 0x1c204fb0 0x04 0x04 0x1c204fc0 0x04 0x04 0x1c205168 0x03 0x00 0x1c205170 0x07 0x00 0x1c204fa8 0x04 0x04 0x1c205168 0x03 0x00 0x1c205170 0x07 0x00 0x1c204fa0 0x04 0x04 0x1c204f18 0x0c 0x04 0x1c204ee8 0x0c 0x04 0x1c204ef0 0x0c 0x04 0x1c204f00 0x0c 0x04 0x1c204ef8 0x04 0x04 0x1c204f10 0x0c 0x04 0x1c204f08 0x04 0x04 0x1c205110 0x01 0x00 0x1c205108 0x01 0x00 0x1c205100 0x01 0x00 0x1c204e78 0x04 0x04 0x1c204e70 0x04 0x04 0x1c205150 0x07 0x00 0x1c205148 0x07 0x00 0x1c205160 0x01 0x00 0x1c205158 0x01 0x00 0x1c204f80 0x04 0x04 0x1c204df8 0x0c 0x08 0x1c204dd8 0x04 0x04 0x1c204df0 0x04 0x04 0x1c2050e0 0x03 0x00 0x1c204cb4 0x07 0x00 0x1c204cb0 0x04 0x04 0x1c204de0 0x04 0x04 0x1c204dd0 0x04 0x04 0x1c204dc0 0x04 0x04 0x1c204dc8 0x04 0x04 0x1c2050e8 0x07 0x00 0x1c204de8 0x04 0x04 0x1c204f78 0x04 0x04 0x1c204fd8 0x04 0x04 0x1c205264 0x0c 0x04 0x1c204c94 0x04 0x04 0x1c20502c 0x1c 0x04 0x1c205034 0x1c 0x04 0x1c204f30 0x04 0x04 0x1c205140 0x07 0x03 0x1c204cac 0x04 0x04 0x1c205d58 0x01 0x01 0x1c207b44 0x02 0x02 0x1c207b3c 0x01 0x01 0x1c207b40 0x01 0x01 0x1c207b3c 0x04 0x04 0x1c207b40 0x04 0x04 0x1c207b48 0x01 0x01 0x1c205d80 0x01 0x01 0x1c205d80 0x02 0x02 0x1c205d80 0x04 0x04 0x1c205d80 0x08 0x08 0x1c2054fc 0x01 0x01 0x1c2054fc 0x02 0x02 0x1c2054fc 0x08 0x08 0x1c205d88 0x02 0x02 0x1c205d88 0x04 0x04 0x1c2075c4 0x01 0x01 0x1c2075c8 0x01 0x01 0x1c2075b8 0x01 0x01 0x1c2075bc 0x01 0x01 0x1c2075b0 0x01 0x01 0x1c205b90 0x01 0x01 0x1c207b4c 0x10 0x10 0x1c207ad0 0x01 0x01 0x1c207ad0 0x02 0x02 0x1c205b98 0x01 0x01 0x1c207b84 0x40 0x40 0x1c207b84 0x20 0x20 0x1c205b80 0x01 0x01 0x1c205ba4 0x01 0x01 0x1c205b78 0x01 0x01 0x1c205ba0 0x01 0x01 0x1c205ba8 0x01 0x01 0x1c205bac 0x01 0x01 0x1c205bb0 0x01 0x01 0x1c205bb4 0x01 0x01 0x1c205bb8 0x01 0x01 0x1c205bbc 0x01 0x01 0x1c205bc0 0x01 0x01 0x1c205bc4 0x01 0x01 0x1c205be8 0x01 0x01 0x1c205bec 0x01 0x01 0x1c205bf0 0x01 0x01 0x1c205bf4 0x01 0x01 0x1c205e04 0x01 0x01 0x1c205e08 0x01 0x01 0x1c205e0c 0x01 0x01 0x1c205e10 0x01 0x01 0x1c205e14 0x01 0x01 0x1c205bf8 0x01 0x01 0x1c205bfc 0x01 0x01 0x1c205c00 0x01 0x01 0x1c205c04 0x01 0x01 0x1c205c08 0x01 0x01 0x1c205c0c 0x01 0x01 0x1c205c10 0x01 0x01 0x1c205c14 0x01 0x01 0x1c205c18 0x01 0x01 0x1c205c1c 0x01 0x01 0x1c205c20 0x01 0x01 0x1c205c24 0x01 0x01 0x1c205c28 0x01 0x01 0x1c205c2c 0x01 0x01 0x1c205c30 0x01 0x01 0x1c205c34 0x01 0x01 0x1c205c38 0x01 0x01 0x1c205c3c 0x01 0x01 0x1c205c40 0x01 0x01 0x1c205c44 0x01 0x01 0x1c205c48 0x01 0x01 0x1c205c4c 0x01 0x01 0x1c205c50 0x01 0x01 0x1c205c54 0x01 0x01 0x1c205c58 0x01 0x01 0x1c205c5c 0x01 0x01 0x1c205c60 0x01 0x01 0x1c205c64 0x01 0x01 0x1c205c68 0x01 0x01 0x1c205c6c 0x01 0x01 0x1c205c70 0x01 0x01 0x1c205c74 0x01 0x01 0x1c205c78 0x01 0x01 0x1c205c7c 0x01 0x01 0x1c205c80 0x01 0x01 0x1c205c98 0x01 0x01 0x1c205c9c 0x01 0x01 0x1c205ca8 0x01 0x01 0x1c205cac 0x01 0x01 0x1c205cb0 0x01 0x01 0x1c205cb4 0x01 0x01 0x1c205cb8 0x01 0x01 0x1c205cbc 0x01 0x01 0x1c205cc0 0x01 0x01 0x1c205cd0 0x01 0x01 0x1c205cd4 0x01 0x01 0x1c205cd8 0x01 0x01 0x1c205cdc 0x01 0x01 0x1c205ce0 0x01 0x01 0x1c205ce4 0x01 0x01 0x1c205ccc 0x01 0x01 0x1c205ce8 0x01 0x01 0x1c205cec 0x01 0x01 0x1c205cf0 0x01 0x01 0x1c205cf4 0x01 0x01 0x1c207fc4 0x02 0x02 0x1c205e58 0x01 0x01 0x1c205e5c 0x01 0x01 0x1c205e60 0x01 0x01 0x1c205e64 0x01 0x01 0x1c205d10 0x01 0x01 0x1c205d14 0x01 0x01 0x1c205d18 0x01 0x01 0x1c205d1c 0x01 0x01 0x1c205e54 0x01 0x01 0x1c205e68 0x01 0x01 0x1c205d20 0x01 0x01 0x1c205d24 0x01 0x01 0x1c205d28 0x01 0x01 0x1c205d2c 0x01 0x01 0x1c205d30 0x01 0x01 0x1c205d34 0x01 0x01 0x1c2054f0 0x80 0x80 0x1c205d38 0x01 0x01 0x1c205d3c 0x01 0x01 0x1c205d40 0x01 0x01 0x1c205d50 0x01 0x01 0x1c205d54 0x01 0x01 0x1c205d44 0x01 0x01 0x1c205d48 0x01 0x01 0x1c205d4c 0x01 0x01 0x1c205e98 0x01 0x01 0x1c205d60 0x01 0x01 0x1c205d68 0x01 0x01 0x1c205d6c 0x01 0x01 0x1c207d84 0x04 0x04>;
		};
	};

	fragment@8 {
		target = <0xffffffff>;

		__overlay__ {
		};
	};

	fragment@9 {
		target = <0xffffffff>;

		__overlay__ {
		};
	};

	fragment@10 {
		target = <0xffffffff>;

		__overlay__ {

			usb-phy@1C780000 {
				mediatek,eye-ls-sr = <0x02>;
				mediatek,eye-pre-em = <0x02>;
				mediatek,eye-clkref-rev1 = <0x04>;
				mediatek,usb20-sqth = <0x08>;
			};

			usb-phy@1C781000 {
				mediatek,eye-ls-sr = <0x02>;
				mediatek,eye-pre-em = <0x02>;
				mediatek,eye-clkref-rev1 = <0x04>;
				mediatek,usb20-sqth = <0x08>;
			};

			usb-phy@1C780700 {
			};
		};
	};

	fragment@11 {
		target = <0xffffffff>;

		__overlay__ {

			usb-phy@1C1A0000 {
				mediatek,eye-ls-sr = <0x02>;
				mediatek,eye-pre-em = <0x02>;
				mediatek,eye-clkref-rev1 = <0x04>;
				mediatek,usb20-sqth = <0x08>;
			};
		};
	};

	fragment@12 {
		target = <0xffffffff>;

		__overlay__ {
			vbus-gpios = <0xffffffff 0x42 0x00 0xffffffff 0x1e 0x00>;
			u3-comp-dix = <0x0f 0x00>;
		};
	};

	fragment@13 {
		target = <0xffffffff>;

		__overlay__ {
			vbus-gpios = <0xffffffff 0x1f 0x00>;
			u3-comp-dix = <0x0f>;
		};
	};

	fragment@14 {
		target = <0xffffffff>;

		__overlay__ {
			u3_port_shift = <0x01>;
			resume-disable-port = <0x01>;
		};
	};

	fragment@15 {
		target = <0xffffffff>;

		__overlay__ {
			support-dma;
			pinctrl-names = "default";
			pinctrl-0 = <0xffffffff>;
			clock-frequency = <0x186a0>;
			scl-stretch;
			bus-number = <0x00>;
		};
	};

	fragment@16 {
		target = <0xffffffff>;

		__overlay__ {
			support-dma;
			pinctrl-names = "default";
			pinctrl-0 = <0xffffffff>;
			clock-frequency = <0x186a0>;
			scl-stretch;
			bus-number = <0x01>;
		};
	};

	fragment@17 {
		target = <0xffffffff>;

		__overlay__ {
			support-dma;
			clock-frequency = <0x186a0>;
			scl-stretch;
			bus-number = <0x02>;
		};
	};

	fragment@18 {
		target = <0xffffffff>;

		__overlay__ {
			support-dma;
			pinctrl-names = "default";
			pinctrl-0 = <0xffffffff>;
			clock-frequency = <0x186a0>;
			scl-stretch;
			bus-number = <0x03>;
		};
	};

	fragment@19 {
		target = <0xffffffff>;

		__overlay__ {
			status = "disabled";
		};
	};

	fragment@20 {
		target = <0xffffffff>;

		__overlay__ {
			pinctrl-names = "default";
			pinctrl-0 = <0xffffffff>;
			clock-frequency = <0x186a0>;
			scl-stretch;
			bus-number = <0x04>;
		};
	};

	fragment@21 {
		target = <0xffffffff>;

		__overlay__ {
			status = "disabled";
		};
	};

	fragment@22 {
		target = <0xffffffff>;

		__overlay__ {
		};
	};

	fragment@23 {
		target = <0xffffffff>;

		__overlay__ {
		};
	};

	fragment@24 {
		target = <0xffffffff>;

		__overlay__ {
			pinctrl-names = "default";
			pinctrl-0 = <0xffffffff>;
		};
	};

	fragment@25 {
		target = <0xffffffff>;

		__overlay__ {
		};
	};

	fragment@26 {
		target = <0xffffffff>;

		__overlay__ {
		};
	};

	fragment@27 {
		target = <0xffffffff>;

		__overlay__ {
			reg = <0x00 0x1c061000 0x00 0x80>;
		};
	};

	fragment@28 {
		target = <0xffffffff>;

		__overlay__ {
			status = "okay";
			reg = <0x00 0x1c061080 0x00 0x80>;
		};
	};

	fragment@29 {
		target = <0xffffffff>;

		__overlay__ {
			reg = <0x00 0x1c647100 0x00 0x80>;
			high-speed-uart;
			uart-synth-reg = <0x1c600e00>;
			uart-synth-clk-index = <0x01>;
		};
	};

	fragment@30 {
		target = <0xffffffff>;

		__overlay__ {
			reg = <0x00 0x1c646100 0x00 0x80>;
		};
	};

	fragment@31 {
		target = <0xffffffff>;

		__overlay__ {
			status = "disabled";
		};
	};

	fragment@32 {
		target = <0xffffffff>;

		__overlay__ {
			status = "disabled";
		};
	};

	fragment@33 {
		target = <0xffffffff>;

		__overlay__ {
		};
	};

	fragment@34 {
		target = <0xffffffff>;

		__overlay__ {
		};
	};

	fragment@35 {
		target = <0xffffffff>;

		__overlay__ {
		};
	};

	fragment@36 {
		target = <0xffffffff>;

		__overlay__ {
		};
	};

	fragment@37 {
		target = <0xffffffff>;

		__overlay__ {
			tgen_version = <0x02>;
			lpll_version = <0x02>;
			mod_version = <0x02>;
			rcon_enable = <0x01>;
			rcon_max = <0x18>;
			rcon_min = <0x08>;
			rcon_value = <0x0f>;
			biascon_single_max = <0x46>;
			biascon_single_min = <0x1e>;
			biascon_single_value = <0x30>;
			biascon_double_max = <0x46>;
			biascon_double_min = <0x1e>;
			biascon_double_value = <0x30>;
			rint_enable = <0x00>;
			rint_max = <0x00>;
			rint_min = <0x00>;
			rint_value = <0x00>;
			pnl_lib_version = <0x06>;
		};
	};

	fragment@38 {
		target = <0xffffffff>;

		__overlay__ {
			u16PWMPort = <0x00>;
		};
	};

	fragment@39 {
		target = <0xffffffff>;

		__overlay__ {
		};
	};

	fragment@40 {
		target = <0xffffffff>;

		__overlay__ {

			ld_vsync-hog {
				gpio-hog;
				gpios = <0x09 0x00>;
				output-low;
				line-name = "ld-vsync-gpio";
			};
		};
	};

	fragment@41 {
		target = <0xffffffff>;

		__overlay__ {

			led0 {
				label = "mtk-tv:red:standby";
				gpios = <0xffffffff 0x1d 0x00>;
				color = <0x01>;
				default-state = "on";
				status = "disabled";
			};

			led1 {
				label = "mtk-tv:green:on";
				gpios = <0xffffffff 0x1e 0x01>;
				color = <0x02>;
				default-state = "on";
				status = "disabled";
			};
		};
	};

	fragment@42 {
		target = <0xffffffff>;

		__overlay__ {
			phy-type = <0x00>;
		};
	};

	fragment@43 {
		target = <0xffffffff>;

		__overlay__ {
			firmware-prefix = "/pmu/pmu_mt5896_2048";
			dtbo-path = "/pmu/pmu_mt5873_h1v1_b6_s.dtbo";
		};
	};

	fragment@44 {
		target = <0xffffffff>;

		__overlay__ {
			wakeup-gpio-num = <0xffff>;
		};
	};

	fragment@45 {
		target = <0xffffffff>;

		__overlay__ {
			wakeup-gpio-num = <0x133>;
			wakeup-virq = <0x507>;
			wakeup-virq-polar = <0x01>;
			status = "okay";
		};
	};

	fragment@46 {
		target = <0xffffffff>;

		__overlay__ {
			wakeup-gpio-num = <0x137>;
			wakeup-virq = <0x50b>;
			wakeup-virq-polar = <0x01>;
			status = "okay";
		};
	};

	fragment@47 {
		target = <0xffffffff>;

		__overlay__ {
			reset-gpio-num = <0x135>;
			default-gpio-val = <0x01>;
			invert-ms = <0x05>;
			status = "okay";
		};
	};

	fragment@48 {
		target = <0xffffffff>;

		__overlay__ {
			wakeup-gpio-num = <0x167>;
			wakeup-virq = <0x53b>;
			wakeup-virq-polar = <0x01>;
			status = "okay";
		};
	};

	fragment@49 {
		target = <0xffffffff>;

		__overlay__ {
			nonpm-gpio-nbase = <0x00>;
			nonpm-gpio-ngpio = <0xd4>;
			pm-gpio-nbase = <0x12c>;
			pm-gpio-ngpio = <0x68>;
			status = "okay";
		};
	};

	fragment@50 {
		target = <0xffffffff>;

		__overlay__ {
			capability = <0x00>;
			firmware-prefix = "/vad/vad_mt5873_512";
			dtbo-path = "/vad/vad_mt5873_h1v1_b6_s.dtbo";
			reg = <0x00 0x1c086400 0x00 0x200 0x00 0x1c020200 0x00 0x200 0x00 0x1c021000 0x00 0x200 0x00 0x1c021200 0x00 0x200 0x00 0x1c620080 0x00 0x02 0x00 0x1c620880 0x00 0x02 0x00 0x1d206000 0x00 0x200 0x00 0x1d2a0800 0x00 0x200 0x00 0x1c087000 0x00 0x200 0x00 0x1d2a0400 0x00 0x200 0x00 0x1c606000 0x00 0x200 0x00 0x1c001800 0x00 0x200 0x00 0x1c001a00 0x00 0x200 0x00 0x1c086000 0x00 0x200 0x00 0x1c086200 0x00 0x200 0x00 0x1c087200 0x00 0x200 0x00 0x1d280000 0x00 0x200 0x00 0x1c025200 0x00 0x200>;
		};
	};

	fragment@51 {
		target = <0xffffffff>;

		__overlay__ {

			tuner-mxl661@60 {
				compatible = "mtk, mxl661";
				reg = <0x60>;
				unique_id = <0x6056>;
				i2c_slave_id = <0x60>;
				delivery_system = <0x01 0x02 0x03 0x08 0x0b 0x0d 0x10 0x13>;
				xtal_cap = <0x1f>;
				gpio_id = <0x00>;
			};

			tuner-av2017@63 {
				compatible = "mtk, av2017";
				reg = <0x63>;
				unique_id = <0x6057>;
				i2c_slave_id = <0x63>;
				delivery_system = <0x05 0x06>;
			};

			tuner-rda5815@61 {
				compatible = "mtk, rda5815";
				reg = <0x61>;
				unique_id = <0xc59>;
				i2c_slave_id = <0x00>;
				delivery_system = <0x05 0x06>;
			};

			tuner-av2018@62 {
				compatible = "mtk, av2018";
				reg = <0x62>;
				unique_id = <0x605a>;
				i2c_slave_id = <0x00>;
				delivery_system = <0x05 0x06>;
			};

			tuner-cxd686@65 {
				compatible = "mtk, cxd686";
				reg = <0x65>;
				unique_id = <0x6060>;
				i2c_slave_id = <0x60>;
				gpio_id = <0xff>;
				delivery_system = <0x01 0x02 0x03 0x05 0x06 0x08 0x0b 0x0d 0x10 0x13>;
			};

			tuner-r842@66 {
				compatible = "mtk, r842";
				reg = <0x66>;
				fe_id = <0x00>;
				unique_id = <0x607b>;
				i2c_slave_id = <0x7b>;
				xtal_cap = <0x0f>;
				delivery_system = <0x01 0x02 0x03 0x08 0x0b 0x0d 0x10 0x13>;
			};

			tuner-r842@6C {
				compatible = "mtk, r842";
				reg = <0x6c>;
				fe_id = <0x01>;
				unique_id = <0x6062>;
				i2c_slave_id = <0x7b>;
				delivery_system = <0x01 0x02 0x03 0x08 0x0b 0x0d 0x10 0x13>;
			};

			tuner-rt710@7A {
				compatible = "mtk, rt710";
				reg = <0x7a>;
				unique_id = <0x617a>;
				i2c_slave_id = <0x7a>;
				delivery_system = <0x05 0x06>;
				ifagc_rf_level_map = <0x6da8 0x17318 0x6da8 0x15f90 0x6c7c 0x14c08 0x6601 0x13880 0x624c 0x124f8 0x5e96 0x11170 0x59da 0xfde8 0x551e 0xea60 0x4d7f 0xd6d8 0x4d26 0xc350 0x4d42 0xafc8 0x4d82 0x9c40 0x4d36 0x88b8 0x4e16 0x7530 0x4dff 0x61a8 0x4d4d 0x4e20 0x4cd7 0x3a98 0x4f2e 0x2710 0x4d55 0x1388 0x4bc5 0x00>;
			};

			mtk-austin-demod@79 {
				compatible = "austin_demod";
				reg = <0x79>;
				i2c_slave_id = <0x79>;
				unique_id = <0x01>;
			};

			cxd2878@64 {
				compatible = "cxd2878";
				reg = <0x64>;
				unique_id = <0x39a>;
				i2c_slave_id = <0xc8>;
				xtal_cap = <0x5dc0>;
				reset_gpio = <0xbb>;
			};
		};
	};

	fragment@52 {
		target = <0xffffffff>;

		__overlay__ {

			pj593@60 {
				compatible = "pj593";
				reg = <0x60>;
				fe_id = <0x00>;
				unique_id = <0x60f8>;
				i2c_slave_id = <0xc0>;
			};

			pj593-1@61 {
				compatible = "pj593-1";
				reg = <0x61>;
				fe_id = <0x01>;
				unique_id = <0x61f8>;
				i2c_slave_id = <0xc2>;
			};

			cxd2857@66 {
				compatible = "cxd2857";
				reg = <0x66>;
				fe_id = <0x00>;
				unique_id = <0x6691>;
				i2c_slave_id = <0xcc>;
				xtal_cap = <0x5dc0>;
				reset_gpio = <0xbb>;
				data_bits = <0x01>;
				pinctrl-ts = "ext_ts_para_demod_pad_mux";
			};

			cxd2857-1@6E {
				compatible = "cxd2857-1";
				reg = <0x6e>;
				fe_id = <0x01>;
				unique_id = <0x6e91>;
				i2c_slave_id = <0xdc>;
				xtal_cap = <0x5dc0>;
				reset_gpio = <0xbb>;
				data_bits = <0x01>;
				pinctrl-ts = "ext1_ts_para_demod_pad_mux";
			};
		};
	};

	fragment@53 {
		target = <0xffffffff>;

		__overlay__ {
			support_lanes = <0x28>;
			layout_order = <0x00 0x01 0x02 0x03 0x04 0x05 0x06 0x07 0x08 0x09 0x0a 0x0b 0x0c 0x0d 0x0e 0x0f 0x19 0x13 0x10 0x1b 0x1c 0x11 0x12 0x14 0x1d 0x15 0x16 0x17 0x1a 0x18 0x1e 0x1f 0x21 0x20 0x22 0x23 0x24 0x27 0x25 0x26>;
		};
	};

	fragment@54 {
		target = <0xffffffff>;

		__overlay__ {
			vcc-gpios = <0xffffffff 0x37 0x00>;
		};
	};

	fragment@55 {
		target = <0xffffffff>;

		__overlay__ {

			panel-color-info {
				GOP0HDRMode = <0x00>;
			};
		};
	};

	fragment@56 {
		target = <0xffffffff>;

		__overlay__ {
			backlight-gpios = <0xffffffff 0x0b 0x00>;
		};
	};

	fragment@57 {
		target = <0xffffffff>;

		__overlay__ {
			pol = <0x00>;
		};
	};

	fragment@58 {
		target = <0xffffffff>;

		__overlay__ {
			pol = <0x00>;
		};
	};

	fragment@59 {
		target = <0xffffffff>;

		__overlay__ {
			extcon-gpios = <0xffffffff 0x21 0x00>;
		};
	};

	fragment@60 {
		target = <0xffffffff>;

		__overlay__ {
			pinctrl-names = "default";
			pinctrl-0 = <0xffffffff>;
		};
	};

	fragment@61 {
		target = <0xffffffff>;

		__overlay__ {
			reg = <0x00 0x1c487640 0x00 0x40 0x00 0x1c4877c0 0x00 0x40 0x00 0x1c487200 0x00 0x40>;
		};
	};

	fragment@62 {
		target = <0xffffffff>;

		__overlay__ {
		};
	};

	fragment@63 {
		target = <0xffffffff>;

		__overlay__ {
		};
	};

	fragment@64 {
		target = <0xffffffff>;

		__overlay__ {
		};
	};

	fragment@65 {
		target = <0xffffffff>;

		__overlay__ {
			pinctrl-names = "default";
			pinctrl-0 = <0xffffffff>;
		};
	};

	__overlay__ {

		dummy_pcb_node {
			status = "disabled";
		};
	};

	fragment@66 {
		target = <0xffffffff>;

		__overlay__ {
		};
	};

	fragment@67 {
		target = <0xffffffff>;

		__overlay__ {
			pinctrl-mt5896,bits = <0x48 0xf0 0x01 0x49 0x0f 0x01>;
			pinctrl-mtk,pins = <0x48 0xf0 0x01 0x49 0x0f 0x01>;
		};
	};

	fragment@68 {
		target = <0xffffffff>;

		__overlay__ {
			pinctrl-mt5896,bits = <0x49 0xf0 0x04 0x4c 0x0f 0x04>;
			pinctrl-mtk,pins = <0x49 0xf0 0x04 0x4c 0x0f 0x04>;
		};
	};

	fragment@69 {
		target = <0xffffffff>;

		__overlay__ {
			pinctrl-mt5896,bits = <0x85 0xf0 0x01 0x88 0x0f 0x01>;
			pinctrl-mtk,pins = <0x85 0xf0 0x01 0x88 0x0f 0x01>;
		};
	};

	fragment@70 {
		target = <0xffffffff>;

		__overlay__ {
			pinctrl-mt5896,bits = <0x05 0xf0 0x01 0x05 0x0f 0x01>;
			pinctrl-mtk,pins = <0x05 0xf0 0x01 0x05 0x0f 0x01>;
		};
	};

	fragment@71 {
		target = <0xffffffff>;

		__overlay__ {
			pinctrl-mt5896,bits = <0x89 0xf0 0x01 0x8c 0xf0 0x01 0x8c 0x0f 0x01 0x8d 0x0f 0x01 0x8d 0xf0 0x01>;
			pinctrl-mtk,pins = <0x89 0xf0 0x01 0x8c 0xf0 0x01 0x8c 0x0f 0x01 0x8d 0x0f 0x01 0x8d 0xf0 0x01>;
		};
	};

	fragment@72 {
		target = <0xffffffff>;

		__overlay__ {
			pinctrl-mt5896,bits = <0x70 0x0f 0x01 0x6c 0xf0 0x01 0x6d 0x0f 0x01 0x6d 0xf0 0x01 0x95 0x0f 0x01>;
			pinctrl-mtk,pins = <0x70 0x0f 0x01 0x6c 0xf0 0x01 0x6d 0x0f 0x01 0x6d 0xf0 0x01 0x95 0x0f 0x01>;
		};
	};

	fragment@73 {
		target = <0xffffffff>;

		__overlay__ {
			pinctrl-mt5896,bits = <0x61 0x0f 0x01 0x61 0xf0 0x01 0x64 0x0f 0x01 0x64 0xf0 0x01 0x65 0x0f 0x01 0x65 0xf0 0x01 0x68 0x0f 0x01 0x68 0xf0 0x01 0x69 0x0f 0x01 0x69 0xf0 0x01 0x6c 0x0f 0x01>;
			pinctrl-mtk,pins = <0x61 0x0f 0x01 0x61 0xf0 0x01 0x64 0x0f 0x01 0x64 0xf0 0x01 0x65 0x0f 0x01 0x65 0xf0 0x01 0x68 0x0f 0x01 0x68 0xf0 0x01 0x69 0x0f 0x01 0x69 0xf0 0x01 0x6c 0x0f 0x01>;
		};
	};

	fragment@74 {
		target = <0xffffffff>;

		__overlay__ {
			pinctrl-mt5896,bits = <0x89 0xf0 0x01 0x8c 0xf0 0x01 0x8c 0x0f 0x01 0x8d 0x0f 0x01 0x8d 0xf0 0x01 0x90 0x0f 0x01 0x90 0xf0 0x01 0x91 0x0f 0x01 0x91 0xf0 0x01 0x94 0x0f 0x01 0x94 0xf0 0x01>;
			pinctrl-mtk,pins = <0x89 0xf0 0x01 0x8c 0xf0 0x01 0x8c 0x0f 0x01 0x8d 0x0f 0x01 0x8d 0xf0 0x01 0x90 0x0f 0x01 0x90 0xf0 0x01 0x91 0x0f 0x01 0x91 0xf0 0x01 0x94 0x0f 0x01 0x94 0xf0 0x01>;
		};
	};

	fragment@75 {
		target = <0xffffffff>;

		__overlay__ {
			pinctrl-mt5896,bits = <0x89 0xf0 0x06 0x8c 0xf0 0x06 0x8c 0x0f 0x06 0x8d 0x0f 0x06 0x8d 0xf0 0x06 0x90 0x0f 0x06 0x90 0xf0 0x06 0x91 0x0f 0x06 0x91 0xf0 0x06 0x94 0x0f 0x06 0x94 0xf0 0x06>;
			pinctrl-mtk,pins = <0x89 0xf0 0x06 0x8c 0xf0 0x06 0x8c 0x0f 0x06 0x8d 0x0f 0x06 0x8d 0xf0 0x06 0x90 0x0f 0x06 0x90 0xf0 0x06 0x91 0x0f 0x06 0x91 0xf0 0x06 0x94 0x0f 0x06 0x94 0xf0 0x06>;
		};
	};

	fragment@76 {
		target = <0xffffffff>;

		__overlay__ {
			pinctrl-mt5896,bits = <0xc0 0xf0 0x02 0xb8 0xf0 0x02 0xbc 0xf0 0x02 0xbc 0x0f 0x02 0xb9 0x0f 0x02 0xb9 0xf0 0x02>;
			pinctrl-mtk,pins = <0xc0 0xf0 0x02 0xb8 0xf0 0x02 0xbc 0xf0 0x02 0xbc 0x0f 0x02 0xb9 0x0f 0x02 0xb9 0xf0 0x02>;
		};
	};

	fragment@77 {
		target = <0xffffffff>;

		__overlay__ {
			pinctrl-mt5896,bits = <0x90 0x0f 0x03 0x94 0x0f 0x03 0x91 0xf0 0x03 0x8d 0xf0 0x03 0x91 0x0f 0x03 0x90 0xf0 0x03>;
			pinctrl-mtk,pins = <0x90 0x0f 0x03 0x94 0x0f 0x03 0x91 0xf0 0x03 0x8d 0xf0 0x03 0x91 0x0f 0x03 0x90 0xf0 0x03>;
		};
	};

	fragment@78 {
		target = <0xffffffff>;

		__overlay__ {
			pinctrl-mt5896,bits = <0x2d 0xf0 0x08>;
			pinctrl-mtk,pins = <0x2d 0xf0 0x08>;
		};
	};

	fragment@79 {
		target = <0xffffffff>;

		__overlay__ {
			pinctrl-mt5896,bits;
			pinctrl-mtk,pins;
		};
	};

	fragment@80 {
		target = <0xffffffff>;

		__overlay__ {
			pinctrl-mt5896,bits;
			pinctrl-mtk,pins;
		};
	};

	fragment@81 {
		target = <0xffffffff>;

		__overlay__ {
			pinctrl-mt5896,bits;
			pinctrl-mtk,pins;
		};
	};

	fragment@82 {
		target = <0xffffffff>;

		__overlay__ {
			pinctrl-mt5896,bits;
			pinctrl-mtk,pins;
		};
	};

	fragment@83 {
		target = <0xffffffff>;

		__overlay__ {
			pinctrl-mt5896,bits = <0x09 0xf0 0x01 0x0c 0x0f 0x01 0x0c 0xf0 0x01 0x0d 0x0f 0x01>;
			pinctrl-mtk,pins = <0x09 0xf0 0x01 0x0c 0x0f 0x01 0x0c 0xf0 0x01 0x0d 0x0f 0x01>;
		};
	};

	fragment@84 {
		target = <0xffffffff>;

		__overlay__ {
			pinctrl-mt5896,bits = <0x18 0xf0 0x01 0x11 0xf0 0x01 0x19 0x0f 0x01>;
			pinctrl-mtk,pins = <0x18 0xf0 0x01 0x11 0xf0 0x01 0x19 0x0f 0x01>;
		};
	};

	fragment@85 {
		target = <0xffffffff>;

		__overlay__ {
			pinctrl-mt5896,bits = <0x88 0xf0 0x01>;
			pinctrl-mtk,pins = <0x88 0xf0 0x01>;
		};
	};

	fragment@86 {
		target = <0xffffffff>;

		__overlay__ {
			pinctrl-mt5896,bits = <0x89 0x0f 0x01>;
			pinctrl-mtk,pins = <0x89 0x0f 0x01>;
		};
	};

	fragment@87 {
		target = <0xffffffff>;

		__overlay__ {
			pinctrl-mt5896,bits = <0x84 0x0f 0x01>;
			pinctrl-mtk,pins = <0x84 0x0f 0x01>;
		};
	};

	fragment@88 {
		target = <0xffffffff>;

		__overlay__ {
			pinctrl-mt5896,bits = <0x81 0xf0 0x01>;
			pinctrl-mtk,pins = <0x81 0xf0 0x01>;
		};
	};

	fragment@89 {
		target = <0xffffffff>;

		__overlay__ {
			pinctrl-mt5896,bits;
			pinctrl-mtk,pins;
		};
	};

	fragment@90 {
		target = <0xffffffff>;

		__overlay__ {
			pinctrl-mt5896,bits;
			pinctrl-mtk,pins;
		};
	};

	fragment@91 {
		target = <0xffffffff>;

		__overlay__ {
			pinctrl-mt5896,bits;
			pinctrl-mtk,pins;
		};
	};

	fragment@92 {
		target = <0xffffffff>;

		__overlay__ {
			pinctrl-mt5896,bits = <0x85 0x0f 0x03 0x84 0xf0 0x03>;
			pinctrl-mtk,pins = <0x85 0x0f 0x03 0x84 0xf0 0x03>;
		};
	};

	fragment@93 {
		target = <0xffffffff>;

		__overlay__ {
			pinctrl-mt5896,bits = <0x01 0x0f 0x05 0x08 0x0f 0x05 0x01 0xf0 0x05 0x00 0xf0 0x05>;
			pinctrl-mtk,pins = <0x01 0x0f 0x05 0x08 0x0f 0x05 0x01 0xf0 0x05 0x00 0xf0 0x05>;
		};
	};

	fragment@94 {
		target = <0xffffffff>;

		__overlay__ {
			pinctrl-mt5896,bits = <0x08 0xf0 0x01>;
			pinctrl-mtk,pins = <0x08 0xf0 0x01>;
		};
	};

	fragment@95 {
		target = <0xffffffff>;

		__overlay__ {
			pinctrl-mt5896,bits = <0x08 0xf0 0x00>;
			pinctrl-mtk,pins = <0x08 0xf0 0x00>;
		};
	};

	fragment@96 {
		target = <0xffffffff>;

		__overlay__ {
			pinctrl-names = "hdmib_pm_uart0";
			pinctrl-0 = <0xffffffff>;
		};
	};

	fragment@97 {
		target = <0xffffffff>;

		__overlay__ {
			pinctrl-mt5896,bits = <0x40 0x0f 0x01 0x40 0xf0 0x01 0x41 0x0f 0x01>;
			pinctrl-mtk,pins = <0x40 0x0f 0x01 0x40 0xf0 0x01 0x41 0x0f 0x01>;
		};
	};

	fragment@98 {
		target = <0xffffffff>;

		__overlay__ {
			pinctrl-mt5896,bits = <0x40 0x0f 0x03 0x40 0xf0 0x03 0x41 0x0f 0x03 0x65 0xf0 0x03>;
			pinctrl-mtk,pins = <0x40 0x0f 0x03 0x40 0xf0 0x03 0x41 0x0f 0x03 0x65 0xf0 0x03>;
		};
	};

	fragment@99 {
		target = <0xffffffff>;

		__overlay__ {
			pinctrl-mt5896,bits = <0x40 0x0f 0x03 0x40 0xf0 0x03 0x41 0x0f 0x03>;
			pinctrl-mtk,pins = <0x40 0x0f 0x03 0x40 0xf0 0x03 0x41 0x0f 0x03>;
		};
	};

	fragment@100 {
		target = <0xffffffff>;

		__overlay__ {
			pinctrl-mt5896,bits = <0x3d 0x0f 0x05 0x3d 0xf0 0x05>;
			pinctrl-mtk,pins = <0x3d 0x0f 0x05 0x3d 0xf0 0x05>;
		};
	};

	fragment@101 {
		target = <0xffffffff>;

		__overlay__ {
			pinctrl-mt5896,bits = <0x04 0xf0 0x01 0x05 0x0f 0x01 0x00 0x0f 0x01 0x00 0xf0 0x01>;
			pinctrl-mtk,pins = <0x04 0xf0 0x01 0x05 0x0f 0x01 0x00 0x0f 0x01 0x00 0xf0 0x01>;
		};
	};

	fragment@102 {
		target = <0xffffffff>;

		__overlay__ {
			pinctrl-mt5896,bits = <0xd0 0xf0 0x02 0xcd 0xf0 0x02 0xd0 0x0f 0x02 0xcd 0x0f 0x02>;
			pinctrl-mtk,pins = <0xd0 0xf0 0x02 0xcd 0xf0 0x02 0xd0 0x0f 0x02 0xcd 0x0f 0x02>;
		};
	};

	fragment@103 {
		target = <0xffffffff>;

		__overlay__ {
			pinctrl-mt5896,bits;
			pinctrl-mtk,pins;
		};
	};

	fragment@104 {
		target = <0xffffffff>;

		__overlay__ {
			pinctrl-mt5896,bits;
			pinctrl-mtk,pins;
		};
	};

	fragment@105 {
		target = <0xffffffff>;

		__overlay__ {
			pinctrl-mt5896,bits = <0x29 0x0f 0x04 0x29 0xf0 0x04>;
			pinctrl-mtk,pins = <0x29 0x0f 0x04 0x29 0xf0 0x04>;
		};
	};

	fragment@106 {
		target = <0xffffffff>;

		__overlay__ {
			pinctrl-mt5896,bits = <0xa0 0xf0 0x01 0xa1 0x0f 0x01 0xa1 0xf0 0x01 0xa4 0x0f 0x01 0xa4 0xf0 0x01 0xa5 0x0f 0x01 0xa5 0xf0 0x01 0xa8 0x0f 0x01 0xa8 0xf0 0x01 0xa9 0x0f 0x01 0xa9 0xf0 0x01 0xac 0x0f 0x01 0xac 0xf0 0x01 0xad 0x0f 0x01 0xad 0xf0 0x01 0xb0 0x0f 0x01 0xb0 0xf0 0x01 0xb1 0x0f 0x01 0xb1 0xf0 0x01 0xb4 0x0f 0x01 0xb4 0xf0 0x01 0xb5 0x0f 0x01 0xb5 0xf0 0x01 0xb8 0x0f 0x01 0xb8 0xf0 0x01 0xb9 0x0f 0x01 0xb9 0xf0 0x01 0xbc 0x0f 0x01 0xbc 0xf0 0x01 0xbd 0x0f 0x01 0xbd 0xf0 0x01 0xc0 0x0f 0x01 0xc0 0xf0 0x01>;
			pinctrl-mtk,pins = <0xa0 0xf0 0x01 0xa1 0x0f 0x01 0xa1 0xf0 0x01 0xa4 0x0f 0x01 0xa4 0xf0 0x01 0xa5 0x0f 0x01 0xa5 0xf0 0x01 0xa8 0x0f 0x01 0xa8 0xf0 0x01 0xa9 0x0f 0x01 0xa9 0xf0 0x01 0xac 0x0f 0x01 0xac 0xf0 0x01 0xad 0x0f 0x01 0xad 0xf0 0x01 0xb0 0x0f 0x01 0xb0 0xf0 0x01 0xb1 0x0f 0x01 0xb1 0xf0 0x01 0xb4 0x0f 0x01 0xb4 0xf0 0x01 0xb5 0x0f 0x01 0xb5 0xf0 0x01 0xb8 0x0f 0x01 0xb8 0xf0 0x01 0xb9 0x0f 0x01 0xb9 0xf0 0x01 0xbc 0x0f 0x01 0xbc 0xf0 0x01 0xbd 0x0f 0x01 0xbd 0xf0 0x01 0xc0 0x0f 0x01 0xc0 0xf0 0x01>;
		};
	};

	fragment@107 {
		target = <0xffffffff>;

		__overlay__ {
			pinctrl-mt5896,bits = <0xa0 0xf0 0x02 0xa1 0x0f 0x02 0xa1 0xf0 0x02 0xa4 0x0f 0x02 0xa4 0xf0 0x02 0xa5 0x0f 0x02 0xa5 0xf0 0x02 0xa8 0x0f 0x02>;
			pinctrl-mtk,pins = <0xa0 0xf0 0x02 0xa1 0x0f 0x02 0xa1 0xf0 0x02 0xa4 0x0f 0x02 0xa4 0xf0 0x02 0xa5 0x0f 0x02 0xa5 0xf0 0x02 0xa8 0x0f 0x02>;
		};
	};

	fragment@108 {
		target = <0xffffffff>;

		__overlay__ {
			pinctrl-mt5896,bits = <0x2c 0x0f 0x01>;
			pinctrl-mtk,pins = <0x2c 0x0f 0x01>;
		};
	};

	fragment@109 {
		target = <0xffffffff>;

		__overlay__ {
			pinctrl-mt5896,bits = <0x00 0x0f 0x04>;
			pinctrl-mtk,pins = <0x00 0x0f 0x04>;
		};
	};

	fragment@110 {
		target = <0xffffffff>;

		__overlay__ {
			pinctrl-mt5896,bits = <0x1c 0x0f 0x00>;
			pinctrl-mtk,pins = <0x1c 0x0f 0x00>;
		};
	};

	fragment@111 {
		target = <0xffffffff>;

		__overlay__ {
			pinctrl-mt5896,bits = <0x1c 0x0f 0x03>;
			pinctrl-mtk,pins = <0x1c 0x0f 0x03>;
		};
	};

	fragment@112 {
		target = <0xffffffff>;

		__overlay__ {
			pinctrl-mt5896,bits = <0x1c 0x0f 0x03>;
			pinctrl-mtk,pins = <0x1c 0x0f 0x03>;
		};
	};

	fragment@113 {
		target = <0xffffffff>;

		__overlay__ {
			pinctrl-mt5896,bits = <0x40 0xf0 0x00>;
			pinctrl-mtk,pins = <0x40 0xf0 0x00>;
		};
	};

	fragment@114 {
		target = <0xffffffff>;

		__overlay__ {
			pinctrl-mt5896,bits = <0x40 0xf0 0x01>;
			pinctrl-mtk,pins = <0x40 0xf0 0x01>;
		};
	};

	fragment@115 {
		target = <0xffffffff>;

		__overlay__ {
			pinctrl-mt5896,pins = <0x104 0x00>;
			pinctrl-mtk,pins = <0x104 0x03 0x03>;
			pinctrl-mt5896,drive-strength = <0x03 0x01>;
		};
	};

	fragment@116 {
		target = <0xffffffff>;

		__overlay__ {
			pinctrl-mt5896,pins = <0x104 0x00>;
			pinctrl-mtk,pins = <0x104 0x03 0x03>;
			pinctrl-mt5896,drive-strength = <0x03 0x02>;
		};
	};

	__fixups__ {
		mtk_pqu = "/fragment@0:target:0";
		pmu_rproc = "/fragment@1:target:0\0/fragment@43:target:0";
		vad_rproc = "/fragment@2:target:0\0/fragment@50:target:0";
		mediatek_drm_tv_kms = "/fragment@3:target:0";
		vsync_like1_gpio_pmux = "/fragment@3/__overlay__:pinctrl-0:0\0/fragment@95:target:0";
		vsync_like1_pmux = "/fragment@3/__overlay__:pinctrl-1:0\0/fragment@94:target:0";
		mediatek_ldm = "/fragment@4:target:0";
		gpio0 = "/fragment@4/__overlay__:gpios:0\0/fragment@12/__overlay__:vbus-gpios:0\0/fragment@40:target:0";
		mtk_sound_soc = "/fragment@5:target:0\0/fragment@7:target:0";
		i2s_out_pmux = "/fragment@5/__overlay__:pinctrl-0:0\0/fragment@6/__overlay__:pinctrl-0:0\0/fragment@83:target:0";
		i2s_in_pmux = "/fragment@5/__overlay__:pinctrl-0:4\0/fragment@6/__overlay__:pinctrl-0:4\0/fragment@84:target:0";
		spdif_out_pmux = "/fragment@5/__overlay__:pinctrl-0:8\0/fragment@6/__overlay__:pinctrl-0:8\0/fragment@87:target:0";
		spdif_in_pmux = "/fragment@5/__overlay__:pinctrl-0:12\0/fragment@6/__overlay__:pinctrl-0:12\0/fragment@88:target:0";
		digmux_uart4_pmux = "/fragment@5/__overlay__:pinctrl-0:16\0/fragment@6/__overlay__:pinctrl-0:16\0/fragment@92:target:0";
		mtk_tv_machine = "/fragment@6:target:0";
		usb_host0 = "/fragment@8:target:0\0/fragment@12:target:0\0/fragment@14:target:0";
		usb_host1 = "/fragment@9:target:0\0/fragment@13:target:0";
		u3phy0 = "/fragment@10:target:0";
		u3phy1 = "/fragment@11:target:0";
		pm_gpio0 = "/fragment@12/__overlay__:vbus-gpios:12\0/fragment@13/__overlay__:vbus-gpios:0\0/fragment@39:target:0\0/fragment@41/__overlay__/led0:gpios:0\0/fragment@41/__overlay__/led1:gpios:0\0/fragment@54/__overlay__:vcc-gpios:0\0/fragment@56/__overlay__:backlight-gpios:0\0/fragment@59/__overlay__:extcon-gpios:0";
		i2c0 = "/fragment@15:target:0\0/fragment@22:target:0\0/fragment@52:target:0";
		i2c0_pmux = "/fragment@15/__overlay__:pinctrl-0:0\0/fragment@67:target:0";
		i2c1 = "/fragment@16:target:0\0/fragment@23:target:0";
		i2c1_pmux = "/fragment@16/__overlay__:pinctrl-0:0\0/fragment@68:target:0";
		i2c2 = "/fragment@17:target:0\0/fragment@24:target:0\0/fragment@51:target:0";
		i2c3 = "/fragment@18:target:0\0/fragment@25:target:0";
		i2c3_pmux = "/fragment@18/__overlay__:pinctrl-0:0\0/fragment@70:target:0";
		i2c4 = "/fragment@19:target:0";
		pm_i2c0 = "/fragment@20:target:0\0/fragment@26:target:0";
		pm_i2c0_pmux = "/fragment@20/__overlay__:pinctrl-0:0\0/fragment@100:target:0";
		pm_i2c1 = "/fragment@21:target:0";
		i2c2_pmux = "/fragment@24/__overlay__:pinctrl-0:0\0/fragment@69:target:0";
		uart0 = "/fragment@27:target:0\0/fragment@33:target:0";
		uart1 = "/fragment@28:target:0\0/fragment@34:target:0";
		uart2 = "/fragment@29:target:0\0/fragment@35:target:0";
		uart3 = "/fragment@30:target:0\0/fragment@36:target:0";
		uart4 = "/fragment@31:target:0";
		uart5 = "/fragment@32:target:0";
		hw_info = "/fragment@37:target:0";
		panel_cus_setting = "/fragment@38:target:0";
		gpio_front_led = "/fragment@41:target:0";
		gmac = "/fragment@42:target:0";
		mic_mute = "/fragment@44:target:0";
		wifi_gpio = "/fragment@45:target:0";
		bt_gpio = "/fragment@46:target:0";
		wifi_reset = "/fragment@47:target:0";
		emer_gpio = "/fragment@48:target:0";
		gpio_control = "/fragment@49:target:0";
		pkg_lane_order = "/fragment@53:target:0";
		video_out = "/fragment@54:target:0\0/fragment@55:target:0\0/fragment@56:target:0";
		pwmu1 = "/fragment@57:target:0\0/fragment@61:target:0";
		pwm = "/fragment@58:target:0\0/fragment@60:target:0";
		extcon_gpio = "/fragment@59:target:0";
		scan_pwm0_pmux = "/fragment@60/__overlay__:pinctrl-0:0\0/fragment@78:target:0";
		pwmu2 = "/fragment@62:target:0";
		pwmu3 = "/fragment@63:target:0";
		pwmu4 = "/fragment@64:target:0";
		serflash = "/fragment@65:target:0";
		mspi_serflash_pmux = "/fragment@65/__overlay__:pinctrl-0:0\0/fragment@102:target:0";
		pinctrl = "/fragment@66:target:0";
		ext1_ts_demod_pmux = "/fragment@71:target:0";
		ext2_ts_demod_pmux = "/fragment@72:target:0";
		ext_ts_para_demod_pmux = "/fragment@73:target:0";
		ext1_ts_para_demod_pmux = "/fragment@74:target:0";
		ts1_para_out_pmux = "/fragment@75:target:0";
		smart_card1_pmux = "/fragment@76:target:0";
		smart_card1_ext_pmux = "/fragment@77:target:0";
		scan_pwm1_pmux = "/fragment@79:target:0";
		scan_pwm2_pmux = "/fragment@80:target:0";
		scan_pwm3_pmux = "/fragment@81:target:0";
		scan_pwm4_pmux = "/fragment@82:target:0";
		diseqc_out_pmux = "/fragment@85:target:0";
		diseqc_in_pmux = "/fragment@86:target:0";
		fuart0_pmux = "/fragment@89:target:0";
		uart0_pmux = "/fragment@90:target:0";
		uart1_pmux = "/fragment@91:target:0";
		ld0_spi_pmux = "/fragment@93:target:0";
		pm_pinctrl = "/fragment@96:target:0";
		hdmib_pm_uart0_pmux = "/fragment@96/__overlay__:pinctrl-0:0\0/fragment@105:target:0";
		dmic_record_pmux = "/fragment@97:target:0";
		dmic_record_i2s_in_pmux = "/fragment@98:target:0";
		dmic_record_i2s_tdm_in_pmux = "/fragment@99:target:0";
		pm_spi_pmux = "/fragment@101:target:0";
		pm_uart0_pmux = "/fragment@103:target:0";
		pm_uart1_pmux = "/fragment@104:target:0";
		pcm_pmux = "/fragment@106:target:0";
		nand_pmux = "/fragment@107:target:0";
		ir_tx_nonpm_pmux = "/fragment@108:target:0";
		irs_pmux = "/fragment@109:target:0";
		pm_ir_pmux = "/fragment@110:target:0";
		pm_irs_pmux = "/fragment@111:target:0";
		irs_haps_pmux = "/fragment@112:target:0";
		gpio_func0_pmux = "/fragment@113:target:0";
		gpio_func1_pmux = "/fragment@114:target:0";
		gpio_func0_pcfg = "/fragment@115:target:0";
		gpio_func1_pcfg = "/fragment@116:target:0";
	};
};
