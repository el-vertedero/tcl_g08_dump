/dts-v1/;

/ {

	fragment@0 {
		target = <0xffffffff>;

		__overlay__ {
			LDM_SUPPORT = <0x01>;
			LED_MSPI_EN = <0x00>;
			LDM_DMA_SPI_LTP_TEST = <0x00>;

			ldm-panel-info {
				PanelWidth = <0xf00>;
				PanelHeight = <0x870>;
				LEDType = <0x03>;
				LDFWidth = <0x40>;
				LDFHeight = <0x24>;
				LEDWidth = <0x40>;
				LEDHeight = <0x24>;
				LSFWidth = <0x80>;
				LSFHeight = <0x48>;
				Edge2D_Local_h = <0x05>;
				Edge2D_Local_v = <0x05>;
				PanelHz = <0x3c>;
				MirrorPanel = <0x00>;
				Support_DV_GD = <0x00>;
			};

			ldm-misc-info {
				LDEn = <0x01>;
				Compensation_En = <0x01>;
				LD_cus_alg_mode = <0x00>;
				OLEDEn = <0x01>;
				OLED_LSP_En = <0x01>;
				OLED_GSP_En = <0x01>;
				OLED_HBP_En = <0x00>;
				OLED_CRP_En = <0x01>;
				OLED_LSPHDR_En = <0x00>;
				OLED_Report_En = <0x00>;
				OLED_LGE_GSR_En = <0x00>;
				OLED_LGE_GSR_HBP_En = <0x00>;
			};

			ldm-led-device-info {
				LedDevice_Type = <0x00>;
				SPIbits = <0x10>;
				DutyHeader = <0x00 0x00 0x00 0x00 0x00 0x00 0x00 0x00 0x00 0x00 0x00 0x00 0x00 0x00 0x00 0x00>;
				CurrentHeader = <0x00 0x00 0x00 0x00 0x00 0x00 0x00 0x00 0x00 0x00 0x00 0x00 0x00 0x00 0x00 0x00>;
				SpiChannelNum = <0x00>;
				DutyHeaderByte = <0x00>;
				DutyPerDataByte = <0x00>;
				DutyCheckSumByte = <0x00>;
				CurrentHeaderByte = <0x00>;
				CurrentPerDataByte = <0x00>;
				CurrentCheckSumByte = <0x00>;
				SPIChannelList;
				Device_Num = <0x00 0x00 0x00 0x00 0x00 0x00 0x00 0x00>;
				DutyDramFormat = <0x00 0x00 0x00 0x00 0x00 0x00 0x00 0x00 0x00 0x00 0x00 0x00 0x00 0x00 0x00 0x00 0x00 0x00 0x00 0x00 0x00 0x00 0x00 0x00>;
				CurrentDramFormat = <0x00 0x00 0x00 0x00 0x00 0x00 0x00 0x00 0x00 0x00 0x00 0x00 0x00 0x00 0x00 0x00 0x00 0x00 0x00 0x00 0x00 0x00 0x00 0x00>;
				Mapping_Table_Header_Duty;
				Mapping_Table_Duty;
				Mapping_Table_CheckSum_Duty;
				Mapping_Table_Header_Current;
				Mapping_Table_Current;
				Mapping_Table_CheckSum_Current;
				Mapping_Table_ExtendData_Current = <0x00 0x00 0x00 0x00 0x00 0x00 0x00 0x00>;
			};
		};
	};

	__fixups__ {
		mediatek_ldm = "/fragment@0:target:0";
	};
};
