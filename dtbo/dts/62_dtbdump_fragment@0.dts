/dts-v1/;

/ {

	fragment@0 {
		target = <0xffffffff>;

		__overlay__ {

			ir {
				key = <0x11 0x00 0x00 0x16 0x2c 0x00 0xd5 0x00 0x74 0x00 0x11 0x00 0x00 0x16 0x2c 0x00 0xf7 0x00 0x66 0x00 0x11 0x00 0x00 0x16 0x2c 0x00 0x10 0x00 0x10 0x00 0x11 0x00 0x00 0x16 0x2c 0x00 0x3d 0x02 0x00 0x00 0x00 0x00 0x00 0x00 0x00 0x00 0x00 0x00 0x00 0x00 0x00 0x00 0x00 0x00 0x00 0x00 0x00 0x00 0x00 0x00 0x00 0x00 0x00 0x00 0x00 0x00 0x00 0x00 0x00 0x00 0x00 0x00 0x00 0x00 0x00 0x00 0x00 0x00 0x00 0x00 0x00 0x00 0x00 0x00 0x00 0x00 0x00 0x00 0x00 0x00 0x00 0x00 0x00 0x00 0x00 0x00 0x00 0x00 0x00 0x00 0x00 0x00 0x00 0x00 0x00 0x00 0x00 0x00 0x00 0x00 0x00 0x00 0x00 0x00 0x00 0x00 0x00 0x00 0x00 0x00 0x00 0x00 0x00 0x00 0x00 0x00 0x00 0x00 0x00 0x00 0x00 0x00 0x00 0x00 0x00 0x00 0x00 0x00 0x00 0x00 0x00 0x00 0x00 0x00 0x00 0x00 0x00 0x00 0x00 0x00 0x00 0x00 0x00 0x00 0x00 0x00 0x00 0x00 0x00 0x00 0x00 0x00 0x00 0x00 0x00 0x00 0x00 0x00 0x00 0x00 0x00 0x00 0x00 0x00 0x00 0x00 0x00 0x00 0x00 0x00 0x00 0x00 0x00 0x00 0x00 0x00 0x00 0x00 0x00 0x00 0x00 0x00 0x00 0x00 0x00 0x00 0x00 0x00 0x00 0x00 0x00 0x00 0x00 0x00 0x00 0x00 0x00 0x00 0x00 0x00 0x00 0x00 0x00 0x00 0x00 0x00 0x00 0x00 0x00 0x00>;
				phandle = <0x01>;
			};

			sar {
				wakeup-ch = <0x00>;
				wakeup-lb = <0x05>;
				wake-adc = <0x05 0x3ff 0x3ff 0x3ff 0x3ff>;
				upgrade-ch = <0x00>;
				upgrade-lb = <0xff>;
				upgrade-adc = <0x05 0x3ff 0x3ff 0x3ff 0x3ff>;
				phandle = <0x02>;
			};
		};
	};

	__symbols__ {
		ir_wake = "/fragment@0/__overlay__/ir";
		ir_sar = "/fragment@0/__overlay__/sar";
	};

	__fixups__ {
		pmu_ini = "/fragment@0:target:0";
	};
};
