/dts-v1/;

/ {

	fragment@0 {
		target = <0xffffffff>;

		__overlay__ {
			pinctrl-mt5896,pins = <0x08 0x00 0x04 0x00 0x20 0x00 0x0c 0x00>;
			pinctrl-mt5896,drive-strength = <0x07 0x03>;
			pinctrl-mtk,pins = <0x08 0x07 0x03 0x04 0x07 0x03 0x20 0x07 0x03 0x0c 0x07 0x03>;
		};
	};

	fragment@1 {
		target = <0xffffffff>;

		__overlay__ {
			pinctrl-mt5896,pins = <0x344 0x00 0x33c 0x00 0x340 0x00 0x338 0x00>;
			pinctrl-mt5896,drive-strength = <0x07 0x03>;
			pinctrl-mtk,pins = <0x344 0x07 0x03 0x33c 0x07 0x03 0x340 0x07 0x03 0x338 0x07 0x03>;
		};
	};

	fragment@2 {
		target = <0xffffffff>;

		__overlay__ {
			pinctrl-names = "default";
			pinctrl-0 = <0xffffffff 0xffffffff>;
		};
	};

	__fixups__ {
		ld0_spi_pcfg = "/fragment@0:target:0\0/fragment@2/__overlay__:pinctrl-0:0";
		ld1_spi_pcfg = "/fragment@1:target:0\0/fragment@2/__overlay__:pinctrl-0:4";
		pinctrl = "/fragment@2:target:0";
	};
};
