/dts-v1/;

/ {

	fragment@0 {
		target = <0xffffffff>;

		__overlay__ {

			ir_keymap0 {
				protocol = <0x13>;
				keymap_name = "AEHA_TV";
				customercode = <0x162c>;
				ir_key_table = <0x74 0xd5 0x02 0xce 0x03 0xcd 0x04 0xcc 0x05 0xcb 0x06 0xca 0x07 0xc9 0x08 0xc8 0x09 0xc7 0x0a 0xc6 0x0b 0x50 0x1ab 0x51 0x1ac 0x52 0x67 0xa6 0x6c 0xa7 0x69 0xa9 0x6a 0xa8 0x1c 0x0b 0x9e 0xd8 0x1d7 0x5c 0x73 0xd0 0x72 0xd1 0x192 0xd2 0x193 0xd3 0x231 0x30 0x66 0xf7 0x191 0x27 0x18e 0xff 0x190 0x1b 0x18f 0x17 0x236 0x10 0x23a 0x25 0x1b8 0x3a 0x1b9 0x3c 0x239 0x1d 0x1ae 0x59 0x16d 0xe5 0x8b 0x13 0x1af 0x55 0x1b6 0x5f 0x1b7 0x5b 0xa7 0xe8 0x1b2 0x5d 0xc3 0xc3 0x172 0x7f 0x188 0xa5 0x23e 0x45 0x23f 0xea 0xc9 0xe6 0x240 0xac 0x243 0xe2 0x242 0xe0 0x241 0xe3 0x1c4 0x53 0x2bf 0x8a 0x22b 0xa3 0x22f 0xad 0x24c 0x60 0x2f0 0x3e 0x15f 0xeb 0x1c8 0x1c 0x71 0xc0 0x15b 0x86 0x200 0x3d 0x2a0 0x41 0x2a1 0x42 0x2a2 0x43 0x2a3 0x44 0x2a4 0x0e 0x2a5 0x56 0x2a6 0x57 0x2a7 0x58 0x2a8 0x90 0x2a9 0x91 0x2aa 0x92 0x2ab 0x93 0x2ac 0x94 0x2ad 0x95 0x2ae 0x96 0x2af 0x97 0x2b0 0x02 0x2b1 0x03 0x2b2 0x04 0x2b3 0x05 0x2b4 0x07 0x2b5 0x08 0x2b6 0x09 0x2b7 0x0a>;
			};
		};
	};

	__fixups__ {
		ir_in = "/fragment@0:target:0";
	};
};
