/dts-v1/;

/ {

	fragment@0 {
		target = <0xffffffff>;

		__overlay__ {
			pinctrl-names = "default";
			pinctrl-0 = <0xffffffff>;
		};
	};

	__fixups__ {
		i2c2 = "/fragment@0:target:0";
		i2c2_pmux = "/fragment@0/__overlay__:pinctrl-0:0";
	};
};
