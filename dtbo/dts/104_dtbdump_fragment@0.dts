/dts-v1/;

/ {

	fragment@0 {
		target = <0xffffffff>;

		__overlay__ {
			pinctrl-names = "default";
			pinctrl-0 = <0xffffffff>;
		};
	};

	__fixups__ {
		mspi0 = "/fragment@0:target:0";
		mspi_demod_pmux = "/fragment@0/__overlay__:pinctrl-0:0";
	};
};
