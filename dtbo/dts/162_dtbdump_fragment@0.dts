/dts-v1/;

/ {

	fragment@0 {
		target = <0xffffffff>;

		__overlay__ {

			ir_keymap0 {
				protocol = <0x01>;
				keymap_name = "mtk-tv";
				customercode = <0x807f>;
				ir_key_table = <0x74 0x46 0x0b 0x50 0x02 0x49 0x03 0x55 0x04 0x59 0x05 0x4d 0x06 0x51 0x07 0x5d 0x08 0x48 0x09 0x54 0x0a 0x58 0x18e 0x47 0x18f 0x4b 0x190 0x57 0x191 0x5b 0x67 0x52 0x6c 0x13 0x69 0x06 0x6a 0x1a 0x1c 0x0f 0x192 0x1f 0x193 0x19 0x73 0x16 0x72 0x15 0x68 0x03 0x6d 0x05 0x66 0x17 0x8b 0x07 0x9e 0x1b 0x71 0x5a 0xa7 0x0d 0x8a 0x42 0xc3 0x14 0x52 0x40 0x4f 0x04 0x247 0x21 0xa8 0x0e 0x9f 0x12 0xa5 0x02 0xa3 0x1e 0xcf 0x01 0x77 0x1d 0x80 0x11 0x188 0x44 0xd4 0x56 0x174 0x4c 0x16b 0x5c 0x8e 0x45 0x16d 0x4a 0x18b 0x10 0x172 0x53 0x1d2 0x41 0x1d2 0x26 0x1d3 0x4e 0x1d4 0x0a 0x1d4 0x23 0x1d5 0x09 0x1d6 0x1c 0x1d7 0x08 0x3b 0x0b 0x3c 0x18 0x3d 0x00 0x3e 0x0c 0x3f 0x4f 0x40 0x5e 0x41 0x43 0x42 0x5f 0x164 0xfe 0x160 0xff 0x58 0x22 0xbe 0x64 0x16c 0x24 0x1d9 0x31 0x1da 0x32 0x26e 0x25>;
			};

			ir_keymap1 {
				protocol = <0x01>;
				keymap_name = "Android_TV";
				customercode = <0x8877>;
				ir_key_table = <0x74 0x21 0x4f 0x60 0x02 0x01 0x03 0x02 0x04 0x03 0x05 0x04 0x06 0x05 0x07 0x06 0x08 0x07 0x09 0x08 0x0a 0x09 0x172 0x58 0x0b 0x0a 0xc3 0x29 0x18e 0x4b 0x18f 0x4a 0x190 0x49 0x191 0x4c 0xf9 0x0f 0x1d6 0x10 0x247 0x46 0xd9 0x0f 0x67 0x15 0x69 0x17 0x1c 0x19 0x6a 0x18 0x6c 0x16 0x9e 0x48 0x66 0x47 0x8a 0x32 0x73 0x23 0x72 0x24 0x71 0x25 0x192 0x33 0x193 0x34 0xbb 0x63 0xbe 0x64 0xc1 0x67 0xc2 0x68 0x16c 0x74 0x1d9 0x10 0x1da 0x59>;
			};

			ir_keymap2 {
				protocol = <0x01>;
				keymap_name = "TEST-tv";
				customercode = <0x40bf>;
				ir_key_table = <0x74 0x12 0x0b 0x00 0x02 0x01 0x03 0x02 0x04 0x03 0x05 0x04 0x06 0x05 0x07 0x06 0x08 0x07 0x09 0x08 0x0a 0x09 0x247 0x21 0x18e 0x4a 0x18f 0x4b 0x190 0x4c 0x191 0x4d 0x67 0x1b 0x6c 0x1f>;
			};
		};
	};

	__fixups__ {
		ir_in = "/fragment@0:target:0";
	};
};
