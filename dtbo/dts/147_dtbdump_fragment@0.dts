/dts-v1/;

/ {

	fragment@0 {
		target = <0xffffffff>;

		__overlay__ {

			hw_reserved_1 {
				reg = <0x00 0x20000000 0x00 0x6000000>;
				no-map;
			};

			hw_reserved_2 {
				reg = <0x00 0x5b000000 0x00 0x300000>;
				no-map;
			};

			hw_reserved_3 {
				reg = <0x00 0x5b315000 0x00 0x20eb000>;
				no-map;
			};

			default_cma {
				compatible = "shared-dma-pool";
				reg = <0x00 0x9fc00000 0x00 0x400000>;
				reusable;
				linux,cma-default;
			};

			nullmem_1 {
				device_type = "mtk-nullmem";
				reg = <0x00 0x3000000 0x00 0x10000000>;
			};

			reserved_local_dimming {
				reg = <0x00 0x5dc00000 0x00 0x600000>;
				reusable;
				mediatek,mpu-nomap;
			};

			frc_dma_pool@frc0 {
				compatible = "shared-dma-pool";
				reg = <0x00 0x5b300000 0x00 0x15000>;
				no-map;
			};

			cma_23 {
				compatible = "shared-dma-pool";
				heap_name = "OTHERS_RETURN";
				reg = <0x00 0x5d400000 0x00 0x800000>;
				reusable;
			};

			iommu_carveout@cv0 {
				reg = <0x00 0x5afff000 0x00 0x1000>;
				mediatek,mpu-map;
			};
		};
	};

	__fixups__ {
		reserved_memory = "/fragment@0:target:0";
	};
};
