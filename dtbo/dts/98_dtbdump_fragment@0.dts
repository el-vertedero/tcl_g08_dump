/dts-v1/;

/ {

	fragment@0 {
		target = <0xffffffff>;

		__overlay__ {
			tcon_dlg-gpios = <0xffffffff 0xc2 0x00>;
			panel_info_name_list = "panel_info\0panel_info_vby1_3840x2160_50\0panel_info_vby1_3840x2160_48\0panel_info_DLG\0panel_info_vby1_3840x1080_100";

			panel_info {
				panel_name = "4K60_PANEL_12LANE_2DIV";
				link_type = <0x01>;
				vbo_byte_mode = <0x04>;
				div_section = <0x02>;
				on_timing1 = <0x1e>;
				on_timing2 = <0xc8>;
				off_timing1 = <0xdc>;
				off_timing2 = <0x0a>;
				hsync_start = <0x00>;
				hsync_width = <0x1e>;
				hsync_polarity = <0x01>;
				vsync_start = <0x42>;
				vsync_width = <0x03>;
				vsync_polarity = <0x01>;
				de_hstart = <0xa8>;
				de_vstart = <0x4e>;
				resolution_width = <0xf00>;
				resolution_height = <0x870>;
				max_h_total = <0x1194>;
				typ_h_total = <0x1130>;
				min_h_total = <0x10cc>;
				max_v_total = <0xb54>;
				typ_v_total = <0x8ca>;
				min_v_total = <0x8c4>;
				max_v_total_panelprotect = <0x1662>;
				min_v_total_panelprotect = <0x8c4>;
				typ_clk_high = <0x00>;
				typ_clk_low = <0x2367b880>;
				output_format = <0x00>;
				content_output_format = <0x00>;
				output_color_range = <0x01>;
				output_color_space = <0x00>;
				vrr_en = <0x00>;
				min_vrr_framerate = <0x1e0>;
				max_vrr_framerate = <0x4e2>;
				graphic_mixer1_outmode = <0x00>;
				graphic_mixer2_outmode = <0x01>;
				GameDirectFrameRateGroup = <0x01>;
				dlg_on = <0x00>;
			};

			panel_info_vby1_3840x2160_50 {
				panel_name = "4K50_PANEL_12LANE_2DIV";
				link_type = <0x01>;
				vbo_byte_mode = <0x04>;
				div_section = <0x02>;
				on_timing1 = <0x1e>;
				on_timing2 = <0xc8>;
				off_timing1 = <0xdc>;
				off_timing2 = <0x0a>;
				hsync_start = <0x00>;
				hsync_width = <0x1e>;
				hsync_polarity = <0x01>;
				vsync_start = <0x42>;
				vsync_width = <0x03>;
				vsync_polarity = <0x01>;
				de_hstart = <0xa8>;
				de_vstart = <0x4e>;
				resolution_width = <0xf00>;
				resolution_height = <0x870>;
				max_h_total = <0x1194>;
				typ_h_total = <0x1130>;
				min_h_total = <0x10cc>;
				max_v_total = <0xb0e>;
				typ_v_total = <0xa8c>;
				min_v_total = <0xa0a>;
				max_v_total_panelprotect = <0x1662>;
				min_v_total_panelprotect = <0x8c4>;
				typ_clk_high = <0x00>;
				typ_clk_low = <0x2367b880>;
				output_format = <0x00>;
				content_output_format = <0x00>;
				output_color_range = <0x01>;
				output_color_space = <0x00>;
				vrr_en = <0x00>;
				min_vrr_framerate = <0x1e0>;
				max_vrr_framerate = <0x4e2>;
				graphic_mixer1_outmode = <0x00>;
				graphic_mixer2_outmode = <0x01>;
				GameDirectFrameRateGroup = <0x01>;
				dlg_on = <0x00>;
			};

			panel_info_vby1_3840x2160_48 {
				panel_name = "4K48_PANEL_12LANE_2DIV";
				link_type = <0x01>;
				vbo_byte_mode = <0x04>;
				div_section = <0x02>;
				on_timing1 = <0x1e>;
				on_timing2 = <0xc8>;
				off_timing1 = <0xdc>;
				off_timing2 = <0x0a>;
				hsync_start = <0x00>;
				hsync_width = <0x1e>;
				hsync_polarity = <0x01>;
				vsync_start = <0x42>;
				vsync_width = <0x03>;
				vsync_polarity = <0x01>;
				de_hstart = <0xa8>;
				de_vstart = <0x4e>;
				resolution_width = <0xf00>;
				resolution_height = <0x870>;
				max_h_total = <0x1194>;
				typ_h_total = <0x1130>;
				min_h_total = <0x10cc>;
				max_v_total = <0xb38>;
				typ_v_total = <0xafc>;
				min_v_total = <0xac3>;
				max_v_total_panelprotect = <0x1662>;
				min_v_total_panelprotect = <0x8c4>;
				typ_clk_high = <0x00>;
				typ_clk_low = <0x2367b880>;
				output_format = <0x00>;
				content_output_format = <0x00>;
				output_color_range = <0x01>;
				output_color_space = <0x00>;
				vrr_en = <0x00>;
				min_vrr_framerate = <0x1e0>;
				max_vrr_framerate = <0x4e2>;
				graphic_mixer1_outmode = <0x00>;
				graphic_mixer2_outmode = <0x01>;
				GameDirectFrameRateGroup = <0x01>;
				dlg_on = <0x00>;
			};

			panel_info_DLG {
				panel_name = "4K1K120_PANEL_12LANE_2DIV";
				link_type = <0x01>;
				vbo_byte_mode = <0x04>;
				div_section = <0x02>;
				on_timing1 = <0x1e>;
				on_timing2 = <0xc8>;
				off_timing1 = <0xdc>;
				off_timing2 = <0x0a>;
				hsync_start = <0x00>;
				hsync_width = <0x1e>;
				hsync_polarity = <0x01>;
				vsync_start = <0x1b>;
				vsync_width = <0x03>;
				vsync_polarity = <0x01>;
				de_hstart = <0xa8>;
				de_vstart = <0x27>;
				resolution_width = <0xf00>;
				resolution_height = <0x438>;
				max_h_total = <0x1194>;
				typ_h_total = <0x1130>;
				min_h_total = <0x10cc>;
				max_v_total = <0x578>;
				typ_v_total = <0x465>;
				min_v_total = <0x45f>;
				max_v_total_panelprotect = <0x1662>;
				min_v_total_panelprotect = <0x45f>;
				typ_clk_high = <0x00>;
				typ_clk_low = <0x2367b880>;
				output_format = <0x00>;
				content_output_format = <0x00>;
				output_color_range = <0x01>;
				output_color_space = <0x00>;
				vrr_en = <0x00>;
				min_vrr_framerate = <0x1e0>;
				max_vrr_framerate = <0x4e2>;
				graphic_mixer1_outmode = <0x00>;
				graphic_mixer2_outmode = <0x01>;
				GameDirectFrameRateGroup = <0x01>;
				dlg_on = <0x01>;
			};

			panel_info_vby1_3840x1080_100 {
				panel_name = "4K1K100_PANEL_12LANE_2DIV";
				link_type = <0x01>;
				vbo_byte_mode = <0x04>;
				div_section = <0x02>;
				on_timing1 = <0x1e>;
				on_timing2 = <0xc8>;
				off_timing1 = <0xdc>;
				off_timing2 = <0x0a>;
				hsync_start = <0x00>;
				hsync_width = <0x1e>;
				hsync_polarity = <0x01>;
				vsync_start = <0x1b>;
				vsync_width = <0x03>;
				vsync_polarity = <0x01>;
				de_hstart = <0xa8>;
				de_vstart = <0x27>;
				resolution_width = <0xf00>;
				resolution_height = <0x438>;
				max_h_total = <0x1194>;
				typ_h_total = <0x1130>;
				min_h_total = <0x10cc>;
				max_v_total = <0x578>;
				typ_v_total = <0x546>;
				min_v_total = <0x524>;
				max_v_total_panelprotect = <0x1662>;
				min_v_total_panelprotect = <0x462>;
				typ_clk_high = <0x00>;
				typ_clk_low = <0x2367b880>;
				output_format = <0x00>;
				content_output_format = <0x00>;
				output_color_range = <0x01>;
				output_color_space = <0x00>;
				vrr_en = <0x00>;
				min_vrr_framerate = <0x1e0>;
				max_vrr_framerate = <0x4e2>;
				graphic_mixer1_outmode = <0x00>;
				graphic_mixer2_outmode = <0x01>;
				GameDirectFrameRateGroup = <0x01>;
				dlg_on = <0x01>;
			};

			panel_tgen_info {
				panel_tgen_max_vtotal = <0x1662>;
				panel_tgen_min_vtotal = <0x45f>;
			};

			panel-color-info {
				COLOR_SPACE = <0x04>;
				COLOR_FORAMT = <0x00>;
				COLOR_RANGE = <0x03>;
				Rx = <0x7d00>;
				Rx_variation = <0x64>;
				Ry = <0x4047>;
				Ry_variation = <0x64>;
				Gx = <0x3a98>;
				Gx_variation = <0x64>;
				Gy = <0x7530>;
				Gy_variation = <0x64>;
				Bx = <0x1d4c>;
				Bx_variation = <0x64>;
				By = <0xbb8>;
				By_variation = <0x64>;
				Wx = <0x3d13>;
				Wx_variation = <0x64>;
				Wy = <0x4042>;
				Wy_variation = <0x64>;
				MaxLuminance = <0x64>;
				MedLuminance = <0x32>;
				MinLuminance = <0x1f4>;
				LinearRGB = <0x01>;
				HDRPanelNits = <0x18f>;
				DynamicLuminance = <0x00>;
			};

			usr_lane_order {
				usr_define = <0x01>;
				ctrl_lanes = <0x20>;
				laneorder = <0x00 0x01 0x02 0x03 0x08 0x09 0x0a 0x0b 0x04 0x05 0x06 0x07 0x0c 0x0d 0x0e 0x0f 0x04 0x05 0x06 0x07 0x0c 0x0d 0x0e 0x0f 0x14 0x15 0x16 0x17 0x1c 0x1d 0x1e 0x1f>;
			};

			panel-dither-info {
				dither_out_depth = <0x01>;
				dither_pattern_type = <0x03>;
				dither_capability = <0x00>;
			};

			ext_graph_combo_info {
				graph_vbo_byte_mode = <0x04>;
			};

			output_swing_info {
				swing_usr_define = <0x00>;
				common_swing = <0x00>;
				swing_ctrl_lane = <0x0c>;
				swing_level = <0x5a 0x55 0x50 0x46 0x3c 0x41 0x41 0x46 0x46 0x4b 0x41 0x46>;
			};

			output_pre_emphasis {
				pe_usr_define = <0x00>;
				common_pe = <0x00>;
				pe_ctrl_lane = <0x0c>;
				pe_level = <0x07 0x07 0x05 0x03 0x00 0x07 0x07 0x07 0x07 0x07 0x02 0x02>;
			};

			pmic_info {
				pmic_info_version = <0x01>;
				pmic_info_length = <0x00>;
				pmic_type = <0x01>;
				pmic_bin_file_path = "tcon/FT430GT03-1/tcon_pmu.bin";
				pmic_bin_format_type = <0x00>;
				pmic_force_init = <0x01>;
				pmic_with_nvm = <0x00>;
				pmic_i2c_bus = <0x02>;
				pmic_i2c_mode = <0x01>;
				pmic_i2c_dev_addr = <0x33>;
				pmic_i2c_reg_offst = <0x00>;
				pmic_pre_gpio_num = <0x00>;
				pmic_pre_gpio_ops = <0x00>;
				pmic_pre_delay = <0x0a>;
				pmic_post_gpio_num = <0x00>;
				pmic_post_gpio_ops = <0x00>;
				pmic_post_delay = <0x0a>;
				pmic_auto_from_flash = <0x09>;
				pimc_data_start = <0x00>;
				pimc_data_end = <0x04>;
			};

			pgamma_info {
				pgamma_info_version = <0x00>;
				pgamma_info_length = <0x00>;
				pgamma_type = <0x00>;
				pgamma_bin_file_path = "FT430GT03-1/tcon_p_gamma.bin";
				pgamma_bin_format_type = <0x00>;
				pgamma_force_init = <0x00>;
				pgamma_with_nvm = <0x00>;
				pgamma_i2c_bus = <0x02>;
				pgamma_i2c_mode = <0x01>;
				pgamma_i2c_dev_addr = <0x28>;
				pgamma_i2c_reg_offst = <0x00>;
				pgamma_pre_gpio_num = <0x00>;
				pgamma_pre_gpio_ops = <0x00>;
				pgamma_pre_delay = <0x0a>;
				pgamma_post_gpio_num = <0x00>;
				pgamma_post_gpio_ops = <0x00>;
				pgamma_post_delay = <0x0a>;
				pgamma_auto_from_flash = <0x00>;
			};

			levelshift_info {
				levelshift_info_version = <0x00>;
				levelshift_info_length = <0x00>;
				levelshift_type = <0x00>;
				levelshift_bin_file_path = "tcon/4k120/RT8949_B.bin";
				levelshift_bin_format_type = <0x00>;
				levelshift_force_init = <0x00>;
				levelshift_with_nvm = <0x00>;
				levelshift_i2c_bus = <0x02>;
				levelshift_i2c_mode = <0x01>;
				levelshift_i2c_dev_addr = <0x29>;
				levelshift_i2c_reg_offst = <0x00>;
				levelshift_pre_gpio_num = <0x00>;
				levelshift_pre_gpio_ops = <0x00>;
				levelshift_pre_delay = <0x00>;
				levelshift_post_gpio_num = <0x00>;
				levelshift_post_gpio_ops = <0x00>;
				levelshift_post_delay = <0x00>;
				levelshift_auto_from_flash = <0x00>;
			};

			vcomic_info {
				vcomic_info_version = <0x00>;
				vcomic_info_length = <0x00>;
				vcomic_type = <0x00>;
				vcomic_bin_file_path = [00];
				vcomic_bin_format_type = <0x00>;
				vcomic_force_init = <0x00>;
				vcomic_with_nvm = <0x00>;
				vcomic_i2c_bus = <0x00>;
				vcomic_i2c_mode = <0x00>;
				vcomic_i2c_dev_addr = <0x00>;
				vcomic_i2c_reg_offst = <0x00>;
				vcomic_pre_gpio_num = <0x00>;
				vcomic_pre_gpio_ops = <0x00>;
				vcomic_pre_delay = <0x00>;
				vcomic_post_gpio_num = <0x00>;
				vcomic_post_gpio_ops = <0x00>;
				vcomic_post_delay = <0x00>;
				vcomic_auto_from_flash = <0x00>;
			};

			spread_spectrum_info {
				ssc_ctrl_en = <0x01>;
				ssc_modulation = <0x1e>;
				ssc_deviation = <0x64>;
			};

			tconless_model_info {
				higt_frame_rate_bin_path = "tcon/FT430GT03-1/tcon_data_dlg.bin";
				higt_pixel_clock_bin_path = [00];
				game_mode_bin_path = [00];
				higt_frame_rate_gamma_bin_path = "tcon/FT430GT03-1/tcon_acc_dlg.bin";
				higt_pixel_clock_gamma_bin_path = [00];
				game_mode_gamma_bin_path = [00];
				power_seq_on_bin_path = "tcon/4k120/TCON20_POST.bin";
				power_seq_off_bin_path = "tcon/4k120/TCON20_PRE.bin";
			};

			tcon_info {
				bVRR_HighFrameRateMode_Support = <0x00>;
				ucVRR_HFR_ON_I2C_DATA_SIZE = <0x07>;
				ucVRR_HFR_ON_I2C_DATA_0 = <0xcd>;
				ucVRR_HFR_ON_I2C_DATA_1 = <0x02>;
				ucVRR_HFR_ON_I2C_DATA_2 = <0x00>;
				ucVRR_HFR_ON_I2C_DATA_3 = <0x00>;
				ucVRR_HFR_ON_I2C_DATA_4 = <0x00>;
				ucVRR_HFR_ON_I2C_DATA_5 = <0x00>;
				ucVRR_HFR_ON_I2C_DATA_6 = <0x00>;
				ucVRR_HFR_OFF_I2C_DATA_SIZE = <0x07>;
				ucVRR_HFR_OFF_I2C_DATA_0 = <0xcd>;
				ucVRR_HFR_OFF_I2C_DATA_1 = <0x02>;
				ucVRR_HFR_OFF_I2C_DATA_2 = <0x01>;
				ucVRR_HFR_OFF_I2C_DATA_3 = <0x00>;
				ucVRR_HFR_OFF_I2C_DATA_4 = <0x00>;
				ucVRR_HFR_OFF_I2C_DATA_5 = <0x00>;
				ucVRR_HFR_OFF_I2C_DATA_6 = <0x00>;
				ucVRR_HFR_ON_I2C_bus = <0x02>;
				ucVRR_HFR_ON_I2C_mode = <0x01>;
				ucVRR_HFR_ON_I2C_dev_addr = <0x70>;
				ucVRR_HFR_ON_I2C_offst = <0x00>;
				bVRR_HighPixelClockMode_Support = <0x00>;
				bGAME_Direct60HzMode_Support = <0x00>;
				ucGAME_60HZ_ON_I2C_DATA_SIZE = <0x00>;
				ucGAME_60HZ_ON_I2C_DATA_0 = <0x00>;
				ucGAME_60HZ_ON_I2C_DATA_1 = <0x00>;
				ucGAME_60HZ_OFF_I2C_DATA_SIZE = <0x00>;
				ucGAME_60HZ_OFF_I2C_DATA_0 = <0x00>;
				ucGAME_60HZ_OFF_I2C_DATA_1 = <0x00>;
				bSupportGpioModeChange = <0x00>;
				u16GPIO_NUM_MODE_CHG = <0xc2>;
				ucGPIO_CTRL_MODE_CHG_ON = <0x01>;
				ucGPIO_CTRL_MODE_CHG_OFF = <0x00>;
				u16DELAY_MODE_CHG = <0x00>;
				bSupportTconI2cWP = <0x00>;
				u16GPIO_NUM_TCON_I2C_WP = <0xc2>;
				ucGPIO_TCON_I2C_WP_ON = <0x00>;
				ucGPIO_TCON_I2C_WP_OFF = <0x01>;
			};

			vrr_hfr_pmic_i2c_ctrl {
				bSupportVrrHfrTconPmicI2cSet = <0x00>;
				ucVRR_HFR_PMIC_I2C_PRE_DELAY = <0x0a>;
				ucVRR_HFR_PMIC_I2C_SLAVE_ADDR = <0x66>;
				ucVRR_HFR_ON_PMIC_I2C_ADDR_SIZE = <0x01>;
				ucVRR_HFR_ON_PMIC_I2C_ADDR_0 = <0x00>;
				ucVRR_HFR_ON_PMIC_I2C_DATA_SIZE = <0x01>;
				ucVRR_HFR_ON_PMIC_I2C_DATA_1 = <0x58>;
				ucVRR_HFR_ON_PMIC_I2C_DATA_2 = <0x00>;
				ucVRR_HFR_OFF_PMIC_I2C_ADDR_SIZE = <0x01>;
				ucVRR_HFR_OFF_PMIC_I2C_ADDR_0 = <0x00>;
				ucVRR_HFR_OFF_PMIC_I2C_DATA_SIZE = <0x01>;
				ucVRR_HFR_OFF_PMIC_I2C_DATA_1 = <0x48>;
				ucVRR_HFR_OFF_PMIC_I2C_DATA_2 = <0x00>;
			};
		};
	};

	fragment@1 {
		target = <0xffffffff>;

		__overlay__ {
			PanelGamma_Enable = <0x01>;
			PanelGamme_BinPath = "tcon/FT430GT03-1/tcon_acc.bin";
			TCON_Enable = <0x01>;
			TCON_BinPath = "tcon/FT430GT03-1/tcon_data.bin";
			PanelMirrorMode = <0x00>;
			PanelOutputFormat = <0x00>;
			SSC_Enable = <0x00>;
			SSC_Step = <0x00>;
			SSC_Span = <0x00>;
			OverDrive_Enable = <0x01>;
			OverDrive_Buf_Addr = <0x00>;
			OverDrive_Buf_Size = <0x00>;
			GPIO_Backlight = <0x00>;
			GPIO_VCC = <0x00>;
			M_delta = <0x7fff>;
			CustomerColorPrimaries = <0x00>;
			SourceWx = <0x3d13>;
			SourceWy = <0x4042>;
			VIDEO_GFX_DISPLAY_MODE = <0x00>;
			OSD_Height = <0x870>;
			OSD_Width = <0xf00>;
			OSD_HsyncStart = <0x00>;
			OSD_HsyncEnd = <0x00>;
			OSD_HDEStart = <0x00>;
			OSD_HDEEnd = <0x00>;
			OSD_HTotal = <0x00>;
			OSD_VsyncStart = <0x00>;
			OSD_VsyncEnd = <0x00>;
			OSD_VDEStart = <0x00>;
			OSD_VDEEnd = <0x00>;
			OSD_VTotal = <0x00>;
			cus_x_dpi = <0x51>;
			cus_y_dpi = <0x4e>;
			u32PeriodPWM = <0x54c563>;
			u32DutyPWM = <0x54c563>;
			u16DivPWM = <0x00>;
			bPolPWM = <0x00>;
			u32MaxPWMvalue = <0x54c563>;
			u32MinPWMvalue = <0x43d11>;
			u16PWMPort = <0x00>;
			u32Period_2ndPWM = <0xd903>;
			u32Duty_2ndPWM = <0x411a>;
			u16Div_2ndPWM = <0x00>;
			bPol_2ndPWM = <0x00>;
			u32Max_2ndPWMvalue = <0xd903>;
			u32Min_2ndPWMvalue = <0xd05>;
			u16PWM_2ndPort = <0x02>;
			graphic_mixer1_outmode = <0x00>;
			graphic_mixer2_outmode = <0x01>;
			panel_frc_table_type = <0x00>;
			RENDER_IN_COLOR_FORMAT = <0x01>;
			RENDER_IN_COLOR_RANGE = <0x01>;
			RENDER_IN_COLOR_SPACE = <0x00>;
			DLG_Enable = <0x00>;
			DLG_GPIO_CusCtrl = <0x00>;
			DLG_I2C_CusCtrl = <0x00>;
			Auto_PanelGamma = <0x00>;
			p2p_cmd_update = <0x00>;
			Global_Mute_Delay = <0x78>;
			Global_Unmute_Delay = <0x96>;
			GameDirectFrameRateMode = <0x00>;
		};
	};

	fragment@2 {
		target = <0xffffffff>;

		__overlay__ {
			tcon_i2c_name_list = "default_tcon_i2c";

			default_tcon_i2c {
				tcon_i2c_bus = <0x02>;
				tcon_i2c_mode = <0x01>;
				tcon_i2c_dev_addr = <0x40>;
				tcon_i2c_reg_offst = <0x00>;
				tcon_i2c_info_length = <0x01>;
				tcon_i2c_info_row = <0x01>;
				tcon_i2c_info_column_num = <0x01>;
				tcon_i2c_info_data = <0x00>;
			};
		};
	};

	fragment@3 {
		target = <0xffffffff>;

		__overlay__ {
			vrr_od_enable = <0x00>;
			vrr_od_table_list = "VRR_OD_tab_0\0VRR_OD_tab_1\0VRR_OD_tab_2\0VRR_OD_tab_3\0VRR_OD_tab_4\0VRR_OD_tab_5\0VRR_OD_tab_6\0VRR_OD_tab_7\0VRR_OD_tab_8\0VRR_OD_tab_9";

			VRR_OD_tab_0 {
				vrr_od_table_en = <0x00>;
				vrr_od_table_idx = <0x00>;
				vrr_od_lo_bound = <0x00>;
				vrr_od_hi_bound = <0x41>;
				vrr_od_file = "tcon/FT430GT03-1/tcon_data.bin";
			};

			VRR_OD_tab_1 {
				vrr_od_table_en = <0x00>;
				vrr_od_table_idx = <0x01>;
				vrr_od_lo_bound = <0x42>;
				vrr_od_hi_bound = <0x7b>;
				vrr_od_file = "tcon/FT430GT03-1/tcon_data.bin";
			};

			VRR_OD_tab_2 {
				vrr_od_table_en = <0x00>;
				vrr_od_table_idx = <0x02>;
				vrr_od_lo_bound = <0x7c>;
				vrr_od_hi_bound = <0x92>;
				vrr_od_file = [00];
			};

			VRR_OD_tab_3 {
				vrr_od_table_en = <0x00>;
				vrr_od_table_idx = <0x03>;
				vrr_od_lo_bound = <0x93>;
				vrr_od_hi_bound = <0x96>;
				vrr_od_file = [00];
			};

			VRR_OD_tab_4 {
				vrr_od_table_en = <0x00>;
				vrr_od_table_idx = <0x04>;
				vrr_od_lo_bound = <0x00>;
				vrr_od_hi_bound = <0x96>;
				vrr_od_file = [00];
			};

			VRR_OD_tab_5 {
				vrr_od_table_en = <0x00>;
				vrr_od_table_idx = <0x05>;
				vrr_od_lo_bound = <0x00>;
				vrr_od_hi_bound = <0x96>;
				vrr_od_file = [00];
			};

			VRR_OD_tab_6 {
				vrr_od_table_en = <0x00>;
				vrr_od_table_idx = <0x06>;
				vrr_od_lo_bound = <0x00>;
				vrr_od_hi_bound = <0x96>;
				vrr_od_file = [00];
			};

			VRR_OD_tab_7 {
				vrr_od_table_en = <0x00>;
				vrr_od_table_idx = <0x07>;
				vrr_od_lo_bound = <0x00>;
				vrr_od_hi_bound = <0x96>;
				vrr_od_file = [00];
			};

			VRR_OD_tab_8 {
				vrr_od_table_en = <0x00>;
				vrr_od_table_idx = <0x08>;
				vrr_od_lo_bound = <0x00>;
				vrr_od_hi_bound = <0x96>;
				vrr_od_file = [00];
			};

			VRR_OD_tab_9 {
				vrr_od_table_en = <0x00>;
				vrr_od_table_idx = <0x09>;
				vrr_od_lo_bound = <0x00>;
				vrr_od_hi_bound = <0x96>;
				vrr_od_file = [00];
			};
		};
	};

	fragment@4 {
		target = <0xffffffff>;

		__overlay__ {
			vrr_pga_enable = <0x00>;
			vrr_pga_table_list = "VRR_PGA_tab_0\0VRR_PGA_tab_1\0VRR_PGA_tab_2\0VRR_PGA_tab_3\0VRR_PGA_tab_4\0VRR_PGA_tab_5\0VRR_PGA_tab_6\0VRR_PGA_tab_7\0VRR_PGA_tab_8\0VRR_PGA_tab_9";

			VRR_PGA_tab_0 {
				vrr_pga_table_en = <0x00>;
				vrr_pga_table_idx = <0x00>;
				vrr_pga_lo_bound = <0x00>;
				vrr_pga_hi_bound = <0x41>;
				vrr_pga_file = "tcon/FT430GT03-1/acc_vrr_60.bin";
			};

			VRR_PGA_tab_1 {
				vrr_pga_table_en = <0x00>;
				vrr_pga_table_idx = <0x01>;
				vrr_pga_lo_bound = <0x42>;
				vrr_pga_hi_bound = <0x7d>;
				vrr_pga_file = "tcon/FT430GT03-1/acc_vrr_120.bin";
			};

			VRR_PGA_tab_2 {
				vrr_pga_table_en = <0x00>;
				vrr_pga_table_idx = <0x02>;
				vrr_pga_lo_bound = <0x49>;
				vrr_pga_hi_bound = <0x54>;
				vrr_pga_file = [00];
			};

			VRR_PGA_tab_3 {
				vrr_pga_table_en = <0x00>;
				vrr_pga_table_idx = <0x03>;
				vrr_pga_lo_bound = <0x55>;
				vrr_pga_hi_bound = <0x60>;
				vrr_pga_file = [00];
			};

			VRR_PGA_tab_4 {
				vrr_pga_table_en = <0x00>;
				vrr_pga_table_idx = <0x04>;
				vrr_pga_lo_bound = <0x61>;
				vrr_pga_hi_bound = <0x6c>;
				vrr_pga_file = [00];
			};

			VRR_PGA_tab_5 {
				vrr_pga_table_en = <0x00>;
				vrr_pga_table_idx = <0x05>;
				vrr_pga_lo_bound = <0x6d>;
				vrr_pga_hi_bound = <0x7d>;
				vrr_pga_file = [00];
			};

			VRR_PGA_tab_6 {
				vrr_pga_table_en = <0x00>;
				vrr_pga_table_idx = <0x06>;
				vrr_pga_lo_bound = <0x7e>;
				vrr_pga_hi_bound = <0x84>;
				vrr_pga_file = [00];
			};

			VRR_PGA_tab_7 {
				vrr_pga_table_en = <0x00>;
				vrr_pga_table_idx = <0x07>;
				vrr_pga_lo_bound = <0x85>;
				vrr_pga_hi_bound = <0x92>;
				vrr_pga_file = [00];
			};

			VRR_PGA_tab_8 {
				vrr_pga_table_en = <0x00>;
				vrr_pga_table_idx = <0x08>;
				vrr_pga_lo_bound = <0x93>;
				vrr_pga_hi_bound = <0x96>;
				vrr_pga_file = [00];
			};

			VRR_PGA_tab_9 {
				vrr_pga_table_en = <0x00>;
				vrr_pga_table_idx = <0x09>;
				vrr_pga_lo_bound = <0x00>;
				vrr_pga_hi_bound = <0x96>;
				vrr_pga_file = [00];
			};
		};
	};

	fragment@5 {
		target = <0xffffffff>;

		__overlay__ {
			status = "disable";
			panel_info_name_list = "panel_info\0timing_info_50\0timing_info_48";

			panel_info {
				panel_name = "SONY BE";
				link_type = <0x01>;
				vbo_byte_mode = <0x04>;
				div_section = <0x01>;
				on_timing1 = <0x1e>;
				on_timing2 = <0xc8>;
				off_timing1 = <0xdc>;
				off_timing2 = <0x0a>;
				hsync_start = <0x00>;
				hsync_width = <0x1e>;
				hsync_polarity = <0x01>;
				vsync_start = <0x00>;
				vsync_width = <0x02>;
				vsync_polarity = <0x01>;
				de_hstart = <0x70>;
				de_vstart = <0x4e>;
				resolution_width = <0xf00>;
				resolution_height = <0x870>;
				max_h_total = <0x1194>;
				typ_h_total = <0x1130>;
				min_h_total = <0x10cc>;
				max_v_total = <0x92e>;
				typ_v_total = <0x8ca>;
				min_v_total = <0x8be>;
				typ_clk_high = <0x00>;
				typ_clk_low = <0x2367b880>;
				output_format = <0x00>;
				content_output_format = <0x00>;
				output_color_range = <0x01>;
				output_color_space = <0x00>;
				graphic_mixer1_outmode = <0x00>;
				graphic_mixer2_outmode = <0x01>;
			};

			timing_info_50 {
				panel_name = "SONY BE 4k 50";
				link_type = <0x01>;
				vbo_byte_mode = <0x04>;
				div_section = <0x01>;
				on_timing1 = <0x1e>;
				on_timing2 = <0xc8>;
				off_timing1 = <0xdc>;
				off_timing2 = <0x0a>;
				hsync_start = <0x00>;
				hsync_width = <0x1e>;
				hsync_polarity = <0x01>;
				vsync_start = <0x00>;
				vsync_width = <0x02>;
				vsync_polarity = <0x01>;
				de_hstart = <0x70>;
				de_vstart = <0x4e>;
				resolution_width = <0xf00>;
				resolution_height = <0x870>;
				max_h_total = <0x1194>;
				typ_h_total = <0x1130>;
				min_h_total = <0x10cc>;
				max_v_total = <0xaf0>;
				typ_v_total = <0xa8c>;
				min_v_total = <0xa28>;
				typ_clk_high = <0x00>;
				typ_clk_low = <0x2367b880>;
				output_format = <0x00>;
				content_output_format = <0x00>;
				output_color_range = <0x01>;
				output_color_space = <0x00>;
				graphic_mixer1_outmode = <0x00>;
				graphic_mixer2_outmode = <0x01>;
			};

			timing_info_48 {
				panel_name = "SONY BE 4k 48";
				link_type = <0x01>;
				vbo_byte_mode = <0x04>;
				div_section = <0x01>;
				on_timing1 = <0x1e>;
				on_timing2 = <0xc8>;
				off_timing1 = <0xdc>;
				off_timing2 = <0x0a>;
				hsync_start = <0x00>;
				hsync_width = <0x1e>;
				hsync_polarity = <0x01>;
				vsync_start = <0x00>;
				vsync_width = <0x02>;
				vsync_polarity = <0x01>;
				de_hstart = <0x70>;
				de_vstart = <0x4e>;
				resolution_width = <0xf00>;
				resolution_height = <0x870>;
				max_h_total = <0x1194>;
				typ_h_total = <0x1130>;
				min_h_total = <0x10cc>;
				max_v_total = <0xb60>;
				typ_v_total = <0xafc>;
				min_v_total = <0xa98>;
				typ_clk_high = <0x00>;
				typ_clk_low = <0x2367b880>;
				output_format = <0x00>;
				content_output_format = <0x00>;
				output_color_range = <0x01>;
				output_color_space = <0x00>;
				graphic_mixer1_outmode = <0x00>;
				graphic_mixer2_outmode = <0x01>;
			};
		};
	};

	fragment@6 {
		target = <0xffffffff>;

		__overlay__ {
			status = "disable";
			panel_info_name_list = "panel_info";

			panel_info {
				panel_name = "GFX output";
				link_type = <0x01>;
				vbo_byte_mode = <0x05>;
				div_section = <0x01>;
				on_timing1 = <0x1e>;
				on_timing2 = <0xc8>;
				off_timing1 = <0xdc>;
				off_timing2 = <0x0a>;
				hsync_start = <0x00>;
				hsync_width = <0x1e>;
				hsync_polarity = <0x01>;
				vsync_start = <0x00>;
				vsync_width = <0x02>;
				vsync_polarity = <0x01>;
				de_hstart = <0x70>;
				de_vstart = <0x4e>;
				resolution_width = <0xf00>;
				resolution_height = <0x870>;
				max_h_total = <0x1194>;
				typ_h_total = <0x1130>;
				min_h_total = <0x10cc>;
				max_v_total = <0x92e>;
				typ_v_total = <0x8d4>;
				min_v_total = <0x8be>;
				typ_clk_high = <0x00>;
				typ_clk_low = <0x23900100>;
				output_format = <0x08>;
				content_output_format = <0x04>;
				output_color_range = <0x01>;
				output_color_space = <0x00>;
				graphic_mixer1_outmode = <0x00>;
				graphic_mixer2_outmode = <0x01>;
			};

			loadfw-timing-info {
				panel_name = "GFX output";
				hsync_start = <0x00>;
				hsync_width = <0x1e>;
				vsync_start = <0x00>;
				vsync_width = <0x02>;
				de_hstart = <0x70>;
				de_vstart = <0x4e>;
				resolution_width = <0xf00>;
				resolution_height = <0x870>;
				max_h_total = <0x1194>;
				typ_h_total = <0x1130>;
				min_h_total = <0x10cc>;
				max_v_total = <0x92e>;
				typ_v_total = <0x8ca>;
				min_v_total = <0x8be>;
				typ_clk_high = <0x00>;
				typ_clk_low = <0x2367b880>;
			};
		};
	};

	__fixups__ {
		video_out = "/fragment@0:target:0";
		gpio0 = "/fragment@0/__overlay__:tcon_dlg-gpios:0";
		panel_cus_setting = "/fragment@1:target:0";
		panel_tcon_i2c_info = "/fragment@2:target:0";
		panel_tcon_vrr_od_info = "/fragment@3:target:0";
		panel_tcon_vrr_pga_info = "/fragment@4:target:0";
		ext_video_out = "/fragment@5:target:0";
		graphic_out = "/fragment@6:target:0";
	};
};
