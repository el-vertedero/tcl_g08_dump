/dts-v1/;

/ {

	fragment@0 {
		target = <0xffffffff>;

		__overlay__ {

			ir_keymap0 {
				protocol = <0x07>;
				keymap_name = "RCA_TV";
				customercode = <0x0f>;
				ir_key_table = <0x1c 0x0b 0x24f 0x0c 0x258 0x0d 0x236 0x10 0x24a 0x12 0x8b 0x13 0x2f7 0x14 0x18f 0x17 0x43 0x18 0x264 0x1a 0x190 0x1b 0x1c8 0x1c 0x239 0x1d 0x265 0x1e 0x266 0x1f 0xc7 0x20 0x23a 0x25 0x191 0x27 0xfe 0x2a 0xfd 0x2b 0x231 0x30 0x233 0x32 0x2f0 0x3e 0x253 0x46 0x254 0x47 0x256 0x48 0x257 0x49 0x252 0x4a 0x255 0x4b 0x3d 0x55 0x1d7 0x5c 0x2fa 0x65 0x4f 0x67 0x174 0x6f 0x2f1 0x72 0x28e 0x73 0x2ef 0x74 0x2ff 0x76 0x2f3 0x78 0x2eb 0x7a 0x2ea 0x7b 0x172 0x7f 0xcc 0x80 0x2ed 0x83 0x2ec 0x85 0x2e9 0x87 0x18b 0x9e 0x22b 0xa3 0x188 0xa5 0x67 0xa6 0x6c 0xa7 0x6a 0xa8 0x69 0xa9 0x22f 0xad 0x1b4 0xae 0x71 0xc0 0xc3 0xc3 0x179 0xc5 0x0b 0xcf 0x02 0xce 0x03 0xcd 0x04 0xcc 0x05 0xcb 0x06 0xca 0x07 0xc9 0x08 0xc8 0x09 0xc7 0x0a 0xc6 0x73 0xd0 0x72 0xd1 0x192 0xd2 0x193 0xd3 0x74 0xd5 0x9e 0xd8 0xa4 0xd9 0x242 0xe0 0x184 0xe1 0x243 0xe2 0x241 0xe3 0x16d 0xe5 0xc9 0xe6 0xa7 0xe8 0x23f 0xea 0xd4 0xed 0x1d2 0xf3 0x40 0xf6 0x66 0xf7 0xae 0xf9 0x41 0xfa 0x1e5 0xfd 0x164 0xfe 0x18e 0xff 0x28d 0x7c 0x28b 0x9c 0x2e7 0x7d 0x288 0xec 0x28a 0x5a 0x289 0xb0 0x286 0xb1 0x28c 0x9d 0x10a 0x6c 0x290 0xb2 0x291 0xb3 0x292 0xb4 0x293 0xb5 0x294 0xb6 0x295 0xb7 0x296 0xb8 0x297 0xb9 0x298 0xbc 0x299 0xbd 0x280 0xbf 0x281 0xd4 0x282 0xd7 0x1fb 0xe9 0x152 0x6a 0x153 0x6b 0x154 0x6e 0x155 0xf1 0x159 0x35 0x157 0x33 0x158 0x34 0xd9 0x06 0x15c 0x37 0x15b 0x86 0x15a 0x36 0x15d 0x38 0x201 0x40 0x200 0x3d 0x2a0 0x41 0x2a1 0x42 0x2a2 0x43 0x2a3 0x44 0x2a4 0x0e 0x2a5 0x56 0x2a6 0x57 0x2a7 0x58 0x2a8 0x90 0x2a9 0x91 0x2aa 0x92 0x2ab 0x93 0x2ac 0x94 0x2ad 0x95 0x2ae 0x96 0x2af 0x97 0x2b0 0x02 0x2b1 0x03 0x2b2 0x04 0x2b3 0x05 0x2b4 0x07 0x2b5 0x08 0x2b6 0x09 0x2b7 0x0a>;
			};
		};
	};

	__fixups__ {
		ir_in = "/fragment@0:target:0";
	};
};
