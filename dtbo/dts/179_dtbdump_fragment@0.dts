/dts-v1/;

/ {

	fragment@0 {
		target = <0xffffffff>;

		__overlay__ {
			vritual_fe_id = <0x00 0x01>;
			cfm_group = <0xffffffff 0xffffffff>;

			cfm_node0 {
				tuners = <0x60f8 0xffff>;
				demods = <0x6691 0xffff>;
				lnbs = <0x123a>;
			};

			cfm_node1 {
				tuners = <0x61f8 0xffff>;
				demods = <0x6e91 0xffff>;
				lnbs = <0x123a>;
			};
		};
	};

	__fixups__ {
		mtk_cfm = "/fragment@0:target:0";
		cfm_node0 = "/fragment@0/__overlay__:cfm_group:0";
		cfm_node1 = "/fragment@0/__overlay__:cfm_group:4";
	};
};
